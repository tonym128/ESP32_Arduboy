// "SQUARE NOSE" + Lethal Mouse
// hold UP and press B in title screen to switch the playable character

//start adding code: 15-05-2019
// last coding: 06-06-2019
/*
- new playable character: Lethal Mouse (hard mode because player has less control on this character)
- target sprites for Lethal Mouse
- explosion animation for Lethal Mouse
- remove time over
- Square Nose can roll (he is a little bit faster when he rolls)
- Square Nose in ball sprites are bigger (but hitbox is the same)
- new title screen for Lethal Mouse and display optimized to save memory
- Square Nose spin has its own fonction
*/

// a Sonic demake for Arduboy
// made by Juice Lizard in 2018 and 2019

// juice.lizard@hotmail.fr
// www.juicelizard.com
// https://www.facebook.com/JuiceLizard/
// https://www.instagram.com/juicelizard/
// https://github.com/JuiceLizard

// tinyfont by Boti Kis
// "Squiddy" by Aphrodite

// Juice Lizard thanks Bateske (Arduboy), Crait (ToChars), Sonic Team, Team Meat ("Super Meat Boy"), Rémi Sharrock (MOOC "ABC du langage C" and "Programmer en C") and you for playing!

// press A to start
// press B to jump
// press LEFT or RIGHT to run
// press DOWN to crouch (it stops Lethal Mouse)
// press DOWN and LEFT or RIGHT to roll (Square Nose only)

#include <Arduboy2.h>
#include <ArduboyTones.h>

Arduboy2 arduboy;
ArduboyTones sound(arduboy.audio.enabled);

#define NOTE 80
#define REST 30
#define DELAY_1 60
#define REST_2 135
#define Y_BIRD 6
#define Y_BUG 52

bool SquareNoseGoesRight = true;
bool birdGoesRight = false;
bool bugGoesRight = true;
bool frogGoesRight = true;
int frogJumpSpeed = 0;
int frogJumpCounter = 0;
bool frogIsJumping = false;
bool SquareNoseIsJumping = false;
int xSquareNose = 22;
int ySquareNose = 42;
int xBird = 22;
int xBug = 74;
int xFrog = 84;
int yFrog = 42;
int xSquid = 60;
int ySquid = 46;
int xSquidBall = 60;
int ySquidBall = 2;
int jumpSpeed = 0;
int jumpCounter = 0;
int ballCounter = 0; // used for Square Nose spin animation
int runCounter = 0;
int gameState = -1;
int xMeatyRing = 94;
int yMeatyRing = 14;
int collectedMeatyRings = 0;
int animationCounter = 0; // bird and bug
int timeCounter = 0;
int seconds = 0;
int minutes = 0;
int level = 1;
int angle = 0;
bool squidSpins = false;
//bool turboMode = false;
int turbo = 0;

bool playLethalMouse = false;
bool LethalMouseMoves = false;

int ringAnimation = 0; // 0 to 28 frames


// BADGER sprite (92x20 pixels)
const unsigned char badgerLogo[] PROGMEM = {
  0x36, 0x36, 0x36, 0x36, 0x36, 0x36, 0x36, 0xf6, 0xe6, 0xce, 0x1e, 0xfc,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 0xc, 
};

// title screen in 3 different parts:
//"SQUARE NOSE" (116x36 pixels), "LETHAL MOUSE" (116x36 pixels) and "a game by Juice Lizard" (116x16 pixels)
const unsigned char SQUARE_NOSE[] PROGMEM = {
  0xff, 0xff, 0xff, 0xff, 0xf, 0xf, 0xf, 0xf, 0xf, 0xf, 0xf, 0xf,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 0x00, 
};

const unsigned char LETHAL_MOUSE[] PROGMEM = {
  0xff, 0xff, 0xff, 0xff, 0x00, 0x00, 0x00, 0x00, 0x00, 0x00, 0x00, 0x00,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 0x00, 
};

const unsigned char aGameByJuiceLizard[] PROGMEM = {
  0x00, 0x00, 0x00, 0x00, 0x00, 0x00, 0x00, 0x00, 0x00, 0x00, 0x00, 0x00,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 0xfc, 
};

// Square Nose sprites
const unsigned char SquareNoseRunsRight1[] PROGMEM = {
  0xf0, 0xf0, 0xfc, 0xfc, 0xcf, 0xcf, 0xfc, 0xfc, 0xcf, 0xcf, 0xfc, 0xfc,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 0x00, 
};

const unsigned char SquareNoseRunsRight2[] PROGMEM = {
  0xf0, 0xf0, 0xfc, 0xfc, 0xcf, 0xcf, 0xfc, 0xfc, 0xcf, 0xcf, 0xfc, 0xfc,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 0x00, 
};

const unsigned char SquareNoseRunsLeft1[] PROGMEM = {
  0x30, 0x30, 0xc0, 0xc0, 0xfc, 0xfc, 0xcf, 0xcf, 0xfc, 0xfc, 0xcf, 0xcf,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 0x00, 
};

const unsigned char SquareNoseRunsLeft2[] PROGMEM = {
  0x30, 0x30, 0xc0, 0xc0, 0xfc, 0xfc, 0xcf, 0xcf, 0xfc, 0xfc, 0xcf, 0xcf,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 0xf, 
};

// Lethal Mouse sprites (20x24 pixels)
const unsigned char LethalMouseRight[] PROGMEM = {
  0xf0, 0xf0, 0x3c, 0x3c, 0xf, 0xf, 0xc3, 0xc3, 0xf, 0xf, 0xc3, 0xc3,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 0x00, 
};

const unsigned char LethalMouseLeft[] PROGMEM = {
  0xf0, 0xf0, 0x30, 0x30, 0xfc, 0xfc, 0xf, 0xf, 0xc3, 0xc3, 0xf, 0xf,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 0x3, 
};

const unsigned char LethalMouseRunsRight[] PROGMEM = {
  0xf0, 0xf0, 0x3c, 0x3c, 0xf, 0xf, 0xc3, 0xc3, 0xf, 0xf, 0xc3, 0xc3,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 0x00, 
};

const unsigned char LethalMouseRunsLeft[] PROGMEM = {
  0xf0, 0xf0, 0x30, 0x30, 0xfc, 0xfc, 0xf, 0xf, 0xc3, 0xc3, 0xf, 0xf,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 0xff, 
};

// Square Nose ball shape sprites
const unsigned char ball1[] PROGMEM = {
  0xc0, 0xc0, 0xfc, 0xfc, 0xfc, 0xfc, 0xff, 0xff, 0xf3, 0xf3, 0xcc, 0xcc, 0xfc, 0xfc, 0xc0, 0xc0, 0x3, 0x3, 0x3f, 0x3f, 0x3f, 0x3f, 0xff, 0xff, 0xff, 0xff, 0x3f, 0x3f, 0x3f, 0x3f, 0x3, 0x3, 
};

const unsigned char ball2[] PROGMEM = {
  0xc0, 0xc0, 0xfc, 0xfc, 0xfc, 0xfc, 0xff, 0xff, 0xff, 0xff, 0xfc, 0xfc, 0xfc, 0xfc, 0xc0, 0xc0, 0x3, 0x3, 0x3f, 0x3f, 0x3f, 0x3f, 0xff, 0xff, 0xff, 0xff, 0x33, 0x33, 0x3c, 0x3c, 0x3, 0x3, 
};

const unsigned char ball3[] PROGMEM = {
  0xc0, 0xc0, 0xfc, 0xfc, 0xfc, 0xfc, 0xff, 0xff, 0xff, 0xff, 0xfc, 0xfc, 0xfc, 0xfc, 0xc0, 0xc0, 0x3, 0x3, 0x3f, 0x3f, 0x33, 0x33, 0xcf, 0xcf, 0xff, 0xff, 0x3f, 0x3f, 0x3f, 0x3f, 0x3, 0x3, 
};

const unsigned char ball4[] PROGMEM = {
  0xc0, 0xc0, 0x3c, 0x3c, 0xcc, 0xcc, 0xff, 0xff, 0xff, 0xff, 0xfc, 0xfc, 0xfc, 0xfc, 0xc0, 0xc0, 0x3, 0x3, 0x3f, 0x3f, 0x3f, 0x3f, 0xff, 0xff, 0xff, 0xff, 0x3f, 0x3f, 0x3f, 0x3f, 0x3, 0x3,   
};

// electrified Square Nose sprite (16x20 pixels)
const unsigned char electrifiedSquareNose[] PROGMEM = {
  0x00, 0x00, 0xf0, 0xf0, 0xcf, 0xcf, 0xfc, 0xfc, 0xfc, 0xfc, 0xcf, 0xcf,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 0x00, 
};

// Lethal Mouse death sprite (16x24 pixels)
const unsigned char deadLethalMouse[] PROGMEM = {
  0xf0, 0xf0, 0x3f, 0x3f, 0xc3, 0xc3, 0xf, 0xf, 0xf, 0xf, 0xc3, 0xc3,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 0xff, 
};

// meaty ring sprites (it is dry food for cats and dogs)
const unsigned char meatyRing1[] PROGMEM = {
  0xf0, 0xf0, 0xc, 0xc, 0x3, 0x3, 0x3, 0x3, 0xc, 0xc, 0xf0, 0xf0, 0x00, 0x00, 0x3, 0x3, 0xc, 0xc, 0xc, 0xc, 0x3, 0x3, 0x00, 0x00,
};

const unsigned char meatyRing2[] PROGMEM = {
  0x00, 0x00, 0xfc, 0xfc, 0x3, 0x3, 0x3, 0x3, 0xfc, 0xfc, 0x00, 0x00, 0x00, 0x00, 0x3, 0x3, 0xc, 0xc, 0xc, 0xc, 0x3, 0x3, 0x00, 0x00,
};

const unsigned char meatyRing3[] PROGMEM = {
  0x00, 0x00, 0x00, 0x00, 0xff, 0xff, 0xff, 0xff, 0x00, 0x00, 0x00, 0x00, 0x00, 0x00, 0x00, 0x00, 0xf, 0xf, 0xf, 0xf, 0x00, 0x00, 0x00, 0x00, 
};

// target sprites (14x14 pixels white, 18x18 pixels black)
const unsigned char target[] PROGMEM = {
  0xc0, 0xc0, 0xfc, 0xfc, 0xc, 0xc, 0xcf, 0xcf, 0xc, 0xc, 0xfc, 0xfc, 0xc0, 0xc0, 0x00, 0x00, 0xf, 0xf, 0xc, 0xc, 0x3c, 0x3c, 0xc, 0xc, 0xf, 0xf, 0x00, 0x00, 
};

const unsigned char targetBlack[] PROGMEM = {
  0xc0, 0xc0, 0xfc, 0xfc, 0xc, 0xc, 0xcf, 0xcf, 0xc3, 0xc3, 0xcf, 0xcf,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 0x00, 
};

// bird sprites
const unsigned char birdRight1[] PROGMEM = {
  0xc, 0xc, 0x33, 0x33, 0xc3, 0xc3, 0xc, 0xc, 0x30, 0x30, 0xcc, 0xcc,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 0x00,
};

const unsigned char birdRight1black[] PROGMEM = {
  0x00, 0x00, 0xc, 0xc, 0x3c, 0x3c, 0xf0, 0xf0, 0xc0, 0xc0, 0x30, 0x30,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 0x00, 
};

const unsigned char birdRight2[] PROGMEM = {
  0xc0, 0xc0, 0xf0, 0xf0, 0xcc, 0xcc, 0xc, 0xc, 0x30, 0x30, 0xcc, 0xcc,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 0x00, 
};

const unsigned char birdRight2black[] PROGMEM = {
  0x00, 0x00, 0x00, 0x00, 0x30, 0x30, 0xf0, 0xf0, 0xc0, 0xc0, 0x30, 0x30,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 0x00, 
};

const unsigned char birdLeft1[] PROGMEM = {
  0x30, 0x30, 0xfc, 0xfc, 0xcc, 0xcc, 0xcc, 0xcc, 0x30, 0x30, 0xc, 0xc,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 0x00,
};

const unsigned char birdLeft1black[] PROGMEM = {
  0x00, 0x00, 0x00, 0x00, 0x30, 0x30, 0x30, 0x30, 0xc0, 0xc0, 0xf0, 0xf0,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 0x00, 
};

const unsigned char birdLeft2[] PROGMEM = {
  0x30, 0x30, 0xfc, 0xfc, 0xcc, 0xcc, 0xcc, 0xcc, 0x30, 0x30, 0xc, 0xc,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 0x00,
};

const unsigned char birdLeft2black[] PROGMEM = {
  0x00, 0x00, 0x00, 0x00, 0x30, 0x30, 0x30, 0x30, 0xc0, 0xc0, 0xf0, 0xf0,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 0x00, 
};

// bug sprites
const unsigned char bugRight1[] PROGMEM = {
  0xfc, 0xfc, 0xc3, 0xc3, 0xc3, 0xc3, 0xc3, 0xc3, 0xfc, 0xfc, 0xcc, 0xcc, 0xfc, 0xfc, 0x00, 0x00, 0x3, 0x3, 0x00, 0x00, 0x00, 0x00, 0x00, 0x00, 0x3, 0x3, 0x00, 0x00, 
};

const unsigned char bugRightBlack[] PROGMEM = {
  0x00, 0x00, 0x3c, 0x3c, 0x3c, 0x3c, 0x3c, 0x3c, 0x00, 0x00, 0x30, 0x30, 0x00, 0x00, 0x00, 0x00, 0x00, 0x00, 0x00, 0x00, 0x00, 0x00, 0x00, 0x00, 0x00, 0x00, 0x00, 0x00,
};

const unsigned char bugRight2[] PROGMEM = {
  0xfc, 0xfc, 0xc3, 0xc3, 0xc3, 0xc3, 0xc3, 0xc3, 0xfc, 0xfc, 0xcc, 0xcc, 0xfc, 0xfc, 0x00, 0x00, 0x00, 0x00, 0x00, 0x00, 0x3, 0x3, 0x00, 0x00, 0x00, 0x00, 0x00, 0x00, 
};

const unsigned char bugLeft1[] PROGMEM = {
  0xfc, 0xfc, 0xcc, 0xcc, 0xfc, 0xfc, 0xc3, 0xc3, 0xc3, 0xc3, 0xc3, 0xc3, 0xfc, 0xfc, 0x00, 0x00, 0x3, 0x3, 0x00, 0x00, 0x00, 0x00, 0x00, 0x00, 0x3, 0x3, 0x00, 0x00, 
};

const unsigned char bugLeftBlack[] PROGMEM = {
  0x00, 0x00, 0x30, 0x30, 0x00, 0x00, 0x3c, 0x3c, 0x3c, 0x3c, 0x3c, 0x3c, 0x00, 0x00, 0x00, 0x00, 0x00, 0x00, 0x00, 0x00, 0x00, 0x00, 0x00, 0x00, 0x00, 0x00, 0x00, 0x00, 
};

const unsigned char bugLeft2[] PROGMEM = {
  0xfc, 0xfc, 0xcc, 0xcc, 0xfc, 0xfc, 0xc3, 0xc3, 0xc3, 0xc3, 0xc3, 0xc3, 0xfc, 0xfc, 0x00, 0x00, 0x00, 0x00, 0x00, 0x00, 0x3, 0x3, 0x00, 0x00, 0x00, 0x00, 0x00, 0x00,
};

// frog sprites
const unsigned char frog1[] PROGMEM = {
  0x00, 0x00, 0xf0, 0xf0, 0xff, 0xff, 0x33, 0x33, 0x3c, 0x3c, 0x3c, 0x3c,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 0xc, 
};

const unsigned char frog1black[] PROGMEM = {
  0x00, 0x00, 0x00, 0x00, 0x00, 0x00, 0xcc, 0xcc, 0xc0, 0xc0, 0xc0, 0xc0,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 0x00, 
};

const unsigned char frog2[] PROGMEM = {
  0x00, 0x00, 0xf0, 0xf0, 0xff, 0xff, 0x33, 0x33, 0x3c, 0x3c, 0x3c, 0x3c,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 0xc0, 
};

const unsigned char frog2black[] PROGMEM = {
  0x00, 0x00, 0x00, 0x00, 0x00, 0x00, 0xcc, 0xcc, 0xc0, 0xc0, 0xc0, 0xc0,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 0x00, 
};

// squid sprites
const unsigned char squid[] PROGMEM = {
  0x3, 0x3, 0xff, 0xff, 0xcc, 0xcc, 0x33, 0x33, 0x33, 0x33, 0xcc, 0xcc, 0xff, 0xff, 0x3, 0x3, 0xc0, 0xc0, 0xfc, 0xfc, 0xc3, 0xc3, 0x3f, 0x3f, 0x3f, 0x3f, 0xc3, 0xc3, 0xfc, 0xfc, 0xc0, 0xc0,
};

const unsigned char squidBlack[] PROGMEM = {
  0x00, 0x00, 0x00, 0x00, 0x30, 0x30, 0xcc, 0xcc, 0xcc, 0xcc, 0x30, 0x30, 0x00, 0x00, 0x00, 0x00, 0x00, 0x00, 0x00, 0x00, 0x00, 0x00, 0x00, 0x00, 0x00, 0x00, 0x00, 0x00, 0x00, 0x00, 0x00, 0x00,
};

const unsigned char squidBall[] PROGMEM = {
  0xc0, 0xc0, 0x3c, 0x3c, 0xc, 0xc, 0x3, 0x3, 0x3, 0x3, 0xc, 0xc, 0x3c, 0x3c, 0xc0, 0xc0, 0x3, 0x3, 0x3c, 0x3c, 0x30, 0x30, 0xc0, 0xc0, 0xc0, 0xc0, 0x30, 0x30, 0x3c, 0x3c, 0x3, 0x3,
};

const unsigned char squidBallBlack[] PROGMEM = {
  0x00, 0x00, 0xc0, 0xc0, 0xf0, 0xf0, 0xfc, 0xfc, 0xfc, 0xfc, 0xf0, 0xf0, 0xc0, 0xc0, 0x00, 0x00, 0x00, 0x00, 0x3, 0x3, 0xf, 0xf, 0x3f, 0x3f, 0x3f, 0x3f, 0xf, 0xf, 0x3, 0x3, 0x00, 0x00,
};

// TRUE PASTA sprite (96x36 pixels)
const unsigned char TruePasta[] PROGMEM = {
  0xf, 0xf, 0xf, 0xf, 0xff, 0xff, 0xff, 0xff, 0xf, 0xf, 0xf, 0xf,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 0xf, 
};

// level numbers sprites (tinyfont 32x32 pixels)
const unsigned char bigOne[] PROGMEM = {
  0x00, 0x00, 0x00, 0x00, 0x00, 0x00, 0x00, 0x00, 0xff, 0xff, 0xff, 0xff,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 0xff, 
};

const unsigned char bigTwo[] PROGMEM = {
  0xff, 0xff, 0xff, 0xff, 0xff, 0xff, 0xff, 0xff, 0xff, 0xff, 0xff, 0xff,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 0xff, 
};

const unsigned char bigThree[] PROGMEM = {
  0xff, 0xff, 0xff, 0xff, 0xff, 0xff, 0xff, 0xff, 0xff, 0xff, 0xff, 0xff,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 0xff, 
};

// numbers (tinyfont 16x16 pixels)
const unsigned char zero[] PROGMEM = {
  0xff, 0xff, 0xff, 0xff, 0xf, 0xf, 0xf, 0xf, 0xf, 0xf, 0xf, 0xf, 0xff, 0xff, 0xff, 0xff, 0xff, 0xff, 0xff, 0xff, 0xf0, 0xf0, 0xf0, 0xf0, 0xf0, 0xf0, 0xf0, 0xf0, 0xff, 0xff, 0xff, 0xff, 
};

const unsigned char one[] PROGMEM = {
  0x00, 0x00, 0x00, 0x00, 0xf, 0xf, 0xf, 0xf, 0xff, 0xff, 0xff, 0xff, 0x00, 0x00, 0x00, 0x00, 0x00, 0x00, 0x00, 0x00, 0xf0, 0xf0, 0xf0, 0xf0, 0xff, 0xff, 0xff, 0xff, 0xf0, 0xf0, 0xf0, 0xf0, 
};

const unsigned char two[] PROGMEM = {
  0xf, 0xf, 0xf, 0xf, 0xf, 0xf, 0xf, 0xf, 0xff, 0xff, 0xff, 0xff, 0xf, 0xf, 0xf, 0xf, 0xf0, 0xf0, 0xf0, 0xf0, 0xff, 0xff, 0xff, 0xff, 0xf0, 0xf0, 0xf0, 0xf0, 0xf0, 0xf0, 0xf0, 0xf0, 
};

const unsigned char three[] PROGMEM = {
  0xf, 0xf, 0xf, 0xf, 0xff, 0xff, 0xff, 0xff, 0xff, 0xff, 0xff, 0xff, 0xff, 0xff, 0xff, 0xff, 0xf0, 0xf0, 0xf0, 0xf0, 0xf0, 0xf0, 0xf0, 0xf0, 0xf0, 0xf0, 0xf0, 0xf0, 0xff, 0xff, 0xff, 0xff,
};

const unsigned char four[] PROGMEM = {
  0xff, 0xff, 0xff, 0xff, 0x00, 0x00, 0x00, 0x00, 0x00, 0x00, 0x00, 0x00, 0xff, 0xff, 0xff, 0xff, 0xf, 0xf, 0xf, 0xf, 0xf, 0xf, 0xf, 0xf, 0xf, 0xf, 0xf, 0xf, 0xff, 0xff, 0xff, 0xff, 
};

const unsigned char five[] PROGMEM = {
  0xff, 0xff, 0xff, 0xff, 0xf, 0xf, 0xf, 0xf, 0xf, 0xf, 0xf, 0xf, 0xf, 0xf, 0xf, 0xf, 0xf, 0xf, 0xf, 0xf, 0xff, 0xff, 0xff, 0xff, 0xff, 0xff, 0xff, 0xff, 0xff, 0xff, 0xff, 0xff, 
};

const unsigned char six[] PROGMEM = {
  0xff, 0xff, 0xff, 0xff, 0xf0, 0xf0, 0xf0, 0xf0, 0xf0, 0xf0, 0xf0, 0xf0, 0xf0, 0xf0, 0xf0, 0xf0, 0xff, 0xff, 0xff, 0xff, 0xf0, 0xf0, 0xf0, 0xf0, 0xf0, 0xf0, 0xf0, 0xf0, 0xff, 0xff, 0xff, 0xff, 
};

const unsigned char seven[] PROGMEM = {
  0xf, 0xf, 0xf, 0xf, 0xf, 0xf, 0xf, 0xf, 0xf, 0xf, 0xf, 0xf, 0xff, 0xff, 0xff, 0xff, 0x00, 0x00, 0x00, 0x00, 0x00, 0x00, 0x00, 0x00, 0x00, 0x00, 0x00, 0x00, 0xff, 0xff, 0xff, 0xff,
};

const unsigned char eight[] PROGMEM = {
  0xff, 0xff, 0xff, 0xff, 0xf, 0xf, 0xf, 0xf, 0xf, 0xf, 0xf, 0xf, 0xff, 0xff, 0xff, 0xff, 0xff, 0xff, 0xff, 0xff, 0xff, 0xff, 0xff, 0xff, 0xff, 0xff, 0xff, 0xff, 0xff, 0xff, 0xff, 0xff, 
};

const unsigned char nine[] PROGMEM = {
  0xff, 0xff, 0xff, 0xff, 0xf, 0xf, 0xf, 0xf, 0xf, 0xf, 0xf, 0xf, 0xff, 0xff, 0xff, 0xff, 0xf, 0xf, 0xf, 0xf, 0xf, 0xf, 0xf, 0xf, 0xf, 0xf, 0xf, 0xf, 0xff, 0xff, 0xff, 0xff, 
};

// TIME sprite (tinyfont 76x16 pixels)
const unsigned char TIME[] PROGMEM = {
  0xf, 0xf, 0xf, 0xf, 0xff, 0xff, 0xff, 0xff, 0xf, 0xf, 0xf, 0xf,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 0xf0, 
};

// TEST sprite (tinyfont 76x16 pixels)
const unsigned char TEST[] PROGMEM = {
  0xf, 0xf, 0xf, 0xf, 0xff, 0xff, 0xff, 0xff, 0xf, 0xf, 0xf, 0xf,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 0x00, 
};

// "m" for minutes and "s" for seconds sprites (tinyfont 16x16 pixels)
const unsigned char smallM[] PROGMEM = {
  0xf0, 0xf0, 0xf0, 0xf0, 0xf0, 0xf0, 0xf0, 0xf0, 0xf0, 0xf0, 0xf0, 0xf0, 0x00, 0x00, 0x00, 0x00, 0xff, 0xff, 0xff, 0xff, 0xf, 0xf, 0xf, 0xf, 0xff, 0xff, 0xff, 0xff, 0x00, 0x00, 0x00, 0x00, 
};

const unsigned char smallS[] PROGMEM = {
  0x00, 0x00, 0x00, 0x00, 0xf0, 0xf0, 0xf0, 0xf0, 0xf0, 0xf0, 0xf0, 0xf0, 0x00, 0x00, 0x00, 0x00, 0xf0, 0xf0, 0xf0, 0xf0, 0xff, 0xff, 0xff, 0xff, 0x00, 0x00, 0x00, 0x00, 0x00, 0x00, 0x00, 0x00, 
};

// GAME sprite (tinyfont 76x16 pixels)
const unsigned char GAME[] PROGMEM = {
  0xff, 0xff, 0xff, 0xff, 0xf, 0xf, 0xf, 0xf, 0xf, 0xf, 0xf, 0xf,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 0xf0, 
};

// OVER sprite (tinyfont 76x16 pixels)
const unsigned char OVER[] PROGMEM = {
  0xff, 0xff, 0xff, 0xff, 0xf, 0xf, 0xf, 0xf, 0xf, 0xf, 0xf, 0xf,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 0xf, 
};

// Y_U'RE A TRUE PLAYER sprite (128x64 pixels)
const unsigned char truePlayer[] PROGMEM = {
  0x00, 0x00, 0x00, 0x00, 0x00, 0x00, 0xf0, 0xf0, 0xf0, 0xf0, 0x00, 0x00,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 0x00, 
};

// 8x8 tinyfont numbers sprites (unused but you can take it for your games)
/*const unsigned char zero8[] PROGMEM = {
  0xff, 0xff, 0xc3, 0xc3, 0xc3, 0xc3, 0xff, 0xff, 
};

const unsigned char one8[] PROGMEM = {
  0x00, 0x00, 0xc3, 0xc3, 0xff, 0xff, 0xc0, 0xc0, 
};

const unsigned char two8[] PROGMEM = {
  0xc3, 0xc3, 0xf3, 0xf3, 0xcf, 0xcf, 0xc3, 0xc3, 
};

const unsigned char three8[] PROGMEM = {
  0xc3, 0xc3, 0xcf, 0xcf, 0xcf, 0xcf, 0xff, 0xff, 
};

const unsigned char four8[] PROGMEM = {
  0x3f, 0x3f, 0x30, 0x30, 0x30, 0x30, 0xff, 0xff, 
};

const unsigned char five8[] PROGMEM = {
  0x3f, 0x3f, 0xf3, 0xf3, 0xf3, 0xf3, 0xf3, 0xf3, 
};

const unsigned char six8[] PROGMEM = {
  0xff, 0xff, 0xcc, 0xcc, 0xcc, 0xcc, 0xfc, 0xfc, 
};

const unsigned char seven8[] PROGMEM = {
  0x3, 0x3, 0x3, 0x3, 0x3, 0x3, 0xff, 0xff, 
};

const unsigned char eight8[] PROGMEM = {
  0xff, 0xff, 0xf3, 0xf3, 0xf3, 0xf3, 0xff, 0xff, 
};

const unsigned char nine8[] PROGMEM = {
  0x3f, 0x3f, 0x33, 0x33, 0x33, 0x33, 0xff, 0xff, 
};*/

// sounds

const uint16_t introMusic[] PROGMEM = {
  NOTE_A2, NOTE, NOTE_C3, NOTE, NOTE_REST, REST, NOTE_E3, NOTE, NOTE_G3, NOTE, NOTE_REST, 50, NOTE_C3, NOTE, NOTE_E3, NOTE, NOTE_REST, REST, NOTE_G3, NOTE, NOTE_B3, NOTE, NOTE_REST, 50, NOTE_E3, NOTE, NOTE_G3, NOTE, NOTE_REST, REST, NOTE_B3, NOTE, NOTE_D4, NOTE, NOTE_REST, 50, NOTE_G3, NOTE, NOTE_B3, NOTE, NOTE_REST, REST, NOTE_D4, NOTE, NOTE_F4, NOTE, TONES_END
};

const uint16_t congratulations[] PROGMEM = {
  NOTE_A2, DELAY_1, NOTE_REST, REST_2, NOTE_C3, DELAY_1, NOTE_REST, REST_2, NOTE_E3, DELAY_1, NOTE_REST, REST_2, NOTE_G3, DELAY_1, NOTE_REST, 20, NOTE_C3, DELAY_1, NOTE_REST, 80, NOTE_C3, DELAY_1, NOTE_REST, REST_2, NOTE_E3, DELAY_1, NOTE_REST, REST_2, NOTE_G3, DELAY_1, NOTE_REST, REST_2, NOTE_B3, DELAY_1, NOTE_REST, REST_2, NOTE_G3, DELAY_1, NOTE_REST, 240, NOTE_G3, DELAY_1, NOTE_REST, 50, NOTE_A3, DELAY_1, NOTE_REST, 50, NOTE_G3, DELAY_1, NOTE_REST, 50, NOTE_C4, DELAY_1, NOTE_REST, 180, NOTE_C3, DELAY_1, TONES_END
};

const uint16_t jumpBip[] PROGMEM = {
  NOTE_B3, 30, TONES_END
};

const uint16_t frogJumpBip[] PROGMEM = {
  NOTE_G3, 30, TONES_END
};

const uint16_t squidBip[] PROGMEM = {
  NOTE_E3, 50, TONES_END
};

const uint16_t meatyRingBip[] PROGMEM = {
  NOTE_C4, 60, NOTE_E4, 60, TONES_END
};

const uint16_t electricitySound[] PROGMEM = {
  NOTE_B2, 100, NOTE_A2, 100, NOTE_G2, 100, NOTE_F2, 100, NOTE_E2, 100, NOTE_D2, 100, NOTE_C2, 400, TONES_END
};

const uint16_t endOfTestSound[] PROGMEM = {
  NOTE_A2, 120, NOTE_C3, 120, NOTE_REST, 30, NOTE_E3, 120, NOTE_G3, 120, NOTE_REST, 30, NOTE_B3, 120, NOTE_D4, 120, NOTE_REST, 30, TONES_END
};

void resetValues();

// function used to draw big tinyfont numbers on screen
void drawNumber(int, int, int);

void setup() {
  arduboy.begin();
  arduboy.setFrameRate(60);
//  arduboy.audio.on();
//  If you have no sound: hold B when turning on the Arduboy, press UP, then release B.
//  If you want to turn off the sound: hold B when turning on the Arduboy, then press DOWN, then release B.
}

void loop() {
  if (!(arduboy.nextFrame())) return;
  arduboy.pollButtons();
  arduboy.clear();

// -1 badger logo; 0 title screen; 1 True Pasta; 2 test chamber (the game); 3 time; 4 game over; 5 congratulation
  switch(gameState) {

// BADGER logo
    case -1:
      arduboy.clear();
      arduboy.drawBitmap(18, 22, badgerLogo, 92, 20, WHITE);
      arduboy.display();
      sound.tones(introMusic);
      delay(4096);
      gameState = 0;
      break;
      
// TITLE SCREEN
    case 0:
// draw the title screen ("SQUARE NOSE" or "LETHAL MOUSE", "a game by Juice Lizard")
      if (playLethalMouse == true) {
//        arduboy.drawBitmap(0, 0, titleScreenLethalMouse, 128, 64, WHITE);
        arduboy.drawBitmap(6, 0, LETHAL_MOUSE, 116, 36, WHITE);
      } else {
//        arduboy.drawBitmap(0, 0, titleScreen, 128, 64, WHITE);
        arduboy.drawBitmap(6, 0, SQUARE_NOSE, 116, 36, WHITE);
      }
      arduboy.drawBitmap(6, 48, aGameByJuiceLizard, 116, 16, WHITE);

// draw loop number
      if (playLethalMouse == true) {
        arduboy.fillRect(36, 20, 16, 16, BLACK);
        if (arduboy.everyXFrames(2)) {
          drawNumber(turbo, 36, 20);
        }
      } else {
        arduboy.fillRect(46, 20, 16, 16, BLACK);
        if (arduboy.everyXFrames(2)) {
          drawNumber(turbo, 46, 20);
        }
      }

// choose to play with Square Nose or Lethal Mouse
      if ((arduboy.pressed(UP_BUTTON)) && (arduboy.justPressed(B_BUTTON))) {
        if (playLethalMouse == false) {
          playLethalMouse = true;
        } else {
          playLethalMouse = false;
        }
      }

// start the game after pressing the A button
      if (arduboy.justReleased(A_BUTTON)) {
        gameState = 1;
// reset all the values (when you start to play and when you lose)
        SquareNoseGoesRight = true;
        birdGoesRight = false;
        bugGoesRight = true;
        SquareNoseIsJumping = false;
        xSquareNose = 22;
        ySquareNose = 42;
        xBird = 22;
        xBug = 74;
        xFrog = 84;
        yFrog = 42;
        xSquid = 60;
        ySquid = 46;
        xSquidBall = 60;
        ySquidBall = 2;
        frogGoesRight = true;
        frogJumpSpeed = 0;
        frogJumpCounter = 0;
        frogIsJumping = false;
        jumpSpeed = 0;
        jumpCounter = 0;
        ballCounter = 0;
        runCounter = 0;
        xMeatyRing = 94;
        yMeatyRing = 14;
        collectedMeatyRings = 0;
        animationCounter = 0;
        timeCounter = 0;
        seconds = 0;
        minutes = 0;
        angle = 0;
        squidSpins = false;
        randomSeed(millis()); // the meaty rings (after the first) will spawn at a different place each time
        LethalMouseMoves = false;
      }
      break;

// TRUE PASTA (show the level you are going to play)
    case 1:
      arduboy.drawBitmap(4, 28, TruePasta, 96, 36, WHITE);
// show the level number you are going to play
      if (arduboy.everyXFrames(2)) {
        switch(level) {
          case 1:
            arduboy.drawBitmap(88, 8, bigOne, 32, 32, WHITE);
            break;
          case 2:
            arduboy.drawBitmap(88, 8, bigTwo, 32, 32, WHITE);
            break;
          case 3:
            arduboy.drawBitmap(88, 8, bigThree, 32, 32, WHITE);
            break;
        }
      }

// go to the game when releasing the A button(test chamber)
      if (arduboy.justReleased(A_BUTTON)) {
        gameState = 2;
      }
      break;

// TEST CHAMBER (the game)
    case 2:
// the in game timer
      timeCounter = timeCounter + 1;
      if (timeCounter > 59) {
        seconds = seconds + 1;
        timeCounter = 0;
      }
      if (seconds > 59) {
        minutes = minutes + 1;
        seconds = 0;
      }
// this was the time over, when 128 seconds passed
/*      if ((minutes > 1) && (seconds > 7)) {
        gameState = 4;
        sound.tones(electricitySound);
      }
*/

// frog jumps every two seconds in loop zero, every 1.5 seconds in loop 1 and always in loop 2
        switch(turbo) {
          case 0:
            if (((seconds % 2) == 0) && (timeCounter == 1)) {
              frogIsJumping = true;
            }
            break;
          case 1:
            if ((((seconds % 3) == 0) && (timeCounter == 1)) || ((((seconds - 1) % 3) == 0) && (timeCounter == 31))) {
              frogIsJumping = true;
            }
            break;
          case 2:
            frogIsJumping = true;
            break;
        }

// a counter used for different sprite animations (20 frames)
      animationCounter = animationCounter + 1;
      if (animationCounter > 19) {
        animationCounter = 0;
      }
    
// when Square Nose touches a meaty ring    
      if (((xSquareNose > (xMeatyRing - 12)) && (xSquareNose < (xMeatyRing + 8))) && ((ySquareNose > (yMeatyRing - 8)) && (ySquareNose < (yMeatyRing + 8)))){
// a new meaty ring appears
        xMeatyRing = random(2, 114);
        yMeatyRing = random(2, 46);
// the meaty ring counter is incremented
        collectedMeatyRings = collectedMeatyRings + 1;
        sound.tones(meatyRingBip);
      }

// Lethal Mouse horizontal moves
      if (playLethalMouse == true) {
// change direction
        if (arduboy.pressed(RIGHT_BUTTON) && (ySquareNose == 42)) {
          SquareNoseGoesRight = true;
          LethalMouseMoves = true;
        }
        if (arduboy.pressed(LEFT_BUTTON) && (ySquareNose == 42)) {
          SquareNoseGoesRight = false;
          LethalMouseMoves = true;
        }
// move left or right
        if (LethalMouseMoves == true) {
          if (SquareNoseGoesRight == true) {
            xSquareNose = xSquareNose + 2;
          } else {
            xSquareNose = xSquareNose - 2;
          }
        }
        if (arduboy.pressed(DOWN_BUTTON) && (ySquareNose > 41)) {
          LethalMouseMoves = false;
        }
      } else {
// Square Nose horizontal moves
        if ((arduboy.pressed(RIGHT_BUTTON)) && (!(arduboy.pressed(LEFT_BUTTON)))) {
          SquareNoseGoesRight = true;
          if (arduboy.pressed(DOWN_BUTTON)) {
            xSquareNose = xSquareNose + 3;
          } else {
            xSquareNose = xSquareNose + 2;
          }
        }
        if ((arduboy.pressed(LEFT_BUTTON)) && (!(arduboy.pressed(RIGHT_BUTTON)))) {
          SquareNoseGoesRight = false;
          if (arduboy.pressed(DOWN_BUTTON)) {
            xSquareNose = xSquareNose - 3;
          } else {
            xSquareNose = xSquareNose - 2;
          }
        }
      }

// Square Nose or Lethal Mouse is stopped by the left and right screen limits
      if (xSquareNose > 109) {
        LethalMouseMoves = false;
        xSquareNose = 110;
      }
      if (xSquareNose < 3) {
        LethalMouseMoves = false;
        xSquareNose = 2;
      }

// Square Nose jump
      if ((ySquareNose == 42) && (arduboy.justPressed(B_BUTTON))) {
        SquareNoseIsJumping = true;
        jumpSpeed = -4;
        sound.tones(jumpBip);
      }

      if (SquareNoseIsJumping == true) {
        ySquareNose = ySquareNose + jumpSpeed;
        jumpCounter = jumpCounter + 1;
        if ((jumpCounter % 4) == 0) {
          jumpSpeed = jumpSpeed + 1;
        }
      }

// jump less high if B button is released during the ascension
      if ((arduboy.justReleased(B_BUTTON)) && (jumpSpeed < 0)){
        jumpSpeed = jumpSpeed / 2;
      }

// stop falling if Square Nose touches the ground
      if (ySquareNose > 42) {
        ySquareNose = 42;
        SquareNoseIsJumping = false;
        jumpCounter = 0;
      }
  
// draw the number of collected meaty rings
      if (arduboy.everyXFrames(2)) {
        drawNumber(collectedMeatyRings / 10, 46, 24);
        drawNumber(collectedMeatyRings % 10, 66, 24);
      }

// draw the target
      if (playLethalMouse == true) {
          if (arduboy.everyXFrames(2)) {
            arduboy.drawBitmap(xMeatyRing, yMeatyRing, target, 14, 14, WHITE);
          }
          arduboy.drawBitmap(xMeatyRing - 2, yMeatyRing - 2, targetBlack, 18, 18, BLACK);
      } else {
// a counter used for ring sprites animation (28 frames)
        ringAnimation = ringAnimation + 1;
        if (ringAnimation > 27) {
          ringAnimation = 0;
        }
// draw the meaty ring
        if (ringAnimation < 7) {
          arduboy.drawBitmap(xMeatyRing, yMeatyRing, meatyRing1, 12, 12, WHITE);
        }
        if (((ringAnimation > 6) && (ringAnimation < 14)) || (ringAnimation > 20)) {
          arduboy.drawBitmap(xMeatyRing, yMeatyRing, meatyRing2, 12, 12, WHITE);
        }
        if ((ringAnimation > 13) && (ringAnimation < 21)) {
          arduboy.drawBitmap(xMeatyRing, yMeatyRing, meatyRing3, 12, 12, WHITE);
        }
      }

      
// draw Square Nose or Lethal Mouse
// player is jumping
      if (ySquareNose < 42) {
        if (playLethalMouse == true) {
          arduboy.drawBitmap(xSquareNose, ySquareNose, squidBall, 16, 16, WHITE);
          arduboy.drawBitmap(xSquareNose, ySquareNose, squidBallBlack, 16, 16, BLACK);
        } else {
          SquareNoseSpin();
        }
// player is on the ground
      } else {
        if (arduboy.pressed(DOWN_BUTTON)) {
          ySquareNose = 46;
          if (playLethalMouse == true) {
            arduboy.drawBitmap(xSquareNose, ySquareNose, squidBall, 16, 16, WHITE);
            arduboy.drawBitmap(xSquareNose, ySquareNose, squidBallBlack, 16, 16, BLACK);
          } else {
            if (!(arduboy.pressed(LEFT_BUTTON)) && !(arduboy.pressed(RIGHT_BUTTON))) {
              arduboy.drawBitmap(xSquareNose, ySquareNose, ball1, 16, 16, WHITE);
            } else {
              SquareNoseSpin();
            }
          }
        } else {
          ySquareNose = 42;
          if (SquareNoseGoesRight == true) {
            if (arduboy.pressed(RIGHT_BUTTON)) {
              if (playLethalMouse == true) {
                arduboy.drawBitmap(xSquareNose, ySquareNose, SquareNoseRunsRight1, 16, 20, BLACK);
                arduboy.drawBitmap(xSquareNose - 2, ySquareNose - 2, LethalMouseRunsRight, 20, 24, WHITE);
                if (arduboy.everyXFrames(2)) {
                    arduboy.fillRect(xSquareNose, ySquareNose + 18, 2, 2, WHITE);
                    arduboy.fillRect(xSquareNose + 6, ySquareNose + 18, 2, 2, WHITE);
                  }
              } else {
                runCounter = runCounter + 1;
                if (runCounter > 19) {
                  runCounter = 0;
                }
                if (runCounter < 10) {
                  arduboy.drawBitmap(xSquareNose, ySquareNose, SquareNoseRunsRight2, 16, 20, WHITE);
                } else {
                  arduboy.drawBitmap(xSquareNose, ySquareNose, SquareNoseRunsRight1, 16, 20, WHITE);
                }
              }
            } else {
              runCounter = 0;
              if (playLethalMouse == true) {
                if (LethalMouseMoves == true) {
                  arduboy.drawBitmap(xSquareNose, ySquareNose, SquareNoseRunsRight1, 16, 20, BLACK);
                  arduboy.drawBitmap(xSquareNose - 2, ySquareNose - 2, LethalMouseRunsRight, 20, 24, WHITE);
                  if (arduboy.everyXFrames(2)) {
                    arduboy.fillRect(xSquareNose, ySquareNose + 18, 2, 2, WHITE);
                    arduboy.fillRect(xSquareNose + 6, ySquareNose + 18, 2, 2, WHITE);
                  }
                } else {
                  arduboy.drawBitmap(xSquareNose, ySquareNose, SquareNoseRunsRight1, 16, 20, BLACK);
                  arduboy.drawBitmap(xSquareNose - 2, ySquareNose - 2, LethalMouseRight, 20, 24, WHITE);
                }
              } else {
                arduboy.drawBitmap(xSquareNose, ySquareNose, SquareNoseRunsRight1, 16, 20, WHITE);
              }
            }
          }
          if (SquareNoseGoesRight == false) {
            if (arduboy.pressed(LEFT_BUTTON)) {
              if (playLethalMouse == true) {
                arduboy.drawBitmap(xSquareNose, ySquareNose, SquareNoseRunsLeft1, 16, 20, BLACK);
                arduboy.drawBitmap(xSquareNose - 2, ySquareNose - 2, LethalMouseRunsLeft, 20, 24, WHITE);
                if (arduboy.everyXFrames(2)) {
                    arduboy.fillRect(xSquareNose + 8, ySquareNose + 18, 2, 2, WHITE);
                    arduboy.fillRect(xSquareNose + 14, ySquareNose + 18, 2, 2, WHITE);
                  }
              } else {
                runCounter = runCounter + 1;
                if (runCounter > 19) {
                  runCounter = 0;
                }
                if (runCounter < 10) {
                  arduboy.drawBitmap(xSquareNose, ySquareNose, SquareNoseRunsLeft2, 16, 20, WHITE);
                } else {
                  arduboy.drawBitmap(xSquareNose, ySquareNose, SquareNoseRunsLeft1, 16, 20, WHITE);
                }
              }
            } else {
              runCounter = 0;
              if (playLethalMouse == true) {
                arduboy.drawBitmap(xSquareNose, ySquareNose, SquareNoseRunsLeft1, 16, 20, BLACK);
                if (LethalMouseMoves == true) {
                  arduboy.drawBitmap(xSquareNose - 2, ySquareNose - 2, LethalMouseRunsLeft, 20, 24, WHITE);
                  if (arduboy.everyXFrames(2)) {
                    arduboy.fillRect(xSquareNose + 8, ySquareNose + 18, 2, 2, WHITE);
                    arduboy.fillRect(xSquareNose + 14, ySquareNose + 18, 2, 2, WHITE);
                  }
                } else {
                  arduboy.drawBitmap(xSquareNose - 2, ySquareNose - 2, LethalMouseLeft, 20, 24, WHITE);
                }
              } else {
                arduboy.drawBitmap(xSquareNose, ySquareNose, SquareNoseRunsLeft1, 16, 20, WHITE);
              }
            }
          }
        }
      }

// draw the lines at the edges of the screen
      arduboy.drawRect(0, 0, 128, 64, WHITE);
      arduboy.drawRect(1, 1, 126, 62, WHITE);

// the appetence test is over when Square Nose has eaten 32 meaty rings
      if (collectedMeatyRings > 31) {
        gameState = 3;
        collectedMeatyRings = 0;
        if (level == 3) {
          sound.tones(congratulations);
        } else {
          sound.tones(endOfTestSound);
        }
      }

// the other animals which take place in the tests
// level 1: a bird and a bug; level 2: a frog; level 3: a squid and its ball
      switch(level) {
        case 1:
// bird moves
          if (birdGoesRight == true) {
            xBird = xBird + 1;
          } else {
            xBird = xBird - 1;
          }
// prevent bird to go out of the screen
          if (xBird > 107) {
            birdGoesRight = false;
          }
          if (xBird < 2) {
            birdGoesRight = true;
          }

// bug moves, it accelerates randomly, it is faster in loop 1 and 2
          if (bugGoesRight == true) {
            xBug = xBug + random(2 + turbo);
          } else {
            xBug = xBug - random(2 + turbo);
          }
// prevent bug from going out of the screen
          if (xBug > 111) {
            bugGoesRight = false;
          }
          if (xBug < 2) {
            bugGoesRight = true;
          }
// you lose if you touch the bug
          if ((xSquareNose > (xBug -14)) && (xSquareNose < (xBug + 12)) && (ySquareNose > (Y_BUG - 14))) {
            gameState = 4;
            sound.tones(electricitySound);
          }
// you lose if you touch the bird
          if ((xSquareNose > (xBird -14)) && (xSquareNose < (xBird + 16)) && (ySquareNose < (Y_BIRD + 10)) && (ySquareNose > (Y_BIRD - 14))) {
            gameState = 4;
            sound.tones(electricitySound);
          }
//draw the bird
          if (birdGoesRight == true) {
            if (animationCounter < 10) {
              arduboy.drawBitmap(xBird, Y_BIRD, birdRight1, 18, 12, WHITE);
              arduboy.drawBitmap(xBird, Y_BIRD, birdRight1black, 18, 12, BLACK);
            } else {
              arduboy.drawBitmap(xBird, Y_BIRD, birdRight2, 18, 12, WHITE);
              arduboy.drawBitmap(xBird, Y_BIRD, birdRight2black, 18, 12, BLACK);
            }
          } else {
            if (animationCounter < 10) {
              arduboy.drawBitmap(xBird, Y_BIRD, birdLeft1, 18, 12, WHITE);
              arduboy.drawBitmap(xBird, Y_BIRD, birdLeft1black, 18, 12, BLACK);
            } else {
              arduboy.drawBitmap(xBird, Y_BIRD, birdLeft2, 18, 12, WHITE);
              arduboy.drawBitmap(xBird, Y_BIRD, birdLeft2black, 18, 12, BLACK);
            }
          }
// draw the bug
          if (bugGoesRight == true) {
            if (animationCounter < 10) {
              arduboy.drawBitmap(xBug, Y_BUG, bugRight1, 14, 10, WHITE);
              arduboy.drawBitmap(xBug, Y_BUG, bugRightBlack, 14, 10, BLACK);
            } else {
              arduboy.drawBitmap(xBug, Y_BUG, bugRight2, 14, 10, WHITE);
              arduboy.drawBitmap(xBug, Y_BUG, bugRightBlack, 14, 10, BLACK);
            }
          } else {
            if (animationCounter < 10) {
              arduboy.drawBitmap(xBug, Y_BUG, bugLeft1, 14, 10, WHITE);
              arduboy.drawBitmap(xBug, Y_BUG, bugLeftBlack, 14, 10, BLACK);
            } else {
              arduboy.drawBitmap(xBug, Y_BUG, bugLeft2, 14, 10, WHITE);
              arduboy.drawBitmap(xBug, Y_BUG, bugLeftBlack, 14, 10, BLACK);
            }
          }
          break;

// level 2: appentence test with a frog
        case 2:
// frog horizontal moves
          if (frogIsJumping == true) {
            if(frogGoesRight == true) {
              xFrog = xFrog + 2;
            } else {
              xFrog = xFrog - 2;
            }
          }
// frog direction changes when colide a wall
          if (xFrog < 2) {
            frogGoesRight = true;
          }
          if (xFrog > 106) {
            frogGoesRight = false;
          }
// frog jump
      if ((yFrog == 42) && (frogIsJumping == true)) {
        frogJumpSpeed = -4;
        sound.tones(frogJumpBip);
      }

      if (frogIsJumping == true) {
        yFrog = yFrog + frogJumpSpeed;
        frogJumpCounter = frogJumpCounter + 1;
        if ((frogJumpCounter % 4) == 0) {
          frogJumpSpeed = frogJumpSpeed + 1;
        }
      }

// stop falling if frog touches the ground
      if (yFrog > 41) {
        yFrog = 42;
        frogIsJumping = false;
        frogJumpCounter = 0;
        frogJumpSpeed = 0;
      }
// you lose if you touch the frog
          if ((xSquareNose > (xFrog -14)) && (xSquareNose < (xFrog + 18)) && (ySquareNose < (yFrog + 18)) && (ySquareNose > (yFrog - 14))) {
            gameState = 4;
            sound.tones(electricitySound);
          }
// draw the frog
// when it is on the ground
          if (yFrog == 42) {
            arduboy.drawBitmap(xFrog, yFrog, frog1, 20, 20, WHITE);
            arduboy.drawBitmap(xFrog, yFrog, frog1black, 20, 20, BLACK);
          } else {
// wehn it is jumping
            arduboy.drawBitmap(xFrog, yFrog, frog2, 20, 24, WHITE);
            arduboy.drawBitmap(xFrog, yFrog, frog2black, 20, 24, BLACK);
          }
          break;

// level 3: appetence test with a squid and its ball (from the game "Squiddy" by Aphrodite)
        case 3:
// you lose if you touch the squid or its ball
          if ((xSquareNose > (xSquid -12)) && (xSquareNose < (xSquid + 12)) && (ySquareNose < (ySquid + 12)) && (ySquareNose > (ySquid - 12))) {
            gameState = 4;
            sound.tones(electricitySound);
          }
           if ((xSquareNose > (xSquidBall -12)) && (xSquareNose < (xSquidBall + 12)) && (ySquareNose < (ySquidBall + 12)) && (ySquareNose > (ySquidBall - 12))) {
            gameState = 4;
            sound.tones(electricitySound);
          }
// ball moves (and squid is still)
          if (squidSpins == false) {
            angle = angle - 1 - turbo; // moves faster when you loop the game
            if (angle < 0) {
              angle = 359;
            }
            xSquidBall = xSquid + cos(angle * PI / 180) * 44;
            ySquidBall = ySquid + sin(angle * PI / 180) * 44;
          }
// squid moves (and ball is still)
          if (squidSpins == true) {
            angle = angle - 1 - turbo; // moves faster when you loop the game
            if (angle < 0) {
              angle = 359;
            }
            xSquid = xSquidBall + cos(angle * PI / 180) * 44;
            ySquid = ySquidBall + sin(angle * PI / 180) * 44;
          }
// inverts rotation center
          if ((squidSpins == true) && ((xSquid < 1) || (xSquid > 111) || (ySquid < 1) || (ySquid > 47))) {
            squidSpins = false;
            angle = angle + 180;
            if (xSquid < 1) {
              sound.tones(squidBip);
              xSquid = 2;
            }
            if (xSquid > 111) {
              sound.tones(squidBip);
              xSquid = 110;
            }
            if (ySquid < 1) {
              sound.tones(squidBip);
              ySquid = 2;
            }
            if (ySquid > 47) {
              sound.tones(squidBip);
              ySquid = 46;
            }
          } else {
            if ((squidSpins == false) && ((xSquidBall < 1) || (xSquidBall > 111) || (ySquidBall < 1) || (ySquidBall > 47))) {
              squidSpins = true;
              angle = angle + 180;
              if (xSquidBall < 1) {
                sound.tones(squidBip);
                xSquidBall = 2;
              }
              if (xSquidBall > 111) {
                sound.tones(squidBip);
                xSquidBall = 110;
              }
              if (ySquidBall < 1) {
                sound.tones(squidBip);
                ySquidBall = 2;
              }
              if (ySquidBall > 47) {
                sound.tones(squidBip);
                ySquidBall = 46;
              }
            }
          }
// angle doesn't go too far
          if (angle > 800) {
            angle = angle - 360;
          }
// draw the squid
          arduboy.drawBitmap(xSquid, ySquid, squid, 16, 16, WHITE);
          arduboy.drawBitmap(xSquid, ySquid, squidBlack, 16, 16, BLACK);
// draw the squid ball
          if (playLethalMouse == true) {
            arduboy.drawBitmap(xSquidBall, ySquidBall, ball1, 16, 16, WHITE);
          } else {
            arduboy.drawBitmap(xSquidBall, ySquidBall, squidBall, 16, 16, WHITE);
            arduboy.drawBitmap(xSquidBall, ySquidBall, squidBallBlack, 16, 16, BLACK);
          }
          break;
      }
      break;  

// TIME (show your total game time after ending a level)
    case 3:
// show the level you just passed through
      arduboy.drawBitmap(6, 6, TEST, 76, 16, WHITE);
      if (arduboy.everyXFrames(2)) { 
        drawNumber(level, 106,6);
      }
// show your time (minutes, seconds and deciseconds) for the last ended levels
      drawNumber(minutes, 6, 42);
      arduboy.drawBitmap(26, 42, smallM, 16, 16, WHITE);
      drawNumber(seconds / 10, 46, 42);
      drawNumber(seconds % 10, 66, 42);
      arduboy.drawBitmap(86, 42, smallS, 16, 16, WHITE);
      drawNumber(timeCounter / 6, 106, 42);

// go to True Pasta screen (level intro screen)
      if (arduboy.justReleased(A_BUTTON)) {
        resetValues();
// go to the congratulation screen if you finish the game (third level)
        if (level == 3) {
          gameState = 5;
        } else {
// you go to next level if you finish the first or second level
        gameState = 1;
        }
        if (level == 1) {
          level = 2;
        } else {
          if (level == 2) {
            level = 3;
          } else {
            level = 1;
          }
        }
      }
      break;

// "GAME OVER", electricity for Square Nose and explosion for Lethal Mouse
    case 4:
// "everyXFrames" is used to make false grey pixels (they blink quickly)
      if (arduboy.everyXFrames(2)) {
// draw "GAME OVER"
// the test fails if Square Nose is more attracted by the other animals than by the meaty rings
        arduboy.drawBitmap(26, 14, GAME, 76, 16, WHITE);
        arduboy.drawBitmap(26, 34, OVER, 76, 16, WHITE);
      }

// death animation for Lethal Mouse
      if (playLethalMouse == true) {
        arduboy.drawBitmap(xSquareNose, ySquareNose, electrifiedSquareNose, 16, 20, BLACK);
        arduboy.drawBitmap(xSquareNose, ySquareNose - 2, deadLethalMouse, 16, 24, WHITE);
// explosion animation
        arduboy.fillCircle(xSquareNose + random(17), ySquareNose + random(-2, 23), random(4, 13), WHITE);
      } else {
// electricity animation for Square Nose ("random" is used to shake the sprite)
        arduboy.drawBitmap(xSquareNose + random(-2, 3), ySquareNose + random(-2, 3), electrifiedSquareNose, 16, 20, WHITE);
      }

// go back to title screen
      if (arduboy.justReleased(A_BUTTON)) {
        gameState = 0;
        level = 1;
// automaticaly go back to normal mode if you lose
        turbo = 0;
      }
      break;

// "YOUR'RE A TRUE PLAYER" congratulation screen
    case 5:
      arduboy.drawBitmap(0, 0, truePlayer, 128, 64, WHITE);
      if (arduboy.everyXFrames(2)) {
        drawNumber(turbo, 26, 4);
      }
// go back to the title screen when you press the A button
      if (arduboy.justReleased(A_BUTTON)) {
        gameState = 0;
        turbo = turbo + 1;
        if (turbo > 2) {
          turbo = 0;
        }
      }
      break;
  }
  arduboy.display();
}

// reset the values between the levels
void resetValues() {
  SquareNoseGoesRight = true;
  birdGoesRight = false;
  bugGoesRight = true;
  SquareNoseIsJumping = false;
  xSquareNose = 22;
  ySquareNose = 42;
  xBird = 22;
  xBug = 74;
  xFrog = 84;
  yFrog = 42;
  xSquid = 60;
  ySquid = 46;
  xSquidBall = 60;
  ySquidBall = 2;
  frogGoesRight = true;
  frogJumpSpeed = 0;
  frogJumpCounter = 0;
  frogIsJumping = false;
  jumpSpeed = 0;
  jumpCounter = 0;
  ballCounter = 0;
  runCounter = 0;
  xMeatyRing = 94;
  yMeatyRing = 14;
  collectedMeatyRings = 0;
  animationCounter = 0;
  timeCounter = 0;
  
//level times are added to show total game time after level 2 and 3
/*
  seconds = 0;
  minutes = 0;
  angle = 0;
*/

  squidSpins = false;
  LethalMouseMoves = false;
}

// there is no "setTextSize" with tinyfont, so I made this function to draw 16x16 pixels numbers on the screen
void drawNumber(int a, int b, int c) {
  switch(a) {
          case 0:
            arduboy.drawBitmap(b, c, zero, 16, 16, WHITE);
            break;
          case 1:
            arduboy.drawBitmap(b, c, one, 16, 16, WHITE);
            break;
          case 2:
            arduboy.drawBitmap(b, c, two, 16, 16, WHITE);
            break;
          case 3:
            arduboy.drawBitmap(b, c, three, 16, 16, WHITE);
            break;
          case 4:
            arduboy.drawBitmap(b, c, four, 16, 16, WHITE);
            break;
          case 5:
            arduboy.drawBitmap(b, c, five, 16, 16, WHITE);
            break;
          case 6:
            arduboy.drawBitmap(b, c, six, 16, 16, WHITE);
            break;
          case 7:
            arduboy.drawBitmap(b, c, seven, 16, 16, WHITE);
            break;
          case 8:
            arduboy.drawBitmap(b, c, eight, 16, 16, WHITE);
            break;
          case 9:
            arduboy.drawBitmap(b, c, nine, 16, 16, WHITE);
            break;
        }
}

void SquareNoseSpin() {
// ballCounter is incremented if Square Nose goes right and decremented if it goes left
  if (SquareNoseGoesRight == true) {
          ballCounter = ballCounter + 1;
        } else {
          ballCounter = ballCounter - 1;
        }
        
        if (ballCounter > 19) {
          ballCounter = 0;
        }
        if (ballCounter < 0) {
          ballCounter = 19;
        }
// draw one of the four sprites of Square Nose in ball shape
        if (ballCounter < 5) {
          arduboy.drawBitmap(xSquareNose, ySquareNose, ball1, 16, 16, WHITE);
        }
        if ((ballCounter > 4) && (ballCounter < 10)) {
          arduboy.drawBitmap(xSquareNose, ySquareNose, ball2, 16, 16, WHITE);
        }
        if ((ballCounter > 9) && (ballCounter < 15)) {
          arduboy.drawBitmap(xSquareNose, ySquareNose, ball3, 16, 16, WHITE);
        }
        if (ballCounter > 14) {
          arduboy.drawBitmap(xSquareNose, ySquareNose, ball4, 16, 16, WHITE);
        }
}
