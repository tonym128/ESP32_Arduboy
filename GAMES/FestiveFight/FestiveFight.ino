//Festive Fight
//	Version 1.1, December 20th, 2017
//	By Jonathan Holmes (crait)
//
//	Website: http://www.crait.net/
//	Twitter: @crait
//
//	Holiday mascots from throughout the calendar must fight in
//	order to compete for the affection of the children throughout
//	the world for some weird reason.
//
//	This game includes single and multiplayer support. To fight,
//	you have two options: Attack and Retreat. Each match, you have
//	5 hearts. Getting punched causes you to lose 1 heart. Lose
//	all your hearts, and you'll lose the match, so make sure you
//	retreat often to dodge oncoming attacks. Different characters
//	have different stats. Some are harder to use than others, so
//	try them all out!
//
//	This game was created for the second Arduboy Game Jam.
//
//	Fighters:			ATTACK	DEFENCE
//		Santa						9			3
//		Easter Bunny		5			7
//		Cupid						10		2
//		Turkey					7			5
//		GroundHog				8			4
//		Uncle Sam				6			6
//
//	1P Buttons:
//		Down - Attack
//		Left - Retreat
//	2P Buttons:
//		A - Attack
//		B - Retreat
//
//	1.1 - December 20, 2017
//		Added a 'Tie' screen
//		Fixed an issue where P1 was given frame advantage
//
//	1.0 - December 19, 2017
//		Initial release

#include <Arduboy2.h>
Arduboy2 arduboy;
#include <ESPboyPlaytune.h>
ESPboyPlaytune tunes(arduboy.audio.enabled);

#define NORMAL 0
#define FLIP 1

#define STANDING 0
#define PUNCHING 1
#define JUMPING 2
#define HURT 3

void drawBitmap(int16_t x, int16_t y, const uint8_t *bitmap, uint8_t w, uint8_t h,
	uint8_t color, uint8_t flip) {
	if (x+w < 0 || x > WIDTH-1 || y+h < 0 || y > HEIGHT-1)
		return;
	int yOffset = abs(y) % 8;
	int sRow = y / 8;
	if (y < 0) {
		sRow--;
		yOffset = 8 - yOffset;
	}
	int rows = h/8;
	if (h%8!=0) rows++;
	for (int a = 0; a < rows; a++) {
		int bRow = sRow + a;
		if (bRow > (HEIGHT/8)-1) break;
		if (bRow > -2) {
		for (int f = 0; f<w; f++) {
			int iCol;
			if(flip) {
				iCol = (w - 1) - f;
			} else {
				iCol = f;
			}
			if (iCol + x > (WIDTH-1)) break;
			if (iCol + x >= 0) {
			if (bRow >= 0) {
				if (color == WHITE)
				arduboy.sBuffer[(bRow*WIDTH) + x + f] |= pgm_read_byte(bitmap+(a*w)+iCol) << yOffset;
				else if (color == BLACK)
				arduboy.sBuffer[(bRow*WIDTH) + x + f] &= ~(pgm_read_byte(bitmap+(a*w)+iCol) << yOffset);
				else
				arduboy.sBuffer[(bRow*WIDTH) + x + f] ^= pgm_read_byte(bitmap+(a*w)+iCol) << yOffset;
			}
			if (yOffset && bRow<(HEIGHT/8)-1 && bRow > -2) {
				if (color == WHITE)
				arduboy.sBuffer[((bRow+1)*WIDTH) + x + f] |= pgm_read_byte(bitmap+(a*w)+iCol) >> (8-yOffset);
				else if (color == BLACK)
				arduboy.sBuffer[((bRow+1)*WIDTH) + x + f] &= ~(pgm_read_byte(bitmap+(a*w)+iCol) >> (8-yOffset));
				else
				arduboy.sBuffer[((bRow+1)*WIDTH) + x + f] ^= pgm_read_byte(bitmap+(a*w)+iCol) >> (8-yOffset);
			}
			}
		}
		}
	}
}

byte gamestate = 0;
byte p1 = 0;
byte p1s = 0;
byte p2s = 0;
byte p2 = 0;
byte h1 = 0;
byte h2 = 0;
byte p1x = 0;
byte p2x = 0;
byte p1y = 0;
byte p2y = 0;
byte p1c = 0;
byte p2c = 0;
byte p1v = 0;
byte p2v = 0;
byte players = 1;
byte playerselect = 1;
byte point = 0;
byte pointer = 0;
byte gameovertimer = 70;
byte intro = 0;
boolean casting = false;

byte snow[10][2] = {
	{random(128), random(34)},
	{random(128), random(34)},
	{random(128), random(34)},
	{random(128), random(34)},
	{random(128), random(34)},
	{random(128), random(34)},
	{random(128), random(34)},
	{random(128), random(34)},
	{random(128), random(34)},
	{random(128), random(34)}
};

const unsigned char winner[]  = {
	0x7c, 0xfc, 0xf8, 0xc0, 0x80, 0xe0, 0xe0, 0xe0, 0x00, 0xe0, 0xf8, 0xfc,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 0x73
};

const unsigned char logo[]  = {
	0x00, 0x00, 0x00, 0x00, 0x00, 0x80, 0x80, 0x80, 0xc0, 0xc0, 0xc0, 0xc0,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 0x00
};
const unsigned char select[]  = {
	0xfe, 0xff, 0xff, 0xff, 0xff, 0xff, 0xff, 0xff, 0xff, 0xff, 0xff, 0xff,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 0x7f
};
const unsigned char op[]  = {
	0x00, 0x00, 0x00, 0x30, 0x38, 0xfc, 0xfc, 0x00, 0x00, 0x00, 0x00, 0xfc,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 0x00
};
const unsigned char opw[]  = {
	0x00, 0x00, 0x78, 0x4c, 0xc6, 0x02, 0x02, 0xfe, 0x00, 0x00, 0xfe, 0x02,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 0x00
};
const unsigned char tp[]  = {
	0x00, 0x00, 0x00, 0x18, 0x1c, 0x0c, 0x8c, 0x8c, 0xf8, 0x70, 0x00, 0x00,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 0x00
};
const unsigned char tpw[]  = {
	0x00, 0x00, 0x3c, 0xa6, 0xa2, 0xf2, 0x52, 0x72, 0x06, 0x8c, 0xf8, 0xfe,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 0x00
};
const unsigned char s[]  = {
	0x00, 0x00, 0x00, 0x00, 0x00, 0xe0, 0xf0, 0xf0, 0xf8, 0xfc, 0xfc, 0x00,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 0x00
};
const unsigned char sw[]  = {
	0x00, 0x00, 0x00, 0x00, 0xf0, 0x18, 0x08, 0x0c, 0x06, 0x02, 0x02, 0xfe,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 0x00
};
const unsigned char so[]  = {
	0x00, 0x00, 0x00, 0x00, 0x00, 0xe0, 0xf0, 0xf0, 0xf8, 0xfc, 0xfc, 0x00,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 0x00
};
const unsigned char sow[]  = {
	0x00, 0x00, 0x00, 0x00, 0xf0, 0x18, 0x08, 0x0c, 0x06, 0x02, 0x02, 0xfe,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 0x00
};
const unsigned char me[]  = {
	0x45, 0x8a, 0x15, 0xaa, 0x15, 0xaa, 0xd5, 0x6a, 0x34, 0x28, 0x21, 0x32,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 0xf8
};

#define SANTA 0
#define EASTERBUNNY 1
#define CUPID 2
#define TURKEY 3
#define GROUNDHOG 4
#define UNCLESAM 5

const byte stats[6][2] {
	{ 9, 3 },
	{ 5, 7 },
	{ 10, 2 },
	{ 7, 5 },
	{ 8, 4 },
	{ 6, 6 }
};

const byte forward = 5;
const byte back = 12;
const byte yoffset = 24;
const byte blow = 10;

//Standing: 30, 38
const unsigned char standing[6][2][150]  = {
	{
		//SANTA
		{
			//BLACK
			0x00, 0x00, 0x00, 0x00, 0x00, 0x00, 0x00, 0x00, 0xc0, 0x20, 0x10, 0xc8,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 0x00,
		}, {
			//WHITE
			0x00, 0x00, 0x00, 0x00, 0x00, 0x00, 0x80, 0xe0, 0x30, 0xd8, 0xec, 0x36,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 0x00,
		}
	},
	{
		//EASTER BUNNY
		{
			//BLACK
			0x00, 0x00, 0x00, 0x00, 0x00, 0x00, 0x00, 0x00, 0x00, 0x00, 0xf0, 0x0c,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 0x00,
		},
		{
			//WHITE
			0x00, 0x00, 0x00, 0x00, 0x00, 0x00, 0x00, 0x00, 0x00, 0xf8, 0x0e, 0xf2,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 0x00,
		}
	},
	{
		//CUPID
		{
			//BLACK
			0x00, 0x00, 0x00, 0x00, 0x00, 0x00, 0x00, 0x00, 0x00, 0x00, 0x00, 0x00,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 0x00,
		},
		{
			//WHITE
			0x00, 0x00, 0x00, 0x00, 0x00, 0x00, 0x00, 0x00, 0x00, 0x00, 0x00, 0x00,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 0x00,
		}
	},
	{
		//TURKEY
		{
			0x00, 0x00, 0x00, 0x00, 0x00, 0x00, 0x00, 0x00, 0x00, 0x00, 0x00, 0x00,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 0x00,
		},
		{
			0x00, 0x00, 0x00, 0x00, 0x00, 0x00, 0x00, 0x00, 0x00, 0x00, 0x00, 0x00,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 0x00,
		}
	},
	{
		//GROUNDHOG
		{
			0x00, 0x00, 0x00, 0x00, 0x00, 0xf0, 0x08, 0x68, 0x48, 0x10, 0x08, 0xc8,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 0x00,
		},
		{
			0x00, 0x00, 0x00, 0x00, 0xf8, 0x0c, 0xf4, 0x94, 0xb4, 0xec, 0xf4, 0x34,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 0x00,
		}
	},
	{
		//UNCLESAM
		{
			0x00, 0x00, 0x00, 0x00, 0x00, 0x00, 0x00, 0x00, 0x00, 0x00, 0x00, 0xfe,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 0x00,
		},
		{
			0x00, 0x00, 0x00, 0x00, 0x00, 0x00, 0x00, 0x00, 0x00, 0x00, 0xff, 0x01,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 0x00,
		}
	}
};

const unsigned char portrait[6][112]  = {
	{
		0xff, 0xff, 0xff, 0xff, 0x3f, 0xdf, 0xef, 0xf7, 0xfb, 0xfd, 0x7d, 0x7d,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 0x0f,
	},
	{
		0x17, 0x17, 0x17, 0x37, 0x37, 0x7b, 0x3b, 0x9b, 0xc9, 0xe9, 0xb1, 0xb1,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 0x0f,
	},
	{
		0xff, 0x7f, 0xbf, 0x7f, 0x9f, 0xdf, 0xef, 0xf3, 0xfb, 0xfd, 0xfb, 0xfb,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 0x0f,

	},
	{
		0xff, 0xff, 0xff, 0xff, 0xff, 0xff, 0x7f, 0xbf, 0xdf, 0xef, 0x73, 0x33,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 0x0f
	},
	{
		0x7f, 0x9f, 0xef, 0x6f, 0xef, 0xdf, 0xbf, 0xdf, 0xdf, 0xdf, 0xef, 0xef,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 0x0f,
	},
	{
		0xff, 0xff, 0xff, 0xff, 0xfc, 0x03, 0xa7, 0x56, 0x20, 0x50, 0x20, 0x50,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 0x0f,
	}
};

//Punching: 38, 39
const unsigned char punching[6][2][190]  = {
	{
		//SANTA
		{
			0x00, 0x00, 0x00, 0x00, 0x00, 0x00, 0x00, 0x00, 0x00, 0x80, 0x40, 0x20,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 0x00,
		}, {
			0x00, 0x00, 0x00, 0x00, 0x00, 0x00, 0x00, 0x00, 0xc0, 0x60, 0xb0, 0xd8,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 0x00,
		}
	},
	{
		//EASTER BUNNY
		{
			0x00, 0x00, 0x00, 0x00, 0x00, 0x00, 0x00, 0x00, 0x00, 0x00, 0x80, 0x80,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 0x00,
		},
		{
			0x00, 0x00, 0x00, 0x00, 0x00, 0x00, 0x00, 0x00, 0x00, 0xc0, 0x40, 0x40,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 0x00,
		}
	},
	{
		//CUPID
		{
			0x00, 0x00, 0x00, 0x00, 0x00, 0x00, 0x00, 0x00, 0x00, 0x00, 0x00, 0x00,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 0x00,
		},
		{
			0x00, 0x00, 0x00, 0x00, 0x00, 0x00, 0x00, 0x00, 0x00, 0x00, 0x00, 0x00,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 0x00,
		}
	},
	{
		//TURKEY
		{
			0x00, 0x00, 0x00, 0x00, 0x00, 0x00, 0x00, 0x00, 0x00, 0x00, 0x00, 0x00,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 0x00,
		},
		{
			0x00, 0x00, 0x00, 0x00, 0x00, 0x00, 0x00, 0x00, 0x00, 0x00, 0x00, 0x00,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 0x00,
		}
	},
	{
		//GROUNDHOG
		{
			//Need To Fix This
			0x00, 0x00, 0x00, 0x00, 0x00, 0xf0, 0x08, 0x68, 0x48, 0x10, 0x08, 0xc8,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 0x00,
		},
		{
			0x00, 0x00, 0x00, 0x00, 0x00, 0x00, 0xf8, 0x0c, 0xf4, 0x94, 0xb4, 0xec,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 0x00,
		}
	},
	{
		//UNCLESAM
		{
			0x00, 0x00, 0x00, 0x00, 0x00, 0x00, 0x00, 0x00, 0x00, 0x00, 0x00, 0x00,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 0x00,
		},
		{
			0x00, 0x00, 0x00, 0x00, 0x00, 0x00, 0x00, 0x00, 0x00, 0x00, 0x00, 0x00,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 0x00,
		}
	}
};

//Hurt: 31, 40
const unsigned char hurt[6][2][155]  = {
	//SANTA
	{
		{
			0x00, 0x00, 0x00, 0x00, 0xc0, 0x30, 0x08, 0x04, 0x84, 0x44, 0xa2, 0xa2,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 0x00,
		}, {
			0x00, 0x00, 0x00, 0xe0, 0x38, 0xcc, 0xf6, 0xfa, 0x7a, 0xbb, 0x5d, 0x5d,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 0x00,
		}
	},
	//EASTERBUNNY
	{
		{
			0x00, 0x00, 0x00, 0x00, 0x80, 0x40, 0x40, 0x80, 0xc0, 0xc0, 0xc0, 0xc0,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 0x00,
		},
		{
			0x00, 0x00, 0x00, 0xc0, 0x60, 0xa0, 0xa0, 0x60, 0x20, 0x20, 0x20, 0x20,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 0x00,
		}
	},
	//CUPID
	{
		{
			0x00, 0x00, 0x00, 0x00, 0x00, 0x00, 0x00, 0x00, 0x00, 0x00, 0x00, 0x00,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 0x00,
		},
		{
			0x00, 0x00, 0x00, 0x00, 0x00, 0x00, 0x00, 0x00, 0x00, 0x00, 0x00, 0x00,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 0x00,
		}
	},
	//TURKEY
	{
		{
			0x00, 0x00, 0x00, 0x00, 0x00, 0x00, 0x80, 0x80, 0x00, 0x80, 0x80, 0x80,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 0x00,
		},
		{
			0x00, 0x00, 0x00, 0x00, 0x80, 0xc0, 0x40, 0x40, 0xc0, 0x40, 0x40, 0x40,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 0x00,
		}
	},
	//GROUNDHOG
	{
		{
			0x00, 0x00, 0x00, 0x00, 0x00, 0xf0, 0x08, 0x68, 0x48, 0x10, 0x08, 0x28,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 0x00,
		},
		{
			0x00, 0x00, 0x00, 0x00, 0xf8, 0x0c, 0xf4, 0x94, 0xb4, 0xec, 0xf4, 0xd4,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 0x00,
		}
	},
	//UNCLESAM
	{
		{
			0x00, 0x00, 0x00, 0x00, 0x00, 0x00, 0x00, 0x00, 0x00, 0x00, 0x00, 0x00,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 0x00,
		},
		{
			0x00, 0x00, 0x00, 0x00, 0x00, 0x00, 0x00, 0x00, 0x00, 0x00, 0x00, 0x00,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 0x00,
		}
	},
};

//Jumping: 31, 42
const unsigned char jumping[6][2][186]  = {
	{
		//SANTA
		{
			0x00, 0x00, 0x00, 0x00, 0x00, 0x00, 0x00, 0x00, 0x00, 0x00, 0x00, 0x00,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 0x00,
		}, {
			0x00, 0x00, 0x00, 0x00, 0x00, 0x00, 0x00, 0x00, 0x00, 0x00, 0x80, 0xe0,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 0x00,
		}
	},
	{
		//EASTERBUNNY
		{
			0x00, 0x00, 0x00, 0x00, 0x00, 0x00, 0x00, 0x00, 0x00, 0x00, 0x00, 0x00,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 0x00,
		},
		{
			0x00, 0x00, 0x00, 0x00, 0x00, 0x00, 0x00, 0x00, 0x00, 0x00, 0x00, 0xfc,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 0x00,
		},
	},
	{
		//CUPID
		{
			0x00, 0x00, 0x00, 0x00, 0x00, 0x00, 0x00, 0x00, 0x00, 0x00, 0x00, 0x00,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 0x00,
		},
		{
			0x00, 0x00, 0x00, 0x00, 0x00, 0x00, 0x00, 0x00, 0x00, 0x00, 0x00, 0x00,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 0x00,
		}
	},
	{
		//TURKEY
		{
			0x00, 0x00, 0x00, 0x00, 0x00, 0x00, 0x00, 0x00, 0x00, 0x00, 0x00, 0x00,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 0x00,
		},
		{
			0x00, 0x00, 0x00, 0x00, 0x00, 0x00, 0x00, 0x00, 0x00, 0x00, 0x00, 0x00,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 0x00,
		}
	},
	{
		//GROUNDHOG
		{
			0x00, 0x00, 0x00, 0x00, 0x00, 0x00, 0x00, 0x00, 0x00, 0x00, 0xf0, 0x08,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 0x00,
		},
		{
			0x00, 0x00, 0x00, 0x00, 0x00, 0x00, 0x00, 0x00, 0x00, 0xf8, 0x0c, 0xf4,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 0x00,
		}
	},
	{
		//UNCLESAM
		{
			0x00, 0x00, 0x00, 0x00, 0x00, 0x00, 0x00, 0x00, 0x00, 0x00, 0x00, 0x00,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 0x00,
		}, //BLACK
		{
			0x00, 0x00, 0x00, 0x00, 0x00, 0x00, 0x00, 0x00, 0x00, 0x00, 0x00, 0x00,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 0x00,
		} //WHITE
	},
};

#define NOISE_NEXT 130
#define NOISE_POINT 70
#define NOISE_MISS 300
#define NOISE_HIT 500
#define NOISE_RETREAT 130
#define NOISE_CLICK 400

#define SOUND_SHORT 100
#define SOUND_MED 150
#define SOUND_LONG 200

void sound(int pitch, long duration) {
	if(arduboy.audio.enabled()) {
		tunes.tone(pitch, duration);
	}
}

void continuestate(byte tostate) {
	if(arduboy.justPressed(A_BUTTON)) {
		sound(NOISE_CLICK, SOUND_SHORT);
		gamestate = tostate;
	}
}

void resetvariables() {
	playerselect = 1;
	gameovertimer = 70;
	h1 = 5;
	h2 = 5;
	p1 = 0;
	p2 = 0;
	p1s = 0;
	p2s = 0;
	players = 1;
	intro = 180;
	p1x = 22;
	p2x = 127 - 22;
	p1y = yoffset;
	p2y = yoffset;
	p1c = 0;
	p2c = 0;
	p1v = 0;
	p2v = 0;
}

void inogamesetup() {
	arduboy.begin();
	arduboy.setFrameRate(60);
	arduboy.initRandomSeed();
	arduboy.display();

	tunes.initChannel(PIN_SPEAKER_1);
	#ifndef AB_DEVKIT
		tunes.initChannel(PIN_SPEAKER_2);
	#else
		tunes.initChannel(PIN_SPEAKER_1);
		tunes.toneMutesScore(true);
	#endif

	arduboy.clear();
}

void inogameloop() {
  delay(0);
	if(!(arduboy.nextFrame())) {
		return;
	}

	arduboy.pollButtons();

	arduboy.clear();

	switch(gamestate) {
		case 0: //Credits Screen
			drawBitmap(8, 8, me, 48, 48, WHITE, NORMAL);
			arduboy.setCursor(75, 8);
			arduboy.print(F("Jonathan"));
			arduboy.setCursor(87, 18);
			arduboy.print(F("Holmes"));
			arduboy.setCursor(86, 38);
			arduboy.print(F("@crait"));
			arduboy.setCursor(68, 49);
			arduboy.print(F("crait.net"));
			continuestate(1);
			break;
		case 1: //Title Screen
			resetvariables();
			drawBitmap(24, 3, logo, 80, 40, WHITE, NORMAL);

			if(pointer < 2 && arduboy.justPressed(RIGHT_BUTTON)) {
				pointer += 1;
				sound(NOISE_NEXT, SOUND_SHORT);
			}
			if(pointer > 0 && arduboy.justPressed(LEFT_BUTTON)) {
				pointer -= 1;
				sound(NOISE_NEXT, SOUND_SHORT);
			}

			drawBitmap(10 + 41 * pointer, 46, select, 26, 16, WHITE, NORMAL);

			drawBitmap(13, 47, op, 22, 14, WHITE, NORMAL);
			drawBitmap(53, 47, tp, 22, 14, WHITE, NORMAL);

			drawBitmap(13, 47, opw, 22, 14, BLACK, NORMAL);
			drawBitmap(53, 47, tpw, 22, 14, BLACK, NORMAL);

			if(arduboy.audio.enabled()) {
				drawBitmap(94, 47, sw, 22, 14, BLACK, NORMAL);
				drawBitmap(94, 47, s, 22, 14, WHITE, NORMAL);
			} else {
				drawBitmap(94, 47, sow, 22, 14, BLACK, NORMAL);
				drawBitmap(94, 47, so, 22, 14, WHITE, NORMAL);
			}

			if(arduboy.justPressed(A_BUTTON)) {
				if(pointer == 0) {
					gamestate = 2;
					players = 1;
					pointer = 0;
				}
				if(pointer == 1) {
					gamestate = 2;
					players = 2;
					pointer = 0;
				}
				if(pointer == 2) {
					arduboy.audio.toggle();
					arduboy.audio.saveOnOff();
				}
				sound(NOISE_CLICK, SOUND_SHORT);
			}

			break;
		case 2: //Char Select		
			drawBitmap(96, 2, select, 26, 16, WHITE, NORMAL);
			if(playerselect == 1) {
				drawBitmap(98, 3, opw, 22, 14, BLACK, NORMAL);
				drawBitmap(98, 3, op, 22, 14, WHITE, NORMAL);
			} else {
				drawBitmap(98, 3, tpw, 22, 14, BLACK, NORMAL);
				drawBitmap(98, 3, tp, 22, 14, WHITE, NORMAL);
			}

			if(arduboy.justPressed(LEFT_BUTTON) && pointer > 0) {
				sound(NOISE_NEXT, SOUND_SHORT);
				pointer -= 1;
			}
			if(arduboy.justPressed(RIGHT_BUTTON) && pointer < 5) {
				sound(NOISE_NEXT, SOUND_SHORT);
				pointer += 1;
			}
			if(arduboy.justPressed(UP_BUTTON) && pointer > 2) {
				sound(NOISE_NEXT, SOUND_SHORT);
				pointer -= 3;
			}
			if(arduboy.justPressed(DOWN_BUTTON) && pointer < 3) {
				sound(NOISE_NEXT, SOUND_SHORT);
				pointer += 3;
			}

			point = 0;
			for(byte y = 0; y < 2; y++) {
				for(byte x = 0; x < 3; x++) {
					drawBitmap(2 + x * 30, 2 + y * 32, portrait[point], 28, 28, WHITE, NORMAL);
					if(point == pointer) {
						arduboy.drawRect(x * 30, y * 32, 32, 32, WHITE);
					} else {
						arduboy.drawRect(2 + x * 30, 2 + y * 32, 28, 28, BLACK);
						arduboy.drawRect(2 + x * 30 + 1, 2 + y * 32 + 1, 26, 26, BLACK);
					}
					point++;
				}
			}
			drawBitmap(94, 22, standing[pointer][BLACK], 30, 38, BLACK, NORMAL);
			drawBitmap(94, 22, standing[pointer][WHITE], 30, 38, WHITE, NORMAL);

			if(arduboy.justPressed(B_BUTTON)) {
				gamestate = 1;
				pointer = 0;
				sound(NOISE_RETREAT, SOUND_SHORT);
			}
			if(arduboy.justPressed(A_BUTTON)) {
				sound(NOISE_CLICK, SOUND_SHORT);
				if(players == 1) {
					p1 = pointer;
					p2 = random(0, 6);
					gamestate = 3;
				} else {
					if(playerselect == 1) {
						p1 = pointer;
						pointer = 0;
						playerselect = 2;
					} else {
						p2 = pointer;
						gamestate = 3;
					}
				}
			}
			break;
		case 3: //Game
		arduboy.setCursor(1, 0);
			for(byte x = 0; x < h1; x++) {
				arduboy.print(char(0x03));
			}

			for(byte x = 0; x < h2; x++) {
				arduboy.setCursor(122 - x * 6, 0);
				arduboy.print(char(0x03));
			}

			for(byte flake = 0; flake < 10; flake++) {
				snow[flake][0] -= ((flake < 4) + 2);
				if(snow[flake][0] > 200) {
					snow[flake][0] = random(30) + 129;
					snow[flake][1] = random(40);
				}
				arduboy.drawPixel(snow[flake][0], snow[flake][1], WHITE);
			}

			arduboy.drawLine(0, 42, 127, 42, WHITE);
		
			if(intro > 0) {
				switch(intro) {
					case 180:
						sound(NOISE_MISS, SOUND_SHORT);
						break;
					case 120:
						sound(NOISE_MISS, SOUND_SHORT);
						break;
					case 60:
						sound(NOISE_MISS, SOUND_SHORT);
						break;
					case 1:
						sound(NOISE_HIT, SOUND_LONG);
						break;
				}
				arduboy.setCursor(60, 25);
				if(intro > 120) {
					arduboy.print("3");
				} else if(intro > 60) {
					arduboy.print("2");
				} else {
					arduboy.print("1");
				}
				intro--;
			} else {
				if(arduboy.justPressed(DOWN_BUTTON) && p1s == STANDING && p1c == 0) {
					p1s = PUNCHING;
					p1c = stats[p1][0] + forward;
					sound(NOISE_MISS, SOUND_MED);
				}
				if(arduboy.justPressed(LEFT_BUTTON) && p1s == STANDING && p1c == 0) {
					p1s = JUMPING;
					p1c = stats[p1][1] + back;
					sound(NOISE_RETREAT, SOUND_MED);
				}
				if(((players == 2 && arduboy.justPressed(A_BUTTON)) || (players == 1 && random(25) == 1)) && p2s == STANDING && p2c == 0) {
					p2s = PUNCHING;
					p2c = stats[p2][0] + forward;
					sound(NOISE_MISS, SOUND_MED);
				}
				if(((players == 2 && arduboy.justPressed(B_BUTTON)) || (players == 1 && random(20) == 1)) && p2s == STANDING && p2c == 0) {
					p2s = JUMPING;
					p2c = stats[p2][1] + back;
					sound(NOISE_RETREAT, SOUND_MED);
				}
				
				if(p1s == JUMPING) {
					p1x -= 2;
					p1c -= 1;
					if((stats[p1][1] + back) - p1c < 5) {
						p1y -= 4;
					} else if(p1c < 5) {
						p1y += 4;
					}
				}
				
				if(p2s == JUMPING) {
					p2x += 2;
					p2c -= 1;
					if((stats[p2][1] + back) - p2c < 5) {
						p2y -= 4;
					} else if(p2c < 5) {
						p2y += 4;
					}
				}
				
				if(p1s == HURT) {
					p1x -= 1;
					p1c -= 1;
					if((stats[p1][1] + back) - p1c < 5) {
						p1y -= 4;
					}
					if(p1c < 5) {
						p1v = 0;
						p1y += 4;
					}
				}
				
				if(p2s == HURT) {
					p2x += 1;
					p2c -= 1;
					if((stats[p2][1] + back) - p2c < 5) {
						p2y -= 4;
					}
					if(p2c < 5) {
						p2v = 0;
						p2y += 4;
					}
				}

				if(p1x > 200) {
					p1x = 0;
				}
				if(p2x < 38) {
					p2x = 38;
				}

				if(p1y < 7) {
					p1y = 4;
				}
				if(p2y < 7) {
					p2y = 4;
				}
				
				if(p1s == PUNCHING) {
					p1x += 2;
				}
				
				if(p2s == PUNCHING) {
					p2x -= 2;
				}

				if(p1c > 0) {
					p1c--;
				}
				
				if(p2c > 0) {
					p2c--;
				}

				if(p1c <= 0) {
					if(p1s == PUNCHING) {
						p1s = STANDING;
						p1c = stats[p1][0];
					} else {
						p1v = 0;
						p1c = 0;
						p1s = STANDING;
						p1y = yoffset;
						if(h1 == 0) {
							gamestate = 4;
						}
					}
				}

				if(p2c <= 0) {
					if(p2s == PUNCHING) {
						p2s = STANDING;
						p2c = stats[p2][0];
					} else {
						p2v = 0;
						p2c = 0;
						p2s = STANDING;
						p2y = yoffset;
						if(h2 == 0) {
							gamestate = 4;
						}
					}
				}			
				
				byte p1h = false;
				byte p2h = false;

				if(p1x + 28 > p2x - 36) {
					if(p1s == PUNCHING && p2v == 0) {
						p2h = true;
					}
					if(p2s == PUNCHING && p1v == 0) {
						p1h = true;
					}
				}

				if(p1h) {
					sound(NOISE_HIT, SOUND_LONG);
					p1v = 1;
					h1 -= 1;
					p1s = HURT;
					p1c = stats[p1][1] + back;
				
					if(!p2h) {
						p2s = JUMPING;
						p2c = stats[p2][1] + back + blow;
					}
				}
				if(p2h) {
					sound(NOISE_HIT, SOUND_LONG);
					p2v = 1;
					h2 -= 1;
					p2s = HURT;
					p2c = stats[p2][1] + back;

					if(!p1h) {
						p1s = JUMPING;
						p1c = stats[p1][1] + back + blow;
					}
				}


				if(p1x >= 127 - 38) {
					p1x = 127 - 38;
				}
				if(p2x > 127) {
					p2x = 127;
				}
			}

			if(p1s == STANDING) {
				drawBitmap(p1x, p1y, standing[p1][BLACK], 30, 38, BLACK, NORMAL);
				drawBitmap(p1x, p1y, standing[p1][WHITE], 30, 38, WHITE, NORMAL);
			}
			if(p1s == PUNCHING) {
				drawBitmap(p1x, p1y, punching[p1][BLACK], 38, 39, BLACK, NORMAL);
				drawBitmap(p1x, p1y, punching[p1][WHITE], 38, 39, WHITE, NORMAL);
			}
			if(p1s == JUMPING) {
				drawBitmap(p1x, p1y, jumping[p1][BLACK], 31, 42, BLACK, NORMAL);
				drawBitmap(p1x, p1y, jumping[p1][WHITE], 31, 42, WHITE, NORMAL);
			}
			if(p1s == HURT) {
				drawBitmap(p1x, p1y, hurt[p1][BLACK], 31, 40, BLACK, NORMAL);
				drawBitmap(p1x, p1y, hurt[p1][WHITE], 31, 40, WHITE, NORMAL);
			}

			if(p2s == STANDING) {
				drawBitmap(p2x - 30, p2y, standing[p2][BLACK], 30, 38, BLACK, FLIP);
				drawBitmap(p2x - 30, p2y, standing[p2][WHITE], 30, 38, WHITE, FLIP);
			}
			if(p2s == PUNCHING) {
				drawBitmap(p2x - 38, p2y, punching[p2][BLACK], 38, 39, BLACK, FLIP);
				drawBitmap(p2x - 38, p2y, punching[p2][WHITE], 38, 39, WHITE, FLIP);
			}
			if(p2s == JUMPING) {
				drawBitmap(p2x - 31, p2y, jumping[p2][BLACK], 31, 42, BLACK, FLIP);
				drawBitmap(p2x - 31, p2y, jumping[p2][WHITE], 31, 42, WHITE, FLIP);
			}
			if(p2s == HURT) {
				drawBitmap(p2x - 31, p2y, hurt[p2][BLACK], 31, 40, BLACK, FLIP);
				drawBitmap(p2x - 31, p2y, hurt[p2][WHITE], 31, 40, WHITE, FLIP);
			}
			
			break;
		case 4: //Game Over
			if(h1 > h2) {
				drawBitmap(33, 14, winner, 62, 16, WHITE, NORMAL);
				drawBitmap(51, 29, select, 26, 16, WHITE, NORMAL);
					
				drawBitmap(53, 30, opw, 22, 14, BLACK, NORMAL);
				drawBitmap(53, 30, op, 22, 14, WHITE, NORMAL);
			} else if(h1 < h2) {
				drawBitmap(33, 14, winner, 62, 16, WHITE, NORMAL);
				drawBitmap(51, 29, select, 26, 16, WHITE, NORMAL);
				
				drawBitmap(53, 30, tpw, 22, 14, BLACK, NORMAL);
				drawBitmap(53, 30, tp, 22, 14, WHITE, NORMAL);
			} else {
				arduboy.setCursor(52, 25);
				arduboy.print(F("TIE!"));
			}

			if(gameovertimer > 0) {
				gameovertimer--;
			} else {
				continuestate(0);
				pointer = 0;
			}
			break;
	}

	if(casting) {
		Serial.write(arduboy.getBuffer(), 128 * 64 / 8);
	}
	arduboy.display();
}
void gameLogicLoop(void *)
{
  for (;;) {
    inogameloop(); 
    // ArduinoOTA.handle();
  }
}

void setup() {
  inogamesetup();
  xTaskCreatePinnedToCore(gameLogicLoop, "g", 4096, nullptr, 0, nullptr, 0);
}

void loop() {
	delay(60000);
}
