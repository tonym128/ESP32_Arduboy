#include <Arduboy2.h>
Arduboy2 arduboy;
BeepPin1 beep; 

byte stair = 0;
byte stair_tower = 0;
byte Main = 0;
byte main_y = 0;
byte flag = 0;
byte speedBlock = 0;
int score = 0;
int allscore = 0;
byte swingState = 0;
byte lives = 3;
byte chek = 0;
byte chose_build = 0;
byte chose_build_state = 1;
byte gamestate = 0;
byte swingy = 0;
byte left = 58;
byte right = 58;
byte frame_tower = 17;
byte combo_wight = 0;
byte Supercombo = 0;
byte marks = 1;
byte massege = 0;
byte Lpanel_mark = 0;
byte Lpanel_enable = 1;
byte Rpanel_enable = 0;
byte Rpanel_markX = 0;
byte Rpanel_markY = 0;

int house_one = 0;
int house_two = 0;
int house_three = 0;
int house_four = 0;
int house_five = 0;
int house_six = 0;
int house_seven = 0;
int house_eight = 0;
int rect = 7;

byte BuldingsOnMap1 = 0;
byte BuldingsOnMap2 = 0;
byte BuldingsOnMap3 = 0;
byte BuldingsOnMap4 = 0;
byte BuldingsOnMap5 = 0;
byte BuldingsOnMap6 = 0;
byte BuldingsOnMap7 = 0;
byte BuldingsOnMap8 = 0;
byte BuldingsOnMap9 = 0;
byte BuldingsOnMap10 = 0;
byte BuldingsOnMap11 = 0;
byte BuldingsOnMap12 = 0;

byte stage = 0;
byte chengePanelRightEnd = 0;
byte massege_state = 0;
byte lastBlock = 0;
int successX = 45;
int successY = -10;
byte gameOff = 0;
int comboAttainment = 0;
byte superComboAttainment = 0;
byte liveAttainment = 0;
int backgroundX = 0;
int backgroundY = -64;
int sky1Y = -192;
int sky2Y = -128;
byte massegeLast = 0;
byte comboDraw_state = 0;
byte comboTimer = 0;
byte frame_bird = 0;
byte bird_state = 0;
byte sfx = 1;
byte SFXmenu = 0;
byte markAchiveX = 21;
byte overmassege = 0;
byte ComboLevel = 0;
byte SFXover = 0;
#define sizeLive 3


Rect rectA = {58, 48, 15, 15};
Rect rectB = {32, 3, 15, 15};
Rect rectMain = {32, 5, 15, 15};
Rect rectBird = {-100, 32, 5, 5};

uint8_t singY[] = {4, 4, 5, 5, 5, 6, 6, 6, 7, 7, 7, 8, 8, 8, 8, 9, 9, 9, 10, 10, 11, 11, 11, 12, 12, 12, 12};

const unsigned char PROGMEM tittle[] =
{
  // width, height,
  128, 64,
// FRAME 00
0x00, 0x00, 0x00, 0x00, 0x00, 0x00, 0x00, 0x00, 0xfc, 0x04, 0x04, 0x04,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 0x00, 
0x00, 0x00, 0x00, 0x00, 0x00, 0x00, 0x00, 0x00, 0xff, 0x80, 0x80, 0x80,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 0x00, 
0x00, 0x00, 0x00, 0x00, 0x00, 0x00, 0x00, 0x00, 0x00, 0x00, 0x00, 0x00,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 0x00, 
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0x00, 0x00, 0x00, 0x00, 0x00, 0x00, 0x00, 0x00, 0x00, 0x00, 0x00, 0x00,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 0x00,
};

const unsigned char PROGMEM town[] =
{
  // width, height,
128, 64,
// FRAME 00
0xff, 0x80, 0x00, 0x00, 0x00, 0x00, 0x00, 0x00, 0x00, 0x00, 0x00, 0x00,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 0xff, 
0xff, 0xfe, 0x06, 0xe6, 0xf6, 0xf6, 0xf6, 0xf6, 0xf6, 0xf6, 0xf6, 0xf6,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 0xff, 
0xff, 0xff, 0x00, 0xff, 0xff, 0xff, 0xff, 0xff, 0xff, 0xff, 0xff, 0xff,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 0xff, 
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0xff, 0xff, 0xe0, 0xe7, 0xef, 0xef, 0xef, 0xef, 0xef, 0xef, 0xef, 0xef,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 0xff,
};
const unsigned char PROGMEM mark[] =
{
  // width, height,
  5, 5,
  // FRAME 00
0x10, 0x0a, 0x07, 0x0e, 0x04,
};

const unsigned char PROGMEM oneBilding[] =
{
  // width, height,
  16, 16,
  // FRAME 00
  0x00, 0xfc, 0xfa, 0xf6, 0x0e, 0xee, 0x6e, 0xae, 0xae, 0x6e, 0xee, 0x0e, 0xf6, 0xfa, 0xfc, 0x00,
  0x00, 0x3f, 0x5f, 0x6f, 0x70, 0x77, 0x76, 0x75, 0x75, 0x76, 0x77, 0x70, 0x6f, 0x5f, 0x3f, 0x00,

  0x00, 0xfc, 0x86, 0xba, 0xba, 0xfa, 0xa2, 0x7e, 0x7e, 0xa2, 0xfa, 0xba, 0xba, 0x86, 0xfc, 0x00,
  0x00, 0x3f, 0x61, 0x5d, 0x5d, 0x5f, 0x45, 0x7e, 0x7e, 0x45, 0x5f, 0x5d, 0x5d, 0x61, 0x3f, 0x00,

  0x00, 0xfc, 0xfe, 0x56, 0x6e, 0x56, 0x3e, 0x86, 0x86, 0x3e, 0x56, 0x6e, 0x56, 0xfe, 0xfc, 0x00,
  0x00, 0x3f, 0x7f, 0x6a, 0x76, 0x6a, 0x7c, 0x61, 0x61, 0x7c, 0x6a, 0x76, 0x6a, 0x7f, 0x3f, 0x00,


};

const unsigned char PROGMEM LeftPanelState[] =
{
  // width, height,
  20, 9,
  // FRAME 00
  0x00, 0xfc, 0xaa, 0xf9, 0xaa, 0xfc, 0x00, 0x00, 0x00, 0x00, 0x00, 0x00, 0x00, 0x00, 0x00, 0x00, 0x00, 0x00, 0x00, 0x00,
  0x00, 0x00, 0x00, 0x00, 0x00, 0x00, 0x00, 0x00, 0x00, 0x00, 0x00, 0x00, 0x00, 0x00, 0x00, 0x00, 0x00, 0x00, 0x00, 0x00,
};

const unsigned char PROGMEM RightPanelState[] =
{
// width, height,
25, 9,
// FRAME 00
0x00, 0x00, 0xae, 0x7e, 0xae, 0x00, 0x00, 0x00, 0x00, 0x00, 0x00, 0x00, 0x00, 0x00, 0x00, 0x00, 0x00, 0x00, 0x00, 0x00, 0x00, 0x00, 0x00, 0x00, 0x00, 
0x00, 0x00, 0x00, 0x00, 0x00, 0x00, 0x00, 0x00, 0x00, 0x00, 0x00, 0x00, 0x00, 0x00, 0x00, 0x00, 0x00, 0x00, 0x00, 0x00, 0x00, 0x00, 0x00, 0x00, 0x00,
};

const unsigned char PROGMEM BildingConAll[] =
{
// width, height,
11, 16,
// FRAME 00
0x00, 0xfc, 0xfa, 0x06, 0x76, 0x56, 0x76, 0x06, 0xfa, 0xfc, 0x00, 
0x00, 0xf9, 0xaa, 0xab, 0xfb, 0x03, 0xfb, 0xab, 0xaa, 0xf9, 0x00,

0x00, 0xfc, 0x26, 0xaa, 0x72, 0xde, 0x72, 0xaa, 0x26, 0xfc, 0x00, 
0x00, 0xf9, 0x8b, 0x8a, 0xfa, 0x8b, 0xfa, 0x8a, 0x8b, 0xf9, 0x00,

0x00, 0xfc, 0x76, 0xde, 0xde, 0x26, 0xde, 0xde, 0x76, 0xfc, 0x00, 
0x00, 0xf9, 0x8b, 0xfb, 0xab, 0xfb, 0xab, 0xfb, 0x8b, 0xf9, 0x00,

};

const unsigned char PROGMEM oneBlock[] =
{
// width, height,
15, 15,
// FRAME 00
0x00, 0xfe, 0x06, 0x76, 0x06, 0x76, 0x06, 0xfe, 0x06, 0x76, 0x06, 0x76, 0x06, 0xfe, 0x00, 
0x00, 0x3f, 0x20, 0x2f, 0x20, 0x2f, 0x20, 0x3f, 0x20, 0x2f, 0x20, 0x2f, 0x20, 0x3f, 0x00,

0x00, 0xfe, 0x82, 0xaa, 0x82, 0xaa, 0x82, 0xfe, 0xfe, 0xc6, 0xc6, 0xc6, 0xfe, 0xfe, 0x00, 
0x00, 0x3f, 0x3f, 0x31, 0x31, 0x31, 0x3f, 0x3f, 0x20, 0x2a, 0x20, 0x2a, 0x20, 0x3f, 0x00,


0x00, 0x3c, 0xfe, 0xfe, 0x0e, 0xc6, 0xe2, 0x02, 0xe2, 0xc6, 0x0e, 0xfe, 0xfe, 0x3c, 0x00, 
0x00, 0x1c, 0x3f, 0x3f, 0x20, 0x2d, 0x2d, 0x20, 0x2d, 0x2d, 0x20, 0x3f, 0x3f, 0x1c, 0x00,
};

const unsigned char PROGMEM roof[] =
{

15, 15,
// FRAME 00
0x00, 0x00, 0x00, 0x00, 0x00, 0x00, 0x00, 0x00, 0x00, 0x80, 0x80, 0xc0, 0xc0, 0xff, 0x7e, 
0xff, 0xc0, 0xff, 0x80, 0xc0, 0x00, 0x80, 0x00, 0x00, 0x00, 0x00, 0x00, 0x00, 0x00, 0x00, 
0x00, 0x70, 0x20, 0x7c, 0x2c, 0x7e, 0x2c, 0x7e, 0x20, 0x7f, 0x2d, 0x7f, 0x2d, 0x7f, 0x21, 
0x7f, 0x2d, 0x7f, 0x2d, 0x7f, 0x20, 0x7f, 0x2c, 0x7e, 0x2c, 0x7e, 0x20, 0x7c, 0x00, 0x70,
};

const unsigned char PROGMEM success[] =
{


39, 12,
// FRAME 00
0xff, 0xff, 0xc1, 0xff, 0xc1, 0xff, 0xc9, 0xff, 0x09, 0xff, 0x09, 0xff,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 0xf4, 
0xfc, 0xe4, 0xfc, 0xfc, 0xfc, 0x04, 0xfc, 0x04, 0xfc, 0x84, 0xfc, 0x94,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 0xff, 
0x07, 0x07, 0x04, 0x07, 0x04, 0x07, 0x04, 0x07, 0x04, 0x07, 0x04, 0x07,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 0x09, 
0x0f, 0x08, 0x0f, 0x0f, 0x0f, 0x04, 0x07, 0x04, 0x07, 0x04, 0x07, 0x04,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 0x07,
};

const unsigned char PROGMEM BACK[] =
{
// width, height,
128, 128,
// FRAME 00
0xbf, 0xbf, 0xbf, 0xbf, 0xbf, 0xbf, 0xbf, 0xbf, 0xbf, 0xbf, 0xbf, 0xbf,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 0xff, 
0xff, 0xff, 0xff, 0xff, 0xff, 0xff, 0xff, 0xff, 0xff, 0xff, 0xff, 0xff,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 0xff, 
0xfd, 0xfd, 0x01, 0xfd, 0xfd, 0xfd, 0x01, 0xfd, 0xfd, 0xfd, 0x01, 0xfd,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 0xff, 
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0xff, 0xff, 0xff, 0xff, 0xff, 0xff, 0xff, 0xff, 0xff, 0xff, 0xff, 0xff,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 0xff,
};

const unsigned char PROGMEM SKY[] =
{
// width, height,
128, 64,
// FRAME 00
0xff, 0xff, 0xff, 0xff, 0xff, 0xff, 0xff, 0xff, 0xff, 0xff, 0xff, 0xff,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 0xff, 
0xff, 0xff, 0xff, 0xff, 0xff, 0xff, 0xff, 0xff, 0xff, 0xff, 0xff, 0xff,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 0xff, 
0xff, 0xff, 0xff, 0xff, 0xff, 0xff, 0xff, 0xff, 0xff, 0xff, 0xff, 0xff,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 0xff, 
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0xff, 0xff, 0xff, 0xff, 0xff, 0xff, 0xff, 0xff, 0xff, 0xff, 0xff, 0xff,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 0xff,
};


const unsigned char PROGMEM stairdraw[] =
{
// width, height,
18, 20,
// FRAME 00
0x00, 0x00, 0x00, 0x00, 0x00, 0x00, 0x00, 0x80, 0x00, 0x80, 0x00, 0x80, 0x00, 0xe0, 0x40, 0xe0, 0x40, 0xff, 
0x40, 0xff, 0x40, 0xe0, 0x00, 0xe0, 0x00, 0x80, 0x00, 0x80, 0x00, 0x80, 0x00, 0x00, 0x00, 0x00, 0x00, 0x00, 
0x00, 0xf8, 0x00, 0xf8, 0x00, 0xf8, 0x00, 0xff, 0x07, 0xff, 0x01, 0xff, 0x01, 0xff, 0x07, 0xff, 0x01, 0xff, 
0x01, 0xff, 0x07, 0xff, 0x01, 0xff, 0x01, 0xff, 0x07, 0xff, 0x00, 0xff, 0x00, 0xf8, 0x00, 0xf8, 0x00, 0xf8, 
0x00, 0x0f, 0x00, 0x0f, 0x00, 0x0f, 0x00, 0x0f, 0x00, 0x0f, 0x00, 0x0f, 0x00, 0x0f, 0x00, 0x0f, 0x00, 0x0f, 
0x00, 0x0f, 0x00, 0x0f, 0x00, 0x0f, 0x00, 0x0f, 0x00, 0x0f, 0x00, 0x0f, 0x00, 0x0f, 0x00, 0x0f, 0x00, 0x0f,
};

const unsigned char PROGMEM star[] =
{
// width, height,
9, 9,
// FRAME 00
0x00, 0x08, 0x00, 0xd8, 0xd0, 0xf8, 0x78, 0xfe, 0x3e, 
0x7f, 0x78, 0xfe, 0xd0, 0xf8, 0x00, 0xd8, 0x00, 0x08, 
0x00, 0x00, 0x00, 0x01, 0x00, 0x01, 0x00, 0x00, 0x00, 
0x00, 0x00, 0x00, 0x00, 0x01, 0x00, 0x01, 0x00, 0x00,
};

const unsigned char PROGMEM combo[] =
{
// width, height,
33, 16,
// FRAME 00
0xdd, 0xba, 0xb6, 0xb6, 0xcd, 0xff, 0xff, 0xc0, 0xbf, 0xbf, 0xbf, 0xc0,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 0xff, 
0xff, 0xc3, 0xbd, 0xbd, 0xdb, 0xff, 0xc3, 0xbd, 0xbd, 0xc3, 0xff, 0x81,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 0xff,
};


const unsigned char PROGMEM birdL[] =
{
// width, height,
5, 5,
// FRAME 00
0x00, 0x06, 0x00, 0x06, 0x00, 
0x04, 0x00, 0x06, 0x00, 0x07,

0x00, 0x06, 0x00, 0x06, 0x00, 
0x04, 0x00, 0x0c, 0x00, 0x1c,
};

const unsigned char PROGMEM birdR[] =
{
// width, height,
5, 5,
// FRAME 00
0x00, 0x07, 0x00, 0x06, 0x00, 
0x04, 0x00, 0x06, 0x00, 0x06,

0x00, 0x1c, 0x00, 0x0c, 0x00, 
0x04, 0x00, 0x06, 0x00, 0x06,

};

const unsigned char PROGMEM windL[] =
{
// width, height,
16, 16,
// FRAME 00
0x00, 0xfe, 0xfe, 0xfe, 0xde, 0xd6, 0xea, 0xfa, 0xde, 0xd6, 0xea, 0xfa, 0xfe, 0xfe, 0xfe, 0x00, 
0x00, 0x7f, 0x7f, 0x7b, 0x71, 0x6a, 0x7b, 0x7b, 0x7b, 0x7b, 0x7b, 0x7b, 0x7b, 0x7f, 0x7f, 0x00,


0x00, 0xfe, 0xfe, 0xfe, 0x5e, 0xd6, 0xea, 0xfa, 0xde, 0xd6, 0xea, 0xfa, 0xfe, 0xfe, 0xfe, 0x00, 
0x00, 0x7f, 0x7f, 0x6e, 0x44, 0x6e, 0x6e, 0x6e, 0x6e, 0x6e, 0x6e, 0x6e, 0x6e, 0x7f, 0x7f, 0x00,

0x00, 0xfe, 0xfe, 0x7e, 0x2e, 0x6a, 0x74, 0x7c, 0x6e, 0x6a, 0x74, 0x7c, 0x7e, 0xfe, 0xfe, 0x00, 
0x00, 0x7f, 0x7f, 0x5b, 0x00, 0x5b, 0x5b, 0x5b, 0x5b, 0x5b, 0x5b, 0x5b, 0x5b, 0x7f, 0x7f, 0x00,

};

const unsigned char PROGMEM windR[] =
{
// width, height,
16, 16,
// FRAME 00
0x00, 0xfe, 0xfe, 0xfe, 0xfa, 0xea, 0xd6, 0xde, 0xfa, 0xea, 0xd6, 0xde, 0xfe, 0xfe, 0xfe, 0x00, 
0x00, 0x7f, 0x7f, 0x7b, 0x7b, 0x7b, 0x7b, 0x7b, 0x7b, 0x7b, 0x6a, 0x71, 0x7b, 0x7f, 0x7f, 0x00,


0x00, 0xfe, 0xfe, 0xfe, 0xfa, 0xea, 0xd6, 0xde, 0xfa, 0xea, 0xd6, 0x5e, 0xfe, 0xfe, 0xfe, 0x00, 
0x00, 0x7f, 0x7f, 0x6e, 0x6e, 0x6e, 0x6e, 0x6e, 0x6e, 0x6e, 0x6e, 0x44, 0x6e, 0x7f, 0x7f, 0x00,


0x00, 0xfe, 0xfe, 0x7e, 0x7c, 0x74, 0x6a, 0x6e, 0x7c, 0x74, 0x6a, 0x2e, 0x7e, 0xfe, 0xfe, 0x00, 
0x00, 0x7f, 0x7f, 0x5b, 0x5b, 0x5b, 0x5b, 0x5b, 0x5b, 0x5b, 0x5b, 0x00, 0x5b, 0x7f, 0x7f, 0x00,

};

const unsigned char PROGMEM Allachive[] =
{
// width, height,
//master
20, 20,
// FRAME 00
0xff, 0x01, 0x01, 0x11, 0x09, 0x01, 0x01, 0x21, 0x71, 0xf9, 0xed, 0xf9, 0xf1, 0xe1, 0xe1, 0x81, 0x01, 0x01, 0x01, 0xff, 
0xff, 0x00, 0x00, 0x80, 0xc0, 0xe0, 0x70, 0x38, 0x1c, 0x0e, 0x07, 0x03, 0x07, 0x0f, 0x1f, 0x8d, 0x07, 0x02, 0x00, 0xff, 
0x0f, 0x08, 0x0b, 0x0b, 0x09, 0x08, 0x08, 0x08, 0x08, 0x08, 0x08, 0x08, 0x08, 0x08, 0x09, 0x08, 0x08, 0x08, 0x08, 0x0f,


//mega
0xff, 0x01, 0x01, 0xf1, 0x91, 0x51, 0xfd, 0x25, 0x05, 0x95, 0xfd, 0x11, 0x51, 0xf1, 0x21, 0xa1, 0xe1, 0x01, 0x01, 0xff, 
0xff, 0x00, 0xfc, 0x15, 0x84, 0xfc, 0x81, 0x80, 0xf8, 0x28, 0x29, 0x88, 0x88, 0xf9, 0x40, 0x40, 0x41, 0xc0, 0x00, 0xff, 
0x0f, 0x08, 0x0b, 0x08, 0x08, 0x0b, 0x08, 0x08, 0x0b, 0x08, 0x08, 0x08, 0x08, 0x0b, 0x08, 0x08, 0x09, 0x0b, 0x08, 0x0f,


//million
0xff, 0x01, 0x01, 0x41, 0x01, 0x01, 0x01, 0x81, 0x41, 0x3d, 0x3d, 0x41, 0x81, 0x01, 0x01, 0x01, 0x09, 0x01, 0x01, 0xff, 
0xff, 0x00, 0x00, 0xf8, 0x08, 0x0e, 0x5a, 0x4b, 0x5a, 0x0b, 0x0b, 0x5a, 0x4b, 0x5a, 0x0e, 0x08, 0xf8, 0x00, 0x00, 0xff, 
0x0f, 0x08, 0x08, 0x0f, 0x08, 0x08, 0x0a, 0x0a, 0x0a, 0x08, 0x08, 0x0a, 0x0a, 0x0a, 0x08, 0x08, 0x0f, 0x08, 0x08, 0x0f,


//glaz
0xff, 0x03, 0x05, 0x09, 0x91, 0x41, 0x21, 0xa1, 0x61, 0x21, 0x21, 0x61, 0xa1, 0x21, 0x41, 0x91, 0x09, 0x05, 0x03, 0xff, 
0xff, 0x00, 0x0e, 0x11, 0x20, 0x40, 0x9f, 0xa0, 0xc0, 0x86, 0x86, 0xc0, 0xa0, 0x9f, 0x40, 0x20, 0x11, 0x0e, 0x00, 0xff, 
0x0f, 0x0c, 0x0a, 0x09, 0x08, 0x08, 0x08, 0x08, 0x08, 0x08, 0x08, 0x08, 0x08, 0x08, 0x08, 0x08, 0x09, 0x0a, 0x0c, 0x0f,


};

void setup() {
  arduboy.begin();
  arduboy.setFrameRate(60);
  beep.begin();
}
void background(){

   Sprites::drawOverwrite (0, sky1Y, SKY, 0);
    Sprites::drawOverwrite (0, sky2Y, SKY, 1);
    Sprites::drawOverwrite (backgroundX, backgroundY, BACK, 0);
    Sprites::drawPlusMask  (0, 44, stairdraw, 0);
    Sprites::drawOverwrite  (103, 55, RightPanelState, 0);
    
    arduboy.fillRect(18,50,8,14,WHITE);
    if(sky2Y == 64){
      sky2Y = -64;
    }
    if(sky1Y == 64){
      sky1Y = -64;
    }

}
void buttons() {
  if (arduboy.justPressed(B_BUTTON) && flag == 0) {
    flag = 1;
  }
  if (rectB.y == 64) {
    flag = 0;
  }

  if (rectA.y == 63) {
     if(stair > 0){
    rectA.y = 48;
     }
    rectA.x = rectB.x;
    flag = 0;
  
 }
}
void wind(){
  if (stair_tower > 5){
    if(bird_state == 4)  Sprites::drawOverwrite  (113, 0, windR, 0);
    if(bird_state == 5)  Sprites::drawOverwrite  (113, 0, windL, 0);
    if (stair_tower > 24){
    if(bird_state == 6)  Sprites::drawOverwrite  (113, 0, windR, 1);
    if(bird_state == 7)  Sprites::drawOverwrite  (113, 0, windL, 1);
    }
    if (stair_tower > 37){
    if(bird_state > 7 && bird_state < 11)  Sprites::drawOverwrite  (113, 0, windR, 2);
    if(bird_state > 10 && bird_state < 14)  Sprites::drawOverwrite  (113, 0, windL, 2);
    }
    
  if(bird_state == 4 && flag == 1){
  
    if(rectB.y == 25 || rectB.y == 30 || rectB.y == 35){
    rectB.x++;
    }
  }
    if(bird_state == 5 && flag == 1){
    
    if(rectB.y == 25 || rectB.y == 30 || rectB.y == 35){
    rectB.x--;
    }
  }
  if(stair_tower > 24){
    if(bird_state == 6 && flag == 1){
    
    if(rectB.y == 25 || rectB.y == 28 || rectB.y == 33 || rectB.y == 35 ){
    rectB.x = rectB.x + 2;
    }
  }
      if(bird_state == 7 && flag == 1){
     
   if(rectB.y == 25 || rectB.y == 28 || rectB.y == 33 || rectB.y == 35 ){
    rectB.x = rectB.x - 2;
    }
    }
  }
    if(stair_tower > 37){
    if(bird_state > 7 && bird_state < 11&& flag == 1){
    
   if(rectB.y == 25 || rectB.y == 28 || rectB.y == 33 || rectB.y == 35 ){
    rectB.x = rectB.x + 4;
    }
  }
      if(bird_state > 10 && bird_state < 14 && flag == 1){
     
   if(rectB.y == 25 || rectB.y == 28 || rectB.y == 33 || rectB.y == 35 ){
    rectB.x = rectB.x - 4;
    }
    }
  }
}
}

void birdfly(){
  if (stair_tower > 10){
            if (arduboy.everyXFrames(5)) frame_bird++;
            if (frame_bird > 1) frame_bird = 0;

  if(bird_state == 0){
    if(rectBird.x < 129){
    rectBird.x = rectBird.x + 2;
  }
Sprites::drawPlusMask  (rectBird.x, rectBird.y, birdR, frame_bird);
  }
  if(bird_state == 1){
        if(rectBird.x > -5){
    rectBird.x = rectBird.x - 2;
  }
Sprites::drawPlusMask  (rectBird.x, rectBird.y, birdL, frame_bird);
  }

  }
}
void upstair() {
  if (arduboy.everyXFrames(2)) {
    if (rectA.y == 49) {
      stair--;
      stair_tower++;
      bird_state = random(0,14);
      if(bird_state == 0) rectBird.x = -100;
      if(bird_state == 1) rectBird.x = 224;
      if(sfx == 1){
      beep.tone(beep.freq(200), 5);
      }
    }

  }
if(stair < 100 && stair >= 10){
  arduboy.setCursor(3, 57);
  arduboy.print(stair);
  }
if(stair >= 100){
    arduboy.setCursor(0, 57);
    arduboy.print(stair);
}
if(stair < 10){
  arduboy.setCursor(7, 57);
  arduboy.print(stair);
}
}




void scores() {
  if (arduboy.everyXFrames(2)) {
    if (rectA.y == 49) {
      
      score = score + 1;
      if (left > 25 && stair_tower > 10) {
        right++;
        left--;
      }
    }
    if ( rectB.x > rectA.x - 4 && rectB.x < rectA.x + 4  && rectA.y == 49) {
      score = score + 2;

    }
    if ( rectB.x == rectA.x  && rectA.y == 49) {
 if(sfx == 1) {
         beep.tone(beep.freq(400), 5);
 }
      ComboLevel++;
      combo_wight = combo_wight + 20;
      comboAttainment++;
      if (combo_wight > 58) {
        combo_wight = 58;
      }
      score = score + 3;
      if (left < 55) {
        right = right - 3;
        left = left + 3;
      }
    }

  }

  if (combo_wight > 0) {
    Sprites::drawPlusMask  (23, 0, star, 0);
    arduboy.fillRect (35, 2, combo_wight, 2, BLACK);
    arduboy.drawRect (34, 1, 59, 4, BLACK);
    if (arduboy.everyXFrames(11)) {
      combo_wight--;
    }

  }

  if (combo_wight > 57) {
    score = score + 20;
    Supercombo++;
    superComboAttainment++;
    combo_wight = 0;
    comboDraw_state = 1;
  }


    
  
  
  if (score < 100) {
    arduboy.setCursor(115, 57);
    arduboy.print(score);
  }
  else {
    arduboy.setCursor(110, 57);
    arduboy.print(score);
  }

}

void drawCombo(){
  if(comboDraw_state == 1){
    comboTimer++;
    if(comboTimer < 20 || comboTimer > 30 && comboTimer < 50 || comboTimer > 70){
  Sprites::drawOverwrite  (85, 28, combo, 0);
    }
  if(sfx == 1) {
    if(comboTimer < 6)   beep.tone(beep.freq(500), 5);
    if(comboTimer > 5 && comboTimer < 20) beep.tone(beep.freq(900), 3);
  }
    if(comboTimer == 150){
      comboTimer = 0;
      comboDraw_state = 0;
    }
  }
}
void Move() {
  rectMain.y = singY[swingy];

  if (arduboy.everyXFrames(2)) {


    if (rectMain.x < 88 && Main == 0) {
      ++rectMain.x;
    }
    if (rectMain.x == 88) {
      Main = 1;
    }
    if (rectMain.x > 32 && Main == 1) {
      --rectMain.x;
    }
    if (rectMain.x == 32 ) {
      Main = 0;
    }
  }

  if (arduboy.everyXFrames(4)) {
    if (rectMain.x < 60 && Main == 0 && swingy < 26) {
      ++swingy;
    }

    if (rectMain.x > 60 && Main == 0  && swingy > 0) {
      --swingy;
    }

    if (rectMain.x > 60 && Main == 1  && swingy < 26) {
      ++swingy;
    }
    if (rectMain.x < 60 && Main == 1  && swingy > 0) {
      --swingy;
    }


  }


}

void MoveDown() {

  if (flag == 1) {
    if (rectB.y < 64) {
      ++rectB.y;
    
  }
  }
if(stair > 0){
  if (flag == 0) {
    rectB.x = rectMain.x;
    rectB.y = rectMain.y;
  }
}
  
}

void drawStair(){  

  //QUICK GAME
  if(chose_build == 0){
    if(stair_tower < 20){
    Sprites::drawOverwrite (rectB.x, rectB.y, oneBlock, 0);
    Sprites::drawOverwrite (rectA.x, rectA.y, oneBlock, 0);
    }
    if(stair_tower >= 20 && stair_tower < 40){
    Sprites::drawOverwrite (rectB.x, rectB.y, oneBlock, 1);
    Sprites::drawOverwrite (rectA.x, rectA.y, oneBlock, 1);
    }
    if(stair_tower >= 40 ){
    Sprites::drawOverwrite (rectB.x, rectB.y, oneBlock, 2);
    Sprites::drawOverwrite (rectA.x, rectA.y, oneBlock, 2);
    }
  }
  //COMPANY

  if(chose_build == 1){
    
    Sprites::drawOverwrite (rectA.x, rectA.y, oneBlock, 0);  
    if(stair == 1 && rectB.y == rectMain.y) lastBlock = 1;
    if(lastBlock == 1)  Sprites::drawPlusMask(rectB.x, rectB.y, roof, 0);
    if(lastBlock == 0){
    Sprites::drawOverwrite (rectB.x, rectB.y, oneBlock, 0);
    }
  }
  if(chose_build == 2){
    Sprites::drawOverwrite (rectA.x, rectA.y, oneBlock, 1);  
    if(stair == 1 && rectB.y == rectMain.y) lastBlock = 1;
    if(lastBlock == 1)  Sprites::drawPlusMask(rectB.x, rectB.y, roof, 0);
    if(lastBlock == 0){
    Sprites::drawOverwrite (rectB.x, rectB.y, oneBlock, 1);
    }

  }
  if(chose_build == 3){
    Sprites::drawOverwrite (rectA.x, rectA.y, oneBlock, 2);  
    if(stair == 1 && rectB.y == rectMain.y) lastBlock = 1;
    if(lastBlock == 1)  Sprites::drawPlusMask(rectB.x, rectB.y, roof, 0);
    if(lastBlock == 0){
    Sprites::drawOverwrite (rectB.x, rectB.y, oneBlock, 2);
    }
  }
    
}

void collideRect() {
  if (arduboy.collide(rectA, rectB) && flag == 1) {
    if (rectB.x > rectA.x - 2 && rectB.x < rectA.x + 2 || rectB.x + 15 > rectA.x + 13 && rectB.x + 15 < rectA.x + 17) {
      rectB.x = rectA.x;
    }

    --rectB.y;
    flag = 2;
    chek = 1;
  }
  if (arduboy.collide(rectA, rectB) && rectB.y + 15 > rectA.y && rectB.x < rectA.x || rectB.y + 16 == rectA.y && rectB.x + 15 < rectA.x + 7  && rectB.x + 15 > rectA.x) {
    chek = 0;
    rectB.x = rectB.x - 7 ;
    flag = 1;


  }
  if (arduboy.collide(rectA, rectB) && rectB.y + 15 > rectA.y && rectB.x > rectA.x || rectB.y + 16 == rectA.y && rectB.x > rectA.x + 8 && rectB.x < rectA.x + 15) {
    chek = 0;
    rectB.x = rectB.x + 7 ;
    flag = 1;

  }

  arduboy.drawLine(rectMain.x + 7, rectMain.y, 64, -15, BLACK  ) ;
  
  if(flag==1 && arduboy.collide(rectBird, rectB)){
    if(bird_state == 0){
    rectB.x = rectB.x + 10;
    rectBird.x = -5;
    bird_state = 3;
    }
        if(bird_state == 1){
    rectB.x = rectB.x - 10;
    rectBird.x = 129;
    bird_state = 3;
    }
  }
   
}

void MoveBloks() {
  
  if (arduboy.everyXFrames(2)) {
    if (flag == 2 && chek == 1) {
      ++rectA.y;
      ++rectB.y;
      ++backgroundY;
      ++sky2Y;
      ++sky1Y;

    }
  }
}



void swingTower() {

  if (stair_tower > 10) {
    if (left > 50 && left < 55) {
      frame_tower = 9;
    }
    if (left > 45 && left < 50) {
      frame_tower = 6;
    }
    if (left > 30 && left < 45) {
      frame_tower = 4;
    }
    if (left > 20 && left < 30) {
      frame_tower = 3;
    }

    if (arduboy.everyXFrames(frame_tower)) {

      if (rectA.x >= right) {
        swingState = 1;
      }
      if (rectA.x <= left ) {
        swingState = 0;
      }


      if (rectA.x < right && swingState == 0 ) {
        ++rectA.x;
      }

      if (rectA.x > left && swingState == 1) {
        --rectA.x;
      }

      if (flag == 2) {
        if ( swingState == 0) {
          ++rectB.x;
        }

        if ( swingState == 1) {
          --rectB.x;
        }
      }


    }


  }
}


void live() {

  if (rectB.y == 64) {
    --lives;
    liveAttainment++;
    if(sfx == 1) {
    beep.tone(beep.freq(50), 5);
    }
  }

  if (lives == 3) {
    arduboy.fillRect(20, 60, sizeLive, sizeLive, BLACK);
    arduboy.fillRect(20, 56, sizeLive, sizeLive, BLACK);
    arduboy.fillRect(20, 52, sizeLive, sizeLive, BLACK);
  }
  if (lives == 2) {
    arduboy.fillRect(20, 56, sizeLive, sizeLive, BLACK);
    arduboy.fillRect(20, 60, sizeLive, sizeLive, BLACK);
  }
  if (lives == 1) {
    arduboy.fillRect(20, 60, sizeLive, sizeLive, BLACK);
  }

}
void successDraw(){

  if(stair == 0){
     if (arduboy.everyXFrames(3)){
    if(successY < 30)successY++;
     }
    Sprites::drawPlusMask(successX, successY, success, 0);
    if(successY == 29 && gameOff == 0) gameOff = 1;
    if(arduboy.justPressed(B_BUTTON) && gameOff == 2) gameOff = 3;
    if(arduboy.justPressed(B_BUTTON) && gameOff == 1) gameOff = 2;
    if(gameOff == 2){
      arduboy.fillRect(15, 11, 100, 45, BLACK);
      arduboy.setCursor(19, 15);
      arduboy.print (F("Population = "));
      arduboy.print (score);
      arduboy.setCursor(19, 30);
      arduboy.print (F("Combo = "));
      arduboy.print (ComboLevel);
      arduboy.setCursor(19, 45);
      arduboy.print (F("Super combo = "));
      arduboy.print (Supercombo);
      
    }
   if(sfx == 1) {
    if(successY < 0) beep.tone(beep.freq(400), 8);
    if(successY > 0 && successY < 3) beep.tone(beep.freq(500), 3);
    if(successY > 3 && successY < 8) beep.tone(beep.freq(600), 3);
    if(successY > 8 && successY < 13) beep.tone(beep.freq(500), 3);
    if(successY > 13 && successY < 23) beep.tone(beep.freq(800), 8);
   }
  }
}
void reset() {
  if (gameOff == 3) {
    chose_build_state = 1;
    Rpanel_markX = 29;
    Rpanel_markY = 15;
    rectA.x = 58;
    rectA.y = 48;
    rectB.x = 32;
    rectB.y = 3;
    rectMain.x = 32;
    rectMain.y = 5;
    swingy = 0;
    left = 58;
    right = 58;
    frame_tower = 17;     

    swingState = 0;
    stair_tower = 0;
    stage++;
    combo_wight = 0;
    lives = 3;
    flag = 0;
    lastBlock = 0;
    gameOff = 0;
    successY = -10;
    Supercombo = 0;
    backgroundX = 0;
    backgroundY = -64;
    sky1Y = -192;
    sky2Y = -128;    
    gamestate = 1;
    chengePanelRightEnd = 1;
    rectBird.x = -5;
    SFXmenu = 0;
  }
}
void resetAll(){
    chose_build_state = 1;
    Rpanel_markX = 27;
    Rpanel_markY = 15;
    rectA.x = 58;
    rectA.y = 48;
    rectB.x = 32;
    rectB.y = 3;
    rectMain.x = 32;
    rectMain.y = 5;
    swingy = 0;
    left = 58;
    right = 58;
    frame_tower = 17;
    swingState = 0;
    stair_tower = 0;
    stage++;
    combo_wight = 0;
    lives = 3;
    score = 0;
    flag = 0;
    lastBlock = 0;
    gameOff = 0;
    successY = -10;
    Supercombo = 0;
    backgroundX = 0;
    backgroundY = -64;
    sky1Y = -192;
    sky2Y = -128;
    rectBird.x = -5;
    SFXmenu = 0;
}
void chose_builds() {
  if (chose_build == 1) {
    if (chose_build_state == 1) {
      stair = 24;
      chose_build_state = 0;
    }
    reset();
  }
  if (chose_build == 2) {
    if (chose_build_state == 1) {
      stair = 37;
      chose_build_state = 0;
    }
    reset();
  }
  if (chose_build == 3) {
    if (chose_build_state == 1) {
      stair = 56;
      chose_build_state = 0;
    }
    reset();
  }

}


void masseges() {
  switch ( massege ) {
    case 0:
      arduboy.fillRect(15, 11, 100, 45, BLACK);
      arduboy.setCursor(35, 18);
      arduboy.print (F("Welcome to"));
      arduboy.setCursor(35, 35);
      arduboy.print (F("ARDUBLOXX!"));
      if (arduboy.justPressed(B_BUTTON)) {
        massege = 1;
      }
      break;

    case 1:
      arduboy.fillRect(10, 11, 110, 47, BLACK);
      arduboy.setCursor(16, 15);
      arduboy.print (F("You have a piece"));
      arduboy.setCursor(14, 25);
      arduboy.print (F("of land. You mast"));
      arduboy.setCursor(23, 35);
      arduboy.print (F("turn this town"));
      arduboy.setCursor(16, 45);
      arduboy.print (F("into a megapolis"));
      if (arduboy.justPressed(B_BUTTON)) {
        massege = 2;
      }
      break;

    case 2:
      arduboy.fillRect(10, 11, 110, 47, BLACK);
      arduboy.setCursor(14, 15);
      arduboy.print (F("Your investor has"));
      arduboy.setCursor(14, 25);
      arduboy.print (F("provided you with"));
      arduboy.setCursor(23, 35);
      arduboy.print (F("the first type"));
      arduboy.setCursor(29, 45);
      arduboy.print (F("of building"));
      if (arduboy.justPressed(B_BUTTON)) {
        massege = 5;
      }
      break;

        case 3:
      arduboy.fillRect(15, 11, 102, 36, BLACK);
      arduboy.setCursor(21, 15);
      arduboy.print (F("You have opened"));
      arduboy.setCursor(21, 25);
      arduboy.print (F("a new building:"));
      arduboy.setCursor(30, 35);
      arduboy.print (F("TOWER BLOCK!"));
      if (arduboy.justPressed(B_BUTTON)) {
        massege = 5;
        massege_state = 1;
      }
      break;
      
        case 4:
      arduboy.fillRect(15, 11, 102, 36, BLACK);
      arduboy.setCursor(21, 15);
      arduboy.print (F("You have opened"));
      arduboy.setCursor(21, 25);
      arduboy.print (F("a new building:"));
      arduboy.setCursor(35, 35);
      arduboy.print (F("SKYSCEAPER!"));
      if (arduboy.justPressed(B_BUTTON)) {
        massege = 5;
        massege_state = 2;
      }
      break;

  }
}


void Rpanel_move(){
      
      if(arduboy.justPressed(RIGHT_BUTTON) && Rpanel_markX < 103){
        Rpanel_markX = Rpanel_markX + 25;
      }
      if(arduboy.justPressed(LEFT_BUTTON) && Rpanel_markX > 30){
        Rpanel_markX = Rpanel_markX - 25;
      }
      if(arduboy.justPressed(DOWN_BUTTON) && Rpanel_markY == 16){
       Rpanel_markY = 46;
      }
      if(arduboy.justPressed(UP_BUTTON) && Rpanel_markY == 46){
       Rpanel_markY = 16;
      }

    
      if(Rpanel_markX == 28 && Rpanel_markY == 16){
        arduboy.setCursor(30, 56);
        arduboy.print (house_one);
      }
      if(Rpanel_markX == 53 && Rpanel_markY == 16){
        arduboy.setCursor(30, 56);
        arduboy.print (house_two);
      }
      if(Rpanel_markX == 78 && Rpanel_markY == 16){
        arduboy.setCursor(30, 56);
        arduboy.print (house_three);
      }
      if(Rpanel_markX == 103 && Rpanel_markY == 16){
        arduboy.setCursor(30, 56);
        arduboy.print (house_four);
      }
      if(Rpanel_markX == 28 && Rpanel_markY == 46){
        arduboy.setCursor(30, 56);
        arduboy.print (house_five);
      }
      if(Rpanel_markX == 53 && Rpanel_markY == 46){
        arduboy.setCursor(30, 56);
        arduboy.print (house_six);
      }        
      if(Rpanel_markX == 78 && Rpanel_markY == 46){
        arduboy.setCursor(30, 56);
        arduboy.print (house_seven);
      }
      if(Rpanel_markX == 103 && Rpanel_markY == 46){
        arduboy.setCursor(30, 56);
        arduboy.print (house_eight);
      }  
      }


void panels() {
  
  //move mark
  if(allscore > 500 && massege_state == 0){
    massege = 3;  
  }
  if(allscore > 1200 && massege_state == 1){
    massege = 4;  
  }
  if (massege == 5) {
    menuSFX();
    Sprites::drawOverwrite (2, 11, oneBilding, 0);
    if(allscore > 500){
    Sprites::drawOverwrite (2, 28, oneBilding, 1);
    }
    if(allscore > 1200){
    Sprites::drawOverwrite (2, 45, oneBilding, 2);
    }
if(chengePanelRightEnd == 0){

      drawBuildOnMap();
       if (arduboy.justPressed(LEFT_BUTTON) && Rpanel_markX == 28) {
      Lpanel_enable = 1;
      Rpanel_enable = 0;  
       }
       
        if (Rpanel_enable == 1) {
      arduboy.drawRect (Rpanel_markX, Rpanel_markY, 9, 9, BLACK);
      Sprites::drawOverwrite (22, 55, RightPanelState, 0);
      Rpanel_move();                         
    }


        if (arduboy.justPressed(RIGHT_BUTTON) && Lpanel_enable == 1) {
      Lpanel_enable = 0;
      Rpanel_enable = 1;
      Rpanel_markX = 28;
      Rpanel_markY = 16;
    }
    
       
    if (Lpanel_enable == 1) {
      Sprites::drawOverwrite (22, 55, LeftPanelState, 0);
      
      if (Lpanel_mark == 0) {
        arduboy.drawRect (3, 12, 14, 14, BLACK);
        arduboy.setCursor(30, 56);
        arduboy.print (F("24"));
        arduboy.setCursor(40, 10);
        arduboy.print (F("Maisonette"));
        if (arduboy.justPressed(B_BUTTON)) {
          chose_build = 1;
          gamestate = 2;
        }
      
      }
      if(allscore > 500){
      if (Lpanel_mark == 1) {
        arduboy.drawRect (3, 29, 14, 14, BLACK);
        arduboy.setCursor(30, 56);
        arduboy.print (F("37"));
        arduboy.setCursor(40, 10);
        arduboy.print (F("Tower block"));
        if (arduboy.justPressed(B_BUTTON)) {
          chose_build = 2;
          gamestate = 2;
        }
      }
      }
      if(allscore > 1200){
      if (Lpanel_mark == 2) {
        arduboy.drawRect (3, 46, 14, 14, BLACK);
        arduboy.setCursor(30, 56);
        arduboy.print (F("56"));
        arduboy.setCursor(40, 10);
        arduboy.print (F("Skyscraper"));
        if (arduboy.justPressed(B_BUTTON)) {
          chose_build = 3;
          gamestate = 2;
        }
      }
      }

      if (arduboy.justPressed(UP_BUTTON) && Lpanel_mark > 0) {
        Lpanel_mark--;
      }
      if (arduboy.justPressed(DOWN_BUTTON) && Lpanel_mark < 2  && allscore > 500) {
        Lpanel_mark++;
      }

    }

      
 
  }

    if(chengePanelRightEnd == 1){      
         if(massegeLast == 2){
      building_construction();
      } 
      if(massegeLast == 1){
        
        arduboy.fillRect(10, 11, 110, 40, BLACK);
        arduboy.setCursor(15, 12);
        arduboy.print (F("Remember you have"));
        arduboy.setCursor(17, 25);
        arduboy.print (F("13 days to build"));
        arduboy.setCursor(32, 37);
        arduboy.print (F("up a city"));  
        if (arduboy.justPressed(B_BUTTON)) massegeLast = 2;
      }
      if(massegeLast == 0){
        
        arduboy.fillRect(10, 11, 110, 27, BLACK);
        arduboy.setCursor(25, 12);
        arduboy.print (F("Put a new home"));
        arduboy.setCursor(40, 25);
        arduboy.print (F("anywhere."));
       if (arduboy.justPressed(B_BUTTON))  massegeLast = 1;
      }
        

    }
}


}

void drawBuildOnMap(){
 
 if(BuldingsOnMap1 == 1)  Sprites::drawOverwrite (27, 15, BildingConAll, 0);
  if(BuldingsOnMap1 == 2)  Sprites::drawOverwrite (27, 15, BildingConAll, 1);
  if(BuldingsOnMap1 == 3)  Sprites::drawOverwrite (27, 15, BildingConAll, 2);
  if(BuldingsOnMap2 == 1)  Sprites::drawOverwrite (52, 15, BildingConAll, 0);
  if(BuldingsOnMap2 == 2)  Sprites::drawOverwrite (52, 15, BildingConAll, 1);
  if(BuldingsOnMap2 == 3)  Sprites::drawOverwrite (52, 15, BildingConAll, 2);
  if(BuldingsOnMap3 == 1)  Sprites::drawOverwrite (77, 15, BildingConAll, 0);
  if(BuldingsOnMap3 == 2)  Sprites::drawOverwrite (77, 15, BildingConAll, 1);
  if(BuldingsOnMap3 == 3)  Sprites::drawOverwrite (77, 15, BildingConAll, 2);
  if(BuldingsOnMap4 == 1)  Sprites::drawOverwrite (102, 15, BildingConAll, 0);
  if(BuldingsOnMap4 == 2)  Sprites::drawOverwrite (102, 15, BildingConAll, 1);
  if(BuldingsOnMap4 == 3)  Sprites::drawOverwrite (102, 15, BildingConAll, 2);

  if(BuldingsOnMap5 == 1)  Sprites::drawOverwrite (27, 44, BildingConAll, 0);
  if(BuldingsOnMap5 == 2)  Sprites::drawOverwrite (27, 44, BildingConAll, 1);
  if(BuldingsOnMap5 == 3)  Sprites::drawOverwrite (27, 44, BildingConAll, 2);
  if(BuldingsOnMap6 == 1)  Sprites::drawOverwrite (52, 44, BildingConAll, 0);
  if(BuldingsOnMap6 == 2)  Sprites::drawOverwrite (52, 44, BildingConAll, 1);
  if(BuldingsOnMap6 == 3)  Sprites::drawOverwrite (52, 44, BildingConAll, 2);
  if(BuldingsOnMap7 == 1)  Sprites::drawOverwrite (77, 44, BildingConAll, 0);
  if(BuldingsOnMap7 == 2)  Sprites::drawOverwrite (77, 44, BildingConAll, 1);
  if(BuldingsOnMap7 == 3)  Sprites::drawOverwrite (77, 44, BildingConAll, 2);
  if(BuldingsOnMap8 == 1)  Sprites::drawOverwrite (102, 44, BildingConAll, 0);
  if(BuldingsOnMap8 == 2)  Sprites::drawOverwrite (102, 44, BildingConAll, 1);
  if(BuldingsOnMap8 == 3)  Sprites::drawOverwrite (102, 44, BildingConAll, 2);

}
void building_construction(){
drawBuildOnMap();
 if(chose_build == 1){
 Sprites::drawOverwrite (Rpanel_markX - 2, Rpanel_markY - 3, BildingConAll, 0);
 }
  if(chose_build == 2){
 Sprites::drawOverwrite (Rpanel_markX - 2, Rpanel_markY - 3, BildingConAll, 1);
 }
  if(chose_build == 3){
 Sprites::drawOverwrite (Rpanel_markX - 2, Rpanel_markY - 3, BildingConAll, 2);
 }
 
       if(arduboy.justPressed(RIGHT_BUTTON) && Rpanel_markX < 103){
        Rpanel_markX = Rpanel_markX + 25;
      }
      if(arduboy.justPressed(LEFT_BUTTON) && Rpanel_markX > 30){
        Rpanel_markX = Rpanel_markX - 25;
      }
      if(arduboy.justPressed(DOWN_BUTTON) && Rpanel_markY == 15){
       Rpanel_markY = 44;
      }
      if(arduboy.justPressed(UP_BUTTON) && Rpanel_markY == 44){
       Rpanel_markY = 15;
      }

      if(Rpanel_markX == 29 && Rpanel_markY == 15){

        arduboy.setCursor(108, 0);
        arduboy.print (score);   
        arduboy.setCursor(83, 0);
        arduboy.print (house_one);        
        if(arduboy.justPressed(B_BUTTON)){
        house_one = score;
        if(chose_build == 1){
        BuldingsOnMap1 = 1;
        }
        if(chose_build == 2){
        BuldingsOnMap1 = 2;
        }
        if(chose_build == 3){
        BuldingsOnMap1 = 3;
        }
        }
      }
      if(Rpanel_markX == 54 && Rpanel_markY == 15){
        arduboy.setCursor(108, 0);
        arduboy.print (score);
        arduboy.setCursor(83, 0);
        arduboy.print (house_two); 
        if(arduboy.justPressed(B_BUTTON)){
        house_two = score;
        if(chose_build == 1){
        BuldingsOnMap2 = 1;
        }
        if(chose_build == 2){
        BuldingsOnMap2 = 2;
        }
        if(chose_build == 3){
        BuldingsOnMap2 = 3;
        }
       
        }
      }
      if(Rpanel_markX == 79 && Rpanel_markY == 15){
        arduboy.setCursor(108, 0);
        arduboy.print (score);
        arduboy.setCursor(83, 0);
        arduboy.print (house_three); 
        if(arduboy.justPressed(B_BUTTON)){
        house_three = score;
        if(chose_build == 1){
        BuldingsOnMap3 = 1;
        }
        if(chose_build == 2){
        BuldingsOnMap3 = 2;
        }
        if(chose_build == 3){
        BuldingsOnMap3 = 3;
        }
        }
      }
      if(Rpanel_markX == 104 && Rpanel_markY == 15){
        arduboy.setCursor(108, 0);
        arduboy.print (score);
        arduboy.setCursor(83, 0);
        arduboy.print (house_four); 
        if(arduboy.justPressed(B_BUTTON)){
        house_four = score;
        if(chose_build == 1){
        BuldingsOnMap4 = 1;
        }
        if(chose_build == 2){
        BuldingsOnMap4 = 2;
        }
        if(chose_build == 3){
        BuldingsOnMap4 = 3;
        }
        }
      }
      if(Rpanel_markX == 29 && Rpanel_markY == 44){
        arduboy.setCursor(108, 0);
        arduboy.print (score);
        arduboy.setCursor(83, 0);
        arduboy.print (house_five); 
        if(arduboy.justPressed(B_BUTTON)){
        house_five = score;
        if(chose_build == 1){
        BuldingsOnMap5 = 1;
        }
        if(chose_build == 2){
        BuldingsOnMap5 = 2;
        }
        if(chose_build == 3){
        BuldingsOnMap5 = 3;
        }
        }
      }
      if(Rpanel_markX == 54 && Rpanel_markY == 44){
        arduboy.setCursor(108, 0);
        arduboy.print (score);
        arduboy.setCursor(83, 0);
        arduboy.print (house_six); 
        if(arduboy.justPressed(B_BUTTON)){
        house_six = score;
        if(chose_build == 1){
        BuldingsOnMap6 = 1;
        }
        if(chose_build == 2){
        BuldingsOnMap6 = 2;
        }
        if(chose_build == 3){
        BuldingsOnMap6 = 3;
        }
        }
      }        
      if(Rpanel_markX == 79 && Rpanel_markY == 44){
        arduboy.setCursor(108, 0);
        arduboy.print (score);
        arduboy.setCursor(83, 0);
        arduboy.print (house_seven); 
        if(arduboy.justPressed(B_BUTTON)){
        house_seven = score;
        if(chose_build == 1){
        BuldingsOnMap7 = 1;
        }
        if(chose_build == 2){
        BuldingsOnMap7 = 2;
        }
        if(chose_build == 3){
        BuldingsOnMap7 = 3;
        }
        }
      }
      if(Rpanel_markX == 104 && Rpanel_markY == 44){
        arduboy.setCursor(108, 0);
        arduboy.print (score);
        arduboy.setCursor(83, 0);
        arduboy.print (house_eight); 
        if(arduboy.justPressed(B_BUTTON)){
        house_eight = score;
        if(chose_build == 1){
        BuldingsOnMap8 = 1;
        }
        if(chose_build == 2){
        BuldingsOnMap8 = 2;
        }
        if(chose_build == 3){
        BuldingsOnMap8 = 3;
        }
        }
      }  

        if(arduboy.justPressed(B_BUTTON)){
        chengePanelRightEnd = 0;
        score = 0;
        }

}
void gameoverSFX(){
   if(sfx == 1) {
  successY++;
    if(successY < -5) beep.tone(beep.freq(400), 5);
    if(successY > -4 && successY < 0) beep.tone(beep.freq(300), 5);
    if(successY > -1 && successY < 10) beep.tone(beep.freq(100), 8);
   }
}
void menuSFX(){
  if(sfx == 1) {
    if(chengePanelRightEnd == 0 && massegeLast == 0|| massegeLast == 2 ){
     if (arduboy.everyXFrames(3)){
  SFXover++;
     }
     
    if(SFXover < 10) beep.tone(beep.freq(130), 8);
    if(SFXover > 15 && SFXover < 20) beep.tone(beep.freq(196), 5);
    if(SFXover > 25 && SFXover < 30) beep.tone(beep.freq(196), 5);
    if(SFXover > 35 && SFXover < 40) beep.tone(beep.freq(196), 5);
    if(SFXover > 40 && SFXover < 50) beep.tone(beep.freq(130), 8);
    if(SFXover > 55 && SFXover < 60) beep.tone(beep.freq(196), 5);
    if(SFXover > 65 && SFXover < 70) beep.tone(beep.freq(196), 5);
    if(SFXover > 75 && SFXover < 81) beep.tone(beep.freq(98), 5);
    
    if(SFXover > 80 && SFXover < 91) beep.tone(beep.freq(130), 8);
    if(SFXover > 95 && SFXover < 100) beep.tone(beep.freq(196), 5);
    if(SFXover > 105 && SFXover < 110) beep.tone(beep.freq(196), 5);
    if(SFXover > 115 && SFXover < 120) beep.tone(beep.freq(196), 5);
    if(SFXover > 120 && SFXover < 125) beep.tone(beep.freq(130), 3);

    if(SFXover > 125 && SFXover < 130) beep.tone(beep.freq(130), 3);
    if(SFXover > 130 && SFXover < 135) beep.tone(beep.freq(146), 3);
    if(SFXover > 135 && SFXover < 140) beep.tone(beep.freq(164), 3);
    if(SFXover > 140 && SFXover < 145) beep.tone(beep.freq(174), 3);
    if(SFXover > 145 && SFXover < 150) beep.tone(beep.freq(164), 3);
    if(SFXover > 150 && SFXover < 155) beep.tone(beep.freq(146), 3);
    if(SFXover > 155 && SFXover < 160) beep.tone(beep.freq(130), 3);

    
    if(SFXover == 215)SFXover = 0;
   }
    }
}

void achievements(){
  if(stage == 13 && chengePanelRightEnd == 0 ){
    massegeLast = 3;
     if (arduboy.everyXFrames(3)){
  SFXmenu++;
     }
if(sfx == 1) {
    if(SFXmenu < 10) beep.tone(beep.freq(261), 8);
    if(SFXmenu > 15 && SFXmenu < 25) beep.tone(beep.freq(329), 8);
    if(SFXmenu > 35 && SFXmenu < 38) beep.tone(beep.freq(392), 3);
    if(SFXmenu > 38 && SFXmenu < 50) beep.tone(beep.freq(440), 8);

}
    Lpanel_enable = 0;
    Rpanel_enable = 0;
    arduboy.fillRect(10, 11, 109, 47, BLACK);
    if(overmassege == 0){
      arduboy.setCursor(17, 13);
      arduboy.print(F("Congratulations!"));
      arduboy.setCursor(29, 30);
      arduboy.print(F("Construction"));
      arduboy.setCursor(37, 40);
      arduboy.print(F("completed!"));
      
    }

     if(overmassege == 1){
    arduboy.drawRect(20, 21, 20, 20, WHITE);
    arduboy.drawRect(43, 21, 20, 20, WHITE);
    arduboy.drawRect(66, 21, 20, 20, WHITE);
    arduboy.drawRect(89, 21, 20, 20, WHITE); 

    if(arduboy.justPressed(RIGHT_BUTTON) && markAchiveX < 89)  markAchiveX = markAchiveX + 23;
    if(arduboy.justPressed(LEFT_BUTTON) && markAchiveX > 21)  markAchiveX = markAchiveX - 23;


      arduboy.setCursor(30, 12);
      arduboy.print(F("Achievements"));
    if(comboAttainment > 249){
    Sprites::drawOverwrite (20, 21, Allachive, 3);
        if(markAchiveX == 21) {
      arduboy.setCursor(39, 45);
      arduboy.print(F("Eagle eye"));
    }
  }
  if(superComboAttainment > 24){
    Sprites::drawOverwrite (43, 21, Allachive, 2);
            if(markAchiveX == 44) {
      arduboy.setCursor(20, 45);
      arduboy.print(F("Golden building"));
    }
  }
  if(liveAttainment == 0){
    Sprites::drawOverwrite (66, 21, Allachive, 0);
            if(markAchiveX == 67) {
      arduboy.setCursor(49, 45);
      arduboy.print(F("Master"));
    }
  }
  if(allscore > 2000){
    Sprites::drawOverwrite (89, 21, Allachive, 1);
            if(markAchiveX == 90) {
      arduboy.setCursor(40, 45);
      arduboy.print(F("Megapolis"));
    }
  }
      arduboy.drawRect(markAchiveX, 22, 18, 18, WHITE);  
}
}
}
void loop() {
  if (!arduboy.nextFrame()) {
    return;
  }
  beep.timer();
  arduboy.pollButtons();
  arduboy.clear();
  switch ( gamestate ) {

    case 0:
      Sprites::drawOverwrite (0, 0, tittle, 0);
      if (arduboy.justPressed(DOWN_BUTTON) && marks < 2) {
        marks++;
      }
      if (arduboy.justPressed(UP_BUTTON) && marks > 1) {
        marks--;
      }
      if (marks == 1) {
        Sprites::drawOverwrite (58, 31, mark, 0);
        if (arduboy.justPressed(B_BUTTON)) {
          gamestate = 1;
        }
      }
      if (marks == 2) {
        Sprites::drawOverwrite (97, 41, mark, 0);  
        if (arduboy.justPressed(B_BUTTON) && sfx == 2) sfx = 0;        
        if (arduboy.justPressed(B_BUTTON) && sfx == 1) sfx = 2;    
        if (arduboy.justPressed(B_BUTTON) && sfx == 0) sfx = 1;

      }

         if(sfx == 1)  arduboy.fillRect (103, 43, 2, 2, WHITE);

      break;

    case 1:
    
      Sprites::drawOverwrite (0, 0, town, 0);
        if(stage == 13 && chengePanelRightEnd == 0 ) {    if(arduboy.justPressed(B_BUTTON)) overmassege = 1;}
      panels();
      achievements();
      masseges();


      //stage
      arduboy.setCursor(2, 0);
      arduboy.print(stage);
      arduboy.setCursor(13, 0);
      arduboy.print("/");
      arduboy.setCursor(20, 0);
      arduboy.print("13");

      //ALLSCORE
      allscore = house_one + house_two + house_three + house_four + house_five + house_six + house_seven + house_eight;
      arduboy.setCursor(43, 0);
      arduboy.print(allscore);
      


      break;


    case 2:
      background();
      Move();
      buttons();
      MoveDown();
      collideRect();
      MoveBloks();
      upstair();
      scores();
      swingTower();
      live();
      chose_builds();
      drawStair();
      successDraw();
      drawCombo();
      birdfly();
      wind();
      if (arduboy.justPressed(A_BUTTON))      gamestate = 4;
      if(arduboy.justPressed(DOWN_BUTTON))   gamestate = 3;
      if(lives == 0) gamestate = 5;


      break;

    case 3:
      arduboy.setCursor(50, 30);
      arduboy.print(F("PAUSE"));
      if(arduboy.justPressed(DOWN_BUTTON))  gamestate = 2;
      break;
      
    case 4:
      arduboy.setCursor(30, 10);
      arduboy.print(F("If you quit"));
      arduboy.setCursor(25, 25);
      arduboy.print(F("your progress"));
      arduboy.setCursor(27, 40);
      arduboy.print(F("will be lost")); 
      arduboy.setCursor(3, 55);
      arduboy.print(F("A-stay"));
      arduboy.setCursor(90, 55);
      arduboy.print(F("B-quit"));    
      if(arduboy.justPressed(B_BUTTON)){
        resetAll();
        gamestate = 1;
      }
      if(arduboy.justPressed(A_BUTTON)){
        gamestate = 2;
      }
      break;

    case 5:
     arduboy.setCursor(32, 15);
     arduboy.print(F("Construction"));
     arduboy.setCursor(45, 30);
     arduboy.print(F("failed"));
     arduboy.setCursor(90, 55);
     arduboy.print(F("B-quit"));
     gameoverSFX();
     if(arduboy.justPressed(B_BUTTON)){
     resetAll();
     gamestate = 1;
      }
     break;

     

  }

  arduboy.display();

}
