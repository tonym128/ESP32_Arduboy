//	Circuit Dude
//	Version 3.1, Aug 6, 2019
//	By Jonathan Holmes (crait)
//
//	Website: http://www.crait.net/
//	Twitter: @crait (http://www.twitter.com/crait)
//
//	Get this game on Steam! https://store.steampowered.com/app/662410/Circuit_Dude/
//	(Also available for Nintendo Switch, PC, macOS, iOS, Android, LDK Game, BittBoy, PyBadge, and PyGamer)
//
//	Help Circuit Dude build an awesome invention by leading him
//	through 75 unique levels, completing circuits and plugging
//	in microchips. After all of the chips are inserted into their
//	sockets, the exit will activate and you can advance to the
//	next puzzle! What kind of secret invention is Circuit Dude
//	building? Complete all 75 levels to find out!
//
//	The fun doesn't stop there, though! You can build your own
//	levels with the built-in level editor or by downloading the
//	Circuit Dude Level Tool from my website. You can use it to
//	save them to your computer to share your own creations online!
//
//	Circuit Dude Level Tool: http://www.crait.net/download.php?file=CircuitDudeLevelTool.zip
//
//	Release History:
//	3.1 - Aug 6, 2019
//		Added download/upload options to transfer levels to/from the PC to save them and play them on other systems
//		Saves audio mute state to EEPROM
//	3.0 - July 27, 2019
//		Re-wrote and refactored the entire game
//		Created a level editor for making custom levels
//		Added 25+ new levels
//		Added in teleportation pads, conveyor reversal buttons, and changed heatsinks to trap doors
//		Re-arranged the levels in order to match the full version more closely
//		Changed the aesthetic layout of many levels
//		Updated the in-game graphics to match the full version
//		Updated the logo, imagery, and branding to match the full version
//		Updated the level drawing to save some space
//		Changed memory location of the current level in EEPROM
//	2.1 - Feb 26, 2017
//	2.0 - Jan 9, 2017
//	1.11 - Dec 5, 2016
//	1.0 - Nov 17, 2016
//
//License:
//	Code is supplied for 2 purposes: 1) Ease of loading onto an Arduboy device for personal
//	play, and 2) Educational value in the case of studying the code and modifying for personal,
//	educational use. Even though the source code is available to the public, this software is
//	not 'open-source'. Re-releasing my code/game, re-distributing my code/game, or publicly
//	sharing a modified variation or derivative of my code/game is not allowed. The code has no
//	guarantee of support in the future. The code is also free of charge in order to play. This
//	code must never be sold. This game must never be sold. Distribution of my game/code for
//	commercial or financial gain is explicitly NOT allowed. Finally, someone creating a new
//	version of the game for a different platform with imagery, gameplay elements, or game
//	design element derived from this game must have explicit permission from me if it is
//	intended to be released or distributed to others.

#include <ESP8266WiFi.h>
#include <Arduboy2.h>
Arduboy2 arduboy;
#include <Arduboy2Beep.h>
BeepPin1 beep;

#define SOUND_MENU_EXIT			215
#define SOUND_MENU_BACK			215
#define SOUND_MENU_TOGGLE		325
#define SOUND_MENU_PICK			325
#define SOUND_MENU_NEXT			425
#define SOUND_MENU_SCROLL		400

#define SOUND_EXPLOSION_1		600
#define SOUND_EXPLOSION_2		700
#define SOUND_EXPLOSION_3		400
#define SOUND_EXPLOSION_4		100

#define SOUND_FALL				50
#define SOUND_TELE				100
#define SOUND_CON				100
#define SOUND_CONB				310
#define SOUND_CAPB				350
#define SOUND_ROTB				425
#define SOUND_ROT				250
#define SOUND_TRAPO				140
#define SOUND_CHIPO				475
#define SOUND_LEVELCOMPLETE		700

#define SOUND_TINY				1
#define SOUND_SHORT				8
#define SOUND_MED				16
#define SOUND_LONG				35

const unsigned char explosionsounds[] PROGMEM = { 6, 7, 4, 1 };

void sound(int pitch, unsigned char duration) {
	if(arduboy.audio.enabled()) {
		beep.tone(beep.freq(pitch), duration);
	}
}

void clearserialbuffer() {
	while(Serial.available()) {
		Serial.read();
	}
}

const unsigned char circuitdude[] PROGMEM = {
	0x00, 0x00, 0x80, 0xc0, 0x40, 0x60, 0xa0, 0xa0, 0xb0, 0xd0, 0xd8, 0xe8,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 0x00
};

const unsigned char leftarm[] PROGMEM = {
	0x00, 0xe0, 0x30, 0xd8, 0xe8, 0xe8, 0x6c, 0xe4, 0xd6, 0xba, 0x7a, 0xba, 0x9a, 0xc6, 0x3c, 0xe0, 0xba, 0xbb, 0xb9, 0xa4, 0x93, 0xa7, 0x8c, 0x9b, 0xbb, 0xd3, 0x80, 0xb7, 0xbb, 0xd9, 0x60, 0x3f
};

const unsigned char rightarm[] PROGMEM = {
	0xf0, 0x18, 0xec, 0xf6, 0xba, 0x3a, 0x7b, 0x71, 0x80, 0x37, 0x9b, 0xcd, 0xe5, 0xf5, 0xf8, 0xfd, 0x3f, 0x60, 0xcf, 0x9f, 0xbf, 0xbf, 0x6f, 0x5f
};

const unsigned char me[] PROGMEM = {
	0x45, 0x8a, 0x15, 0xaa, 0x15, 0xaa, 0xd5, 0x6a, 0x34, 0x28, 0x21, 0x32, 0x1d, 0x0a, 0x0c, 0x06, 0x03, 0x02, 0x07, 0x02, 0x23, 0x41, 0xa0, 0x41, 0x80, 0x40, 0x81, 0x40, 0x20, 0x80, 0x40, 0x80,
	0x40, 0x20, 0x08, 0xc7, 0x7d, 0xa2, 0x55, 0xa2, 0x51, 0xa8, 0x15, 0x88, 0x44, 0xa2, 0x51, 0xaa, 0x54, 0xa8, 0x51, 0x82, 0x05, 0xff, 0x00, 0x00, 0x41, 0x80, 0x80, 0x00, 0x80, 0xe0, 0xf0, 0xf0,
	0xf0, 0xf0, 0xe0, 0x60, 0x60, 0x60, 0x68, 0xed, 0xe4, 0xe3, 0xe0, 0xe0, 0x61, 0x72, 0xe1, 0x02, 0xe1, 0x32, 0x1a, 0xaf, 0x11, 0x88, 0x54, 0x8a, 0x45, 0x2a, 0x05, 0x92, 0x45, 0xa2, 0x41, 0xa0,
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	0xdb, 0x57, 0xa7, 0xcf, 0xb7, 0x8b, 0xfa, 0xf6, 0x76, 0xa6, 0xca, 0x76, 0xea, 0x9c, 0x5f, 0xdf, 0xc0, 0xfe, 0xfe, 0xff, 0xff, 0xff, 0xff, 0x0f, 0xb6, 0xb9, 0xfb, 0xf8, 0xf3, 0xf7, 0xff, 0xf8
};

const unsigned char jonathan[] PROGMEM = {
	0x20, 0x40, 0x41, 0x3f, 0x01, 0x00, 0x38, 0x44,
	0x44, 0x44, 0x38, 0x00, 0x7c, 0x08, 0x04, 0x04,
	0x78, 0x00, 0x20, 0x54, 0x54, 0x78, 0x40, 0x00,
	0x04, 0x04, 0x3f, 0x44, 0x24, 0x00, 0x7f, 0x08,
	0x04, 0x04, 0x78, 0x00, 0x20, 0x54, 0x54, 0x78,
	0x40, 0x00, 0x7c, 0x08, 0x04, 0x04, 0x78
};

const unsigned char holmes[] PROGMEM = {
	0x7f, 0x08, 0x08, 0x08, 0x7f, 0x00, 0x38, 0x44,
	0x44, 0x44, 0x38, 0x00, 0x00, 0x41, 0x7f, 0x40,
	0x00, 0x00, 0x7c, 0x04, 0x78, 0x04, 0x78, 0x00,
	0x38, 0x54, 0x54, 0x54, 0x18, 0x00, 0x48, 0x54,
	0x54, 0x54, 0x24
};

const unsigned char at[] PROGMEM = {
	0x3e, 0x41, 0x5d, 0x59, 0x4e
};

const unsigned char crait[] PROGMEM = {
	0x38, 0x44, 0x44, 0x44, 0x28, 0x00, 0x7c, 0x08,
	0x04, 0x04, 0x08, 0x00, 0x20, 0x54, 0x54, 0x78,
	0x40, 0x00, 0x00, 0x44, 0x7d, 0x40, 0x00, 0x00,
	0x04, 0x04, 0x3f, 0x44, 0x24
};

const unsigned char net[] PROGMEM = {
	0x60, 0x60, 0x00, 0x00, 0x7c, 0x08, 0x04, 0x04,
	0x78, 0x00, 0x38, 0x54, 0x54, 0x54, 0x18, 0x00,
	0x04, 0x04, 0x3f, 0x44, 0x24
};

const unsigned char also[] PROGMEM = {
	0x7f, 0x41, 0x75, 0x41, 0x7f, 0x41, 0x5f, 0x5f,
	0x7f, 0x59, 0x55, 0x4d, 0x7f, 0x41, 0x5d, 0x41,
	0x7f, 0x7f, 0x7f, 0x7f, 0x41, 0x75, 0x41, 0x7f,
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	0x7d, 0x41, 0x7f, 0x6b, 0x7f
};

const unsigned char circuit[] PROGMEM = {
	0xfc, 0xfe, 0xff, 0x07, 0xf7, 0x17, 0x07, 0x3f,
	0x3e, 0x3c, 0x00, 0x00, 0xff, 0xff, 0xff, 0x00,
	0x00, 0xff, 0xff, 0xff, 0xc7, 0xd7, 0xd7, 0xc7,
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	0x7f, 0x7f, 0x7f, 0x00, 0x00, 0x00,
};

const unsigned char dude[] PROGMEM = {
	0xff, 0xff, 0xff, 0x07, 0xf7, 0x07, 0x07, 0xff,
	0xfe, 0xfc, 0x00, 0x00, 0xff, 0xff, 0xff, 0x00,
	0xff, 0x00, 0x00, 0xff, 0xff, 0xff, 0x00, 0x00,
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	0x7f, 0x7f, 0x7f, 0x71, 0x75, 0x75, 0x71, 0x70,
};

const unsigned char ending_circle_1[] PROGMEM = {
	0x00, 0x00, 0x00, 0x00, 0x00, 0x00, 0x00, 0x00,
	0x00, 0x00, 0x00, 0x00, 0x80, 0x80, 0xc0, 0xe0,
	0xd0, 0x50, 0x00, 0x48, 0x40, 0xe0, 0xf0, 0xf0,
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	0x00, 0x00, 0x00, 0x00, 0x00, 0x00, 0x00, 0x00
};

const unsigned char ending_circle_2[] PROGMEM = {
	0x00, 0x00, 0x00, 0x00, 0x00, 0x00, 0x00, 0x00, 
	0x00, 0x00, 0x00, 0x00, 0x00, 0x00, 0x00, 0x00, 
	0x00, 0x00, 0x00, 0x00, 0x00, 0x00, 0x00, 0x00, 
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	0x00, 0x00, 0x00, 0x00, 0x00, 0x00, 0x00, 0x00
};

const unsigned char ending_label[] PROGMEM = {
	0x7f, 0x7d, 0x41, 0x7d, 0x7f, 0x41, 0x77, 0x41, 
	0x7f, 0x41, 0x55, 0x7f, 0x7f, 0x41, 0x55, 0x7f, 
	0x41, 0x7b, 0x77, 0x41, 0x7f, 0x41, 0x5d, 0x63, 
	0x7f
};

const unsigned char ending_table[] PROGMEM = {
	0x00, 0x00, 0x00, 0x00, 0x00, 0x00, 0x00, 0x00, 
	0x00, 0x00, 0x00, 0x00, 0x00, 0x80, 0x80, 0xc0, 
	0x40, 0x40, 0x20, 0x20, 0x10, 0x10, 0x88, 0xc8, 
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	0x64, 0x6c, 0x68, 0x78, 0x70, 0x70, 0xe0, 0xe0
};

const unsigned char ending_laughing_face[] PROGMEM = {
	0x00, 0x00, 0x00, 0x00, 0x00, 0x00, 0x00, 0x00, 
	0x80, 0x80, 0xc0, 0x40, 0x40, 0x60, 0xb0, 0xd8, 
	0xe8, 0xd8, 0xd0, 0x90, 0x10, 0x50, 0x50, 0xd0, 
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	0x9f, 0x47, 0xf0, 0x8f, 
};

const unsigned char ending_laughing_body[] PROGMEM = {
	0x01, 0x0e, 0xf0, 0x87, 0x3f, 0xdf, 0x6f, 0xb3, 
	0xdd, 0xde, 0xde, 0xbe, 0x7d, 0xfb, 0x77, 0xb7, 
	0xcf, 0x3f, 0xff, 0xff, 0xff, 0xff, 0xff, 0xff, 
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	0x05, 0x05, 0x05, 0x04
};

const unsigned char ending_laughing_arm[] PROGMEM = {
	0x9e, 0x6e, 0xf7, 0xfa, 0xf9, 0xfb, 0xf6, 0xf4, 
	0xf4, 0x04, 0xf6, 0xfa, 0xfb, 0x79, 0x7a, 0x37, 
	0x2f, 0x1f, 0x1f, 0x1f, 0x0c, 0x03, 0x00, 0x01, 
	0x01, 0x02, 0x02, 0x06, 0x05, 0x01, 0x01, 0x00, 
	0x01, 0x01, 0x00, 0x00, 0x00, 0x00, 0x00, 0x00, 
	0x00, 0x00, 0x00, 0x00, 0x00, 0x00
};

const unsigned char ending_laughing_right[] PROGMEM = {
	0x00, 0x00, 0x00, 0x80, 0xf0, 0x1c, 0x66, 0x7b, 
	0x7d, 0x3d, 0xbd, 0x9b, 0x46, 0x3c, 0x00, 0xf8, 
	0x0c, 0xf4, 0xf4, 0xf4, 0xec, 0xd8, 0x30, 0xe0, 
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	0xb7, 0xbb, 0x9d, 0x9e, 0x6e, 0xf7, 0xfa, 0xf9
};

const unsigned char ending_laughing_left[] PROGMEM = {
	0x00, 0x00, 0xe0, 0x38, 0xce, 0xf3, 0xfd, 0xfd, 
	0x3d, 0xc3, 0xfe, 0x80, 0x00, 0xf0, 0x18, 0xe8, 
	0xe8, 0xe8, 0x18, 0xf0, 0x80, 0x00, 0x00, 0x00, 
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	0x0b, 0x0b, 0x09, 0x04, 0x03, 0x00
};

const unsigned char ending_smile_face[] PROGMEM = {
	0x00, 0x00, 0x00, 0x00, 0x00, 0x00, 0xfc, 0x04, 
	0xf6, 0xea, 0xeb, 0xdd, 0x5d, 0x8d, 0xed, 0xed, 
	0xcb, 0xca, 0x9a, 0x9a, 0x1a, 0x5a, 0x5a, 0xda, 
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	0xff, 0xff, 0xff, 0x0f, 0xe0, 0xbf, 0x80, 0x00
};

const unsigned char ending_smile_body[] PROGMEM = {
	0xf8, 0x0c, 0xf6, 0xf3, 0xf5, 0x76, 0xae, 0xdf, 
	0xdf, 0xdf, 0x1f, 0xcf, 0xee, 0xe5, 0x03, 0xf7, 
	0xfb, 0x03, 0xfb, 0xfb, 0xfb, 0xfc, 0x0c, 0xfc, 
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	0x33, 0x1e
};

const unsigned char ending_smile_body_back[] PROGMEM = {
	0x10, 0x19, 0x0e, 0x08, 0x0c, 0x07, 0x02, 0x04,
	0x07, 0x04, 0x08, 0x08, 0x08, 0x07, 0x08, 0x08,
	0x08, 0x07, 0x08, 0x10, 0x20, 0x21, 0x20, 0x21,
	0x23, 0x1c, 0x00, 0x00, 0x00, 0x00, 0x00, 0x00,
	0x00, 0x00, 0x00, 0x39, 0x25, 0x24, 0x22, 0x3a,
	0x46, 0x45, 0x63, 0x92, 0x92, 0x8a, 0x45
};

const unsigned char saved[] PROGMEM = {
	0x7f, 0x59, 0x55, 0x4d, 0x7f, 0x41, 0x75, 0x41,
	0x7f, 0x61, 0x5f, 0x61, 0x7f, 0x41, 0x55, 0x5d,
	0x7f, 0x41, 0x5d, 0x63, 0x7f
};

const unsigned char level[] PROGMEM = {
	0x7f, 0x41, 0x5f, 0x5f, 0x7f, 0x41, 0x55, 0x5d,
	0x7f, 0x61, 0x5f, 0x61, 0x7f, 0x41, 0x55, 0x5d,
	0x7f, 0x41, 0x5f, 0x5f, 0x7f
};

const unsigned char lock[] PROGMEM = {
	0x7e, 0x79, 0x59, 0x79, 0x7e
};

const unsigned char arrowup[] PROGMEM = {
	0x08, 0x0c, 0x0e, 0x0f, 0x0e, 0x0c, 0x08
};

const unsigned char arrowdown[] PROGMEM = {
	0x01, 0x03, 0x07, 0x0f, 0x07, 0x03, 0x01
};

const unsigned char menulabels[9][21] PROGMEM = {
	//Play
	{
		0x7f, 0x41, 0x75, 0x71, 0x7f, 0x41, 0x5f, 0x5f,
		0x7f, 0x41, 0x75, 0x41, 0x7f, 0x79, 0x47, 0x79,
		0x7f, 0x7f, 0x7f, 0x7f, 0x7f
	},
	//Edit
	{
		0x7f, 0x41, 0x55, 0x5d, 0x7f, 0x41, 0x5d, 0x63,
		0x7f, 0x5d, 0x41, 0x5d, 0x7f, 0x7d, 0x41, 0x7d,
		0x7f, 0x7f, 0x7f, 0x7f, 0x7f
	},
	//About
	{
		0x7f, 0x41, 0x75, 0x41, 0x7f, 0x41, 0x55, 0x4b,
		0x7f, 0x41, 0x5d, 0x41, 0x7f, 0x41, 0x5f, 0x41,
		0x7f, 0x7d, 0x41, 0x7d, 0x7f
	},
	//Sound
	{
		0x7f, 0x59, 0x55, 0x4d, 0x7f, 0x41, 0x5d, 0x41,
		0x7f, 0x41, 0x5f, 0x41, 0x7f, 0x41, 0x7d, 0x41,
		0x7f, 0x41, 0x5d, 0x63, 0x7f
	},
	//Save
	{
		0x7f, 0x59, 0x55, 0x4d, 0x7f, 0x41, 0x75, 0x41,
		0x7f, 0x61, 0x5f, 0x61, 0x7f, 0x41, 0x55, 0x5d,
		0x7f, 0x7f, 0x7f, 0x7f, 0x7f,
	},
	//Exit
	{
		0x7f, 0x41, 0x55, 0x5d, 0x7f, 0x49, 0x77, 0x49,
		0x7f, 0x5d, 0x41, 0x5d, 0x7f, 0x7d, 0x41, 0x7d,
		0x7f, 0x7f, 0x7f, 0x7f, 0x7f
	},
	//Clear
	{
		0x7f, 0x41, 0x5d, 0x5d, 0x7f, 0x41, 0x5f, 0x5f,
		0x7f, 0x41, 0x55, 0x5d, 0x7f, 0x41, 0x75, 0x41,
		0x7f, 0x41, 0x75, 0x49, 0x7f
	},
	//Read
	{
		0x7f, 0x41, 0x75, 0x49, 0x7f, 0x41, 0x55, 0x5d,
		0x7f, 0x41, 0x75, 0x41, 0x7f, 0x41, 0x5d, 0x63,
		0x7f, 0x7f, 0x7f, 0x7f, 0x7f
	},
	//Send
	{
		0x7f, 0x59, 0x55, 0x4d, 0x7f, 0x41, 0x55, 0x5d,
		0x7f, 0x41, 0x7d, 0x41, 0x7f, 0x41, 0x5d, 0x63,
		0x7f, 0x7f, 0x7f, 0x7f, 0x7f
	}
};

const unsigned char usb[] PROGMEM = {
	0x7f, 0x7f, 0x63, 0x63, 0x77, 0x73, 0x65, 0x55,
	0x55, 0x77, 0x63, 0x77
};

const unsigned char soundlabel[] PROGMEM = {
	0x08, 0x1c, 0x00, 0x08, 0x22, 0x1c
};

const unsigned char numbers[10][3] PROGMEM = {
	{0x3e, 0x22, 0x3e },
	{0x24, 0x3e, 0x20 },
	{0x32, 0x2a, 0x24 },
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	{0x2e, 0x2a, 0x3e }
};

const unsigned char platforms[4][144] PROGMEM = {
	{ 0xf8, 0xfc, 0x6, 0xc3, 0xe1, 0xe1, 0xe1, 0xc1, 0x1, 0xff, 0xff, 0x00, 0x00,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 0x3f, 0x1f },
	{ 0x00, 0x00, 0x80, 0x80, 0x80, 0x00, 0x00, 0x00, 0x00, 0x00, 0x00, 0x00, 0x00,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 0x00, 0x00 },
	{ 0xfe, 0xff, 0xff, 0xfe, 0xfc, 0xf8, 0xf2, 0xe6, 0xcc, 0x1c, 0x78, 0xf8, 0xf0,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 0x00, 0x00 },
	{ 0x00, 0x00, 0x00, 0x00, 0x00, 0x00, 0x00, 0x00, 0xc, 0x9e, 0xfe, 0xfc, 0xf8,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 0x7, 0x3 }
};

const unsigned char sidebar[] PROGMEM = {
	0xfe, 0x02, 0xaa, 0x82, 0xaa, 0x02, 0xe2, 0x36,
	0x24, 0x34, 0x24, 0x36, 0xe2, 0x02, 0xf2, 0x9e,
	0x0f, 0x98, 0xfb, 0x0a, 0xfb, 0x98, 0x09, 0x0b,
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	0x08, 0x08, 0x98, 0xf8, 0x08, 0xfa, 0x98, 0x0f
};

const unsigned char thermostat[] PROGMEM = {
	0x00, 0x00, 0xfe, 0x01, 0x01, 0xfe, 0x00, 0x00,
	0x00, 0x00, 0xff, 0x00, 0x00, 0xff, 0x00, 0x00,
	0x00, 0x00, 0xff, 0x00, 0x00, 0xff, 0x00, 0x00,
	0x18, 0x3c, 0x7f, 0x80, 0x80, 0x7f, 0x3c, 0x18
};

#define WAVE_WIDTH 27
const unsigned char wave[] PROGMEM = {
	0x88, 0x84, 0x84, 0x88, 0x90, 0xa0, 0xa0, 0x90,
	0x88, 0x84, 0x82, 0x81, 0x82, 0x84, 0x98, 0xa0,
	0xc0, 0xa0, 0x98, 0x84, 0x82, 0x84, 0x88, 0x90,
	0xa0, 0xa0, 0x90
};

const unsigned char lv[] PROGMEM = {
	0x7f, 0x41, 0x5f, 0x7f, 0x61, 0x5f, 0x61
};

const unsigned char transfering[] PROGMEM = {
	0x7f, 0x7d, 0x41, 0x7d, 0x7f, 0x41, 0x75, 0x4b,
	0x7f, 0x41, 0x75, 0x41, 0x7f, 0x41, 0x7d, 0x41,
	0x7f, 0x59, 0x55, 0x4d, 0x7f, 0x41, 0x75, 0x7d,
	0x7f, 0x41, 0x55, 0x5d, 0x7f, 0x41, 0x75, 0x4b,
	0x7f, 0x5d, 0x41, 0x5d, 0x7f, 0x41, 0x7d, 0x41,
	0x7f, 0x43, 0x5d, 0x4d, 0x7f
};

const unsigned char to[] PROGMEM = {
	0x7f, 0x7d, 0x41, 0x7d, 0x7f, 0x41, 0x5d, 0x41,
	0x7f, 0x7f, 0x7f, 0x7f
};

const unsigned char from[] PROGMEM = {
	0x7f, 0x41, 0x75, 0x7d, 0x7f, 0x41, 0x75, 0x4b,
	0x7f, 0x41, 0x5d, 0x41, 0x7f, 0x41, 0x73, 0x41,
	0x7f, 0x7f, 0x7f, 0x7f
};

const unsigned char pc[] PROGMEM = {
	0x7f, 0x41, 0x75, 0x71, 0x7f, 0x41, 0x5d, 0x5d,
	0x7f
};

#define MAIN_OFFSET	5

#define TRAP_C		0
#define CAP_O		1
#define CAP_B		2
#define ROT_B		3
#define CON_B		4
#define CHIP_O		5
#define TELE		6
#define TELE_2		7
#define TELE_3		8
#define BLANK		7
#define EXIT		9
#define EXIT_2		10
#define EXIT_3		11
#define TRAP_O		12
#define START		13
#define DUDE		13
#define DUDE_PUFF	14
#define DUDE_BACK	31

#define BLOCK		15
#define LED			16
#define CHIP_I		17
#define CAP_I		18
#define LED_ON		19

#define CON_U		20
#define CON_D		21
#define CON_L		22
#define CON_R		23
#define ROT_H		24
#define ROT_V		25
#define ROT_TL		26
#define ROT_TR		27
#define ROT_BL		28
#define ROT_BR		29

#define HOLD		30

const unsigned char blocks[][8] PROGMEM = {
	{ 0xff, 0x81, 0x81, 0xf1, 0x8f, 0x81, 0x81, 0xff },
	{ 0x2a, 0x1, 0x80, 0x1, 0x80, 0x1, 0x80, 0x54 },
	{ 0x00, 0x14, 0x40, 0x1a, 0x58, 0x2, 0x28, 0x00 },
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	{ 0x38, 0xff, 0xff, 0x7f, 0x7f, 0xff, 0xff, 0x38 }
};

const unsigned char explosion[8][8] PROGMEM = {
	{ 0x39, 0x9e, 0xe1, 0x4d, 0x4d, 0xe1, 0x9b, 0x34 },
	{ 0x3b, 0x94, 0xe1, 0x4d, 0x48, 0xe1, 0x99, 0x36 },
	{ 0x2a, 0x90, 0xc5, 0x5, 0x48, 0x81, 0xa8, 0x45 },
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	{ 0xe, 0xfe, 0xfe, 0x70, 0x40, 0xc7, 0xc7, 0x7 }
};

const unsigned char conveyors[16][8] PROGMEM = {
	{ 0xff, 0xe7, 0xb3, 0x99, 0x99, 0xb3, 0xe7, 0xff },
	{ 0xff, 0xb3, 0x99, 0xcd, 0xcd, 0x99, 0xb3, 0xff },
	{ 0xff, 0x99, 0xcd, 0xe7, 0xe7, 0xcd, 0x99, 0xff },
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	{ 0xff, 0xe7, 0xbd, 0x99, 0xc3, 0xe7, 0xbd, 0xff }
};

const unsigned char walls[6][4] PROGMEM = {
	{ 0x00, 0xe, 0xe, 0x6 },
	{ 0x6, 0xe, 0xe, 0x00 },
	{ 0x00, 0x7, 0x7, 0x6 },
	{ 0x6, 0x7, 0x7, 0x00 },
	{ 0x6, 0x6, 0x6, 0x6 },
	{ 0x00, 0xf, 0xf, 0x00 }
};

const signed char corners[4][2] = {
	{ -1, -1 }, { 1, -1 }, { -1, 1 }, { 1, 1 }
};

#define WALL_TL			0
#define WALL_TR			1
#define WALL_BL			2
#define WALL_BR			3
#define WALL_H			4
#define WALL_V			5

#define PROP_X			0
#define PROP_Y			1

#define SAVELOCATION	(EEPROM_STORAGE_SPACE_START + 412)
#define CUSTOMLOCATION	(EEPROM_STORAGE_SPACE_START + 90)
#define FRAMERATE		45

#define STATE_CREDITS	0
#define STATE_SYSTEMS	1
#define STATE_SOUND		9
#define STATE_TITLE		10
#define STATE_SELECT_GAME	23
#define STATE_SELECT_EDIT	24
#define STATE_SELECT	25
#define	STATE_EDIT_BUFFER	28
#define	STATE_EDIT_LOAD	29
#define	STATE_EDITOR	30
#define STATE_GAME		39
#define STATE_GAMEPLAY	40
#define STATE_ENDING_1	50
#define STATE_ENDING_2	51
#define STATE_ENDING_3	52
#define STATE_ENDING_4	53
#define STATE_ENDING_5	54

const unsigned char menudirection[] = {
	STATE_SELECT_GAME,
	STATE_SELECT_EDIT,
	STATE_CREDITS,
	STATE_SOUND
};

#define LEVELS			75
#define CUSTOMLEVELS	5
#define TEMP_MAX		33
#define TIME_EXPLOSION	32
#define TIME_TELE		32
#define TIME_MOVE		8
#define TIME_FALL		32

#define DIR_UP			0
#define DIR_DOWN		1
#define DIR_LEFT		2
#define DIR_RIGHT		3
#define DIR_STAY		4
#define DIR_TELE		10
#define DIR_FALL		11
#define DIR_SPAWNED		99

const unsigned char dirbuttons[4] PROGMEM = {
	UP_BUTTON,
	DOWN_BUTTON,
	LEFT_BUTTON,
	RIGHT_BUTTON
};

unsigned char animation = 0;
unsigned char wavex = 0;
boolean casting = false;

unsigned char gamestate = STATE_CREDITS;
unsigned char menuindex = 0;
#define MENU_PLAY	0
#define MENU_EDIT	1
#define MENU_ABOUT	2
#define MENU_SOUND	3

unsigned char buttonblock = 0;

unsigned char currentlevel = 0;
unsigned char menulevel = 0;
unsigned char maxlevel = 0;

#define EDIT_PICKING	0
#define EDIT_TILE		1
#define EDIT_MENU		2
#define EDIT_READING	3
#define EDIT_SENDING	4
unsigned char editx = 3;
unsigned char edity = 3;
unsigned char editstate = EDIT_MENU;
unsigned char edittile = 0;
unsigned char editmenu = 0;

const unsigned char edititems[7] PROGMEM = {
	1,	//Edit
	0,	//Play
	6,	//Clear
	7,	//Read
	8,	//Send
	4,	//Save
	5	//Exit
};

#define EDIT_EDIT	0
#define EDIT_PLAY	1
#define EDIT_CLEAR	2
#define EDIT_READ	3
#define EDIT_SEND	4
#define EDIT_SAVE	5
#define EDIT_EXIT	6

#define EDITOR_TILES	24
const unsigned char edittiles[EDITOR_TILES] PROGMEM = {
	BLOCK,
	BLANK,
	START,
	EXIT,
	CHIP_O,
	LED,
	CON_B,
	CON_U,
	CON_D,
	CON_L,
	CON_R,
	TRAP_C,
	TRAP_O,
	CAP_B,
	CAP_O,
	CAP_I,
	TELE,
	ROT_B,
	ROT_H,
	ROT_V,
	ROT_TL,
	ROT_TR,
	ROT_BL,
	ROT_BR
};

unsigned char temperature = 0;
boolean levelcomplete = false;
unsigned char posx = 0;
unsigned char posy = 0;
char aposx = 0;
char aposy = 0;
unsigned char movetimer = 0;
unsigned char state = DIR_SPAWNED;
unsigned char tele[2][2];

const unsigned char maps[LEVELS][70] PROGMEM = {
	{
		// Level 1
		123, 222, 247, 189, 239, 121, 206, 115, 156, 239, 121, 218,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 239
	}, {
		// Level 2
		123, 222, 247, 189, 239, 124, 14, 115, 156, 239, 121, 206,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 239
	}, {
		// Level 3
		123, 222, 247, 189, 239, 121, 78, 115, 156, 175, 121, 222,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 239
	}, {
		// Level 4
		123, 222, 247, 189, 239, 121, 206, 115, 156, 239, 121, 206,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 239
	}, {
		// Level 5
		41, 74, 247, 188, 165, 41, 74, 247, 188, 165, 41, 203,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 239
	}, {
		// Level 6
		124, 15, 3, 192, 239, 121, 206, 115, 156, 239, 123, 222,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 239
	}, {
		// Level 7
		41, 74, 247, 156, 231, 43, 203, 83, 221, 231, 41, 74,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 231
	}, {
		// Level 8
		123, 222, 247, 189, 239, 124, 14, 115, 158, 15, 121, 218,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 239
	}, {
		// Level 9
		57, 206, 247, 156, 231, 59, 78, 82, 157, 39, 57, 206,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 231
	}, {
		// Level 10
		123, 222, 247, 189, 239, 121, 233, 74, 82, 140, 121, 30,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 239
	}, {
		// Level 11
		41, 94, 119, 156, 231, 41, 94, 119, 157, 167, 41, 78,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 207
	}, {
		// Level 12
		145, 222, 119, 156, 231, 145, 222, 112, 29, 39, 145, 222,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 231
	}, {
		// Level 13
		123, 222, 247, 189, 239, 121, 206, 114, 148, 239, 121, 196,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 239
	}, {
		// Level 14
		123, 222, 247, 156, 231, 121, 74, 82, 149, 242, 121, 68,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 167
	}, {
		// Level 15
		75, 206, 114, 148, 231, 11, 206, 114, 148, 231, 11, 196,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 239
	}, {
		// Level 16
		123, 222, 247, 189, 239, 61, 40, 32, 208, 231, 43, 222,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 239
	}, {
		// Level 17
		123, 222, 247, 150, 69, 57, 206, 119, 148, 69, 41, 94,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 71
	}, {
		// Level 18
		17, 232, 114, 148, 165, 57, 222, 82, 148, 165, 187, 222,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 231
	}, {
		// Level 19
		123, 222, 250, 214, 183, 121, 74, 91, 20, 183, 121, 74,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 239
	}, {
		// Level 20
		41, 74, 82, 189, 239, 41, 74, 82, 190, 16, 121, 94,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 165
	}, {
		// Level 21
		129, 206, 115, 132, 33, 57, 210, 35, 132, 33, 129, 218,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 239
	}, {
		// Level 22
		57, 206, 243, 157, 231, 59, 79, 147, 159, 37, 57, 206,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 239
	}, {
		// Level 23
		129, 206, 115, 156, 231, 129, 198, 118, 157, 39, 129, 206,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 165
	}, {
		// Level 24
		123, 222, 247, 157, 169, 120, 202, 83, 156, 231, 121, 94,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 239
	}, {
		// Level 25
		123, 222, 247, 190, 16, 123, 222, 247, 190, 16, 129, 248,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 16
	}, {
		// Level 26
		123, 222, 247, 189, 239, 63, 56, 83, 243, 143, 110, 250,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 239
	}, {
		// Level 27
		57, 68, 83, 156, 231, 57, 70, 87, 189, 231, 57, 74,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 239
	}, {
		// Level 28
		123, 222, 253, 103, 60, 57, 206, 115, 210, 152, 43, 202,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 61
	}, {
		// Level 29
		59, 222, 242, 148, 165, 62, 51, 130, 148, 165, 59, 206,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 148
	}, {
		// Level 30
		57, 206, 247, 189, 239, 60, 14, 247, 189, 239, 57, 206,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 7
	}, {
		// Level 31
		123, 206, 115, 188, 229, 131, 206, 125, 228, 229, 105, 206,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 239
	}, {
		// Level 32
		45, 232, 115, 214, 229, 45, 222, 51, 190, 229, 45, 222,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 197
	}, {
		// Level 33
		123, 222, 247, 189, 239, 121, 206, 119, 156, 239, 121, 204,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 239
	}, {
		// Level 34
		41, 94, 247, 189, 239, 41, 138, 82, 149, 175, 121, 94,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 239
	}, {
		// Level 35
		57, 223, 122, 82, 143, 73, 223, 119, 190, 207, 105, 206,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 239
	}, {
		// Level 36
		51, 222, 247, 189, 239, 169, 76, 82, 148, 39, 59, 222,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 148
	}, {
		// Level 37
		41, 74, 87, 148, 197, 41, 74, 87, 148, 165, 41, 74,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 165
	}, {
		// Level 38
		123, 222, 247, 189, 239, 123, 222, 82, 149, 239, 123, 222,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 239
	}, {
		// Level 39
		123, 222, 114, 148, 165, 123, 222, 114, 148, 197, 121, 206,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 229
	}, {
		// Level 40
		105, 74, 87, 148, 165, 41, 74, 115, 152, 165, 41, 74,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 165
	}, {
		// Level 41
		123, 222, 247, 189, 239, 123, 78, 84, 148, 239, 125, 174,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 239
	}, {
		// Level 42
		57, 206, 115, 148, 165, 187, 222, 243, 148, 164, 187, 207,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 165
	}, {
		// Level 43
		123, 222, 247, 189, 239, 57, 206, 116, 156, 175, 43, 222,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 162
	}, {
		// Level 44
		130, 90, 115, 148, 37, 123, 222, 249, 20, 165, 123, 222,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 239
	}, {
		// Level 45
		57, 206, 115, 240, 252, 179, 223, 119, 157, 231, 176, 143,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 167
	}, {
		// Level 46
		20, 164, 16, 132, 226, 43, 202, 82, 188, 167, 11, 202,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 229
	}, {
		// Level 47
		41, 78, 82, 156, 165, 187, 236, 247, 221, 229, 43, 207,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 231
	}, {
		// Level 48
		57, 203, 131, 148, 231, 59, 222, 247, 189, 231, 61, 10,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 231
	}, {
		// Level 49
		123, 222, 247, 189, 239, 121, 206, 115, 156, 239, 121, 207,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 231
	}, {
		// Level 50
		105, 206, 115, 156, 4, 59, 222, 247, 189, 224, 59, 196,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 231
	}, {
		// Level 51
		40, 168, 122, 20, 240, 41, 94, 87, 148, 233, 41, 94,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 167
	}, {
		// Level 52
		185, 206, 34, 28, 246, 187, 222, 247, 189, 246, 188, 10,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 239
	}, {
		// Level 53
		41, 74, 82, 148, 167, 44, 142, 252, 97, 231, 41, 120,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 167
	}, {
		// Level 54
		123, 222, 82, 149, 247, 129, 222, 82, 149, 247, 73, 206,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 239
	}, {
		// Level 55
		129, 206, 247, 189, 239, 75, 79, 90, 156, 175, 129, 206,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 239
	}, {
		// Level 56
		41, 74, 82, 189, 239, 41, 76, 82, 200, 231, 41, 74,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 165
	}, {
		// Level 57
		41, 74, 90, 157, 237, 41, 74, 92, 159, 39, 57, 206,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 229
	}, {
		// Level 58
		57, 68, 87, 193, 48, 57, 78, 87, 156, 231, 57, 78,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 165
	}, {
		// Level 59
		41, 94, 82, 148, 165, 56, 222, 82, 148, 165, 203, 222,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 175
	}, {
		// Level 60
		41, 74, 82, 148, 165, 41, 74, 82, 148, 165, 123, 222,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 165
	}, {
		// Level 61
		41, 199, 119, 189, 239, 187, 197, 74, 82, 148, 59, 202,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 231
	}, {
		// Level 62
		57, 228, 82, 132, 240, 105, 228, 82, 132, 233, 57, 222,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 239
	}, {
		// Level 63
		41, 94, 151, 148, 165, 169, 222, 119, 148, 229, 41, 115,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 231
	}, {
		// Level 64
		57, 206, 115, 156, 246, 59, 223, 189, 111, 118, 160, 135,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 239
	}, {
		// Level 65
		62, 115, 156, 159, 3, 59, 222, 247, 157, 229, 59, 222,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 3
	}, {
		// Level 66
		123, 222, 247, 189, 239, 121, 235, 83, 210, 135, 121, 94,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 239
	}, {
		// Level 67
		41, 74, 90, 148, 165, 41, 68, 89, 20, 165, 41, 74,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 162
	}, {
		// Level 68
		41, 75, 34, 140, 175, 40, 203, 34, 148, 175, 198, 178,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 182
	}, {
		// Level 69
		132, 30, 122, 150, 162, 132, 30, 87, 190, 82, 123, 222,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 175
	}, {
		// Level 70
		17, 94, 87, 188, 167, 27, 246, 124, 105, 227, 59, 243,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 9
	}, {
		// Level 71
		57, 192, 112, 156, 101, 41, 94, 119, 148, 165, 41, 94,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 5
	}, {
		// Level 72
		189, 41, 74, 82, 148, 187, 222, 243, 189, 239, 187, 222,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 165
	}, {
		// Level 73
		57, 206, 119, 156, 231, 56, 218, 119, 157, 39, 57, 206,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 239
	}, {
		// Level 74
		59, 206, 82, 149, 233, 62, 78, 50, 231, 39, 59, 206,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 239
	}, {
		// Level 75
		45, 78, 18, 136, 39, 59, 206, 242, 149, 231, 59, 206,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 71
	}
};

#define MAP_WIDTH	14
#define MAP_HEIGHT	8
unsigned char currentmap[MAP_HEIGHT][MAP_WIDTH];
unsigned char compressedmap[70];

void readcustommap(unsigned char l) {
	EEPROM.get(CUSTOMLOCATION + l * 70, compressedmap);
}

void savecustommap(unsigned char l) {
	EEPROM.put(CUSTOMLOCATION + l * 70, compressedmap);
}

void compressmap() {
	unsigned char c = 0;
	for(unsigned char i = 0; i < 70; i += 5) {
 		compressedmap[i + 0] = (currentmap[0][c] << 0x3) | (currentmap[1][c] >> 0x2);
		compressedmap[i + 1] = (currentmap[1][c] << 0x6) | (currentmap[2][c] << 0x1) | (currentmap[3][c] >> 0x4);
		compressedmap[i + 2] = (currentmap[3][c] << 0x4) | (currentmap[4][c] >> 0x1);
		compressedmap[i + 3] = (currentmap[4][c] << 0x7) | (currentmap[5][c] << 0x2) | (currentmap[6][c] >> 0x3);
		compressedmap[i + 4] = (currentmap[6][c] << 0x5) | (currentmap[7][c]);
		c++;
	}
}

void clearcompressed() {
	for(unsigned char i = 0; i < 70; i += 5) {
		compressedmap[i + 0] = 57;
		compressedmap[i + 1] = 206;
		compressedmap[i + 2] = 115;
		compressedmap[i + 3] = 156;
		compressedmap[i + 4] = 231;
	}
}

void expandmap(unsigned char l, boolean iscustom) {
	unsigned char buffer[5];
	unsigned char c = 0;
	boolean isvalid = true;
	boolean isempty = true;
	for(unsigned char x = 0; x < 70; x += 5) {
		if(iscustom) {
			for(unsigned char i = 0; i < 5; i++) {
				buffer[i] = compressedmap[x + i];
			}
		} else {
			buffer[0] = pgm_read_byte(&maps[l][x + 0]);
			buffer[1] = pgm_read_byte(&maps[l][x + 1]);
			buffer[2] = pgm_read_byte(&maps[l][x + 2]);
			buffer[3] = pgm_read_byte(&maps[l][x + 3]);
			buffer[4] = pgm_read_byte(&maps[l][x + 4]);
		}
		currentmap[0][c] = (buffer[0] >> 0x3);
		currentmap[1][c] = (buffer[0] << 0x2) & 0b00011111 | (buffer[1] >> 0x6);
		currentmap[2][c] = (buffer[1] >> 0x1) & 0b00011111;
		currentmap[3][c] = (buffer[1] << 0x4) & 0b00011111 | (buffer[2] >> 0x4);
		currentmap[4][c] = (buffer[2] << 0x1) & 0b00011111 | (buffer[3] >> 0x7);
		currentmap[5][c] = (buffer[3] >> 0x2) & 0b00011111;
		currentmap[6][c] = (buffer[3] << 0x3) & 0b00011111 | (buffer[4] >> 0x5);
		currentmap[7][c] = (buffer[4] & 0b00011111);

		if(iscustom) {
			for(unsigned char i = 0; i < 8; i++) {
				if(currentmap[i][c] != 0) {
					isempty = false;
				}
				boolean validtile = false;
				for(unsigned char tile = 0; tile < EDITOR_TILES; tile++) {
					if(currentmap[i][c] == pgm_read_byte(&edittiles[tile])) {
						validtile = true;
						break;
					}
				}
				isvalid = (isvalid && validtile);
			}
		}
		c++;
	}

	if(iscustom && (isempty || !isvalid)) {
		clearcompressed();
		expandmap(l, iscustom);
	}
}

unsigned char findpiece(signed char x, signed char y, unsigned char direction) {
	if(direction == DIR_UP) {
		y--;
	}
	if(direction == DIR_DOWN) {
		y++;
	}
	if(direction == DIR_LEFT) {
		x--;
	}
	if(direction == DIR_RIGHT) {
		x++;
	}
	if(x < 0 || x >= MAP_WIDTH || y < 0 || y >= MAP_HEIGHT) {
		return BLOCK;
	}

	return currentmap[y][x];
}

boolean canenter(unsigned char direction) {
	unsigned char to = findpiece(posx / 8, posy / 8, direction);

	if(to < BLOCK) {
		return true;
	}
	if(to < CON_U) {
		return false;
	}

	if(to == CON_U && direction == DIR_DOWN) {
		return false;
	}
	if(to == CON_D && direction == DIR_UP) {
		return false;
	}
	if(to == CON_L && direction == DIR_RIGHT) {
		return false;
	}
	if(to == CON_R && direction == DIR_LEFT) {
		return false;
	}
	if(to == ROT_H && (direction == DIR_UP || direction == DIR_DOWN)) {
		return false;
	}
	if(to == ROT_V && (direction == DIR_LEFT || direction == DIR_RIGHT)) {
		return false;
	}
	if(to == ROT_TL && (direction == DIR_DOWN || direction == DIR_RIGHT)) {
		return false;
	}
	if(to == ROT_TR && (direction == DIR_DOWN || direction == DIR_LEFT)) {
		return false;
	}
	if(to == ROT_BL && (direction == DIR_UP || direction == DIR_RIGHT)) {
		return false;
	}
	if(to == ROT_BR && (direction == DIR_UP || direction == DIR_LEFT)) {
		return false;
	}

	return true;
}

boolean canleave(unsigned char direction) {
	unsigned char from = currentmap[posy / 8][posx / 8];

	if(from == CON_U && direction == DIR_DOWN) {
		return false;
	}
	if(from == CON_D && direction == DIR_UP) {
		return false;
	}
	if(from == CON_L && direction == DIR_RIGHT) {
		return false;
	}
	if(from == CON_R && direction == DIR_LEFT) {
		return false;
	}
	if(from == ROT_H && (direction == DIR_UP || direction == DIR_DOWN)) {
		return false;
	}
	if(from == ROT_V && (direction == DIR_LEFT || direction == DIR_RIGHT)) {
		return false;
	}
	if(from == ROT_TL && (direction == DIR_UP || direction == DIR_LEFT)) {
		return false;
	}
	if(from == ROT_TR && (direction == DIR_UP || direction == DIR_RIGHT)) {
		return false;
	}
	if(from == ROT_BL && (direction == DIR_DOWN || direction == DIR_LEFT)) {
		return false;
	}
	if(from == ROT_BR && (direction == DIR_DOWN || direction == DIR_RIGHT)) {
		return false;
	}

	return true;
}

void onenter() {
	unsigned char on = currentmap[posy / 8][posx / 8];
	if(on == TRAP_O) {
		state = DIR_FALL;
		movetimer = TIME_FALL;
	}
	if(on == CAP_B) {
		swapall(CAP_I, CAP_O);
		sound(SOUND_CAPB, SOUND_SHORT);
	}
	if(on == ROT_B) {
		swapall(ROT_V, ROT_H);
		
		change(ROT_BL, HOLD);
		change(ROT_BR, ROT_BL);
		change(ROT_TR, ROT_BR);
		change(ROT_TL, ROT_TR);
		change(HOLD, ROT_TL);

		sound(SOUND_ROTB, SOUND_SHORT);
	}
	if(on == CON_B) {
		swapall(CON_D, CON_U);
		swapall(CON_R, CON_L);

		sound(SOUND_CONB, SOUND_SHORT);
	}
	if(on == CHIP_O) {
		currentmap[posy / 8][posx / 8] = CHIP_I;
		checkcompletion();

		if(!levelcomplete) {
			sound(SOUND_CHIPO, SOUND_SHORT);
		}
	}
	if(on == TELE) {
		if(posx / 8 == tele[0][PROP_X] && posy / 8 == tele[0][PROP_Y]) {
			posx = tele[1][PROP_X] * 8;
			posy = tele[1][PROP_Y] * 8;
		} else {
			posx = tele[0][PROP_X] * 8;
			posy = tele[0][PROP_Y] * 8;
		}
		state = DIR_TELE;
		movetimer = TIME_TELE;
	}
	if(on == EXIT) {
		if(levelcomplete) {
			sound(SOUND_LEVELCOMPLETE, SOUND_LONG);
			if(menuindex == MENU_PLAY) {
				if(currentlevel + 1 >= LEVELS) {
					gamestate = STATE_ENDING_1;
				} else {
					if(currentlevel >= maxlevel) {
						currentlevel++;
						menulevel = currentlevel;
						maxlevel = currentlevel;
						EEPROM.put(SAVELOCATION, maxlevel);
						loadlevel(currentlevel, false);
						buttonblock = 10;
					} else {
						gamestate = STATE_SELECT;
					}
				}
			} else {
				gamestate = STATE_EDIT_LOAD;
			}
			levelcomplete = false;
		}
	}
	if(on == CON_U) {
		if(canenter(DIR_UP)) {
			state = DIR_UP;
			movetimer = TIME_MOVE;
			sound(SOUND_CON, SOUND_MED);
		}
	}
	if(on == CON_D) {
		if(canenter(DIR_DOWN)) {
			state = DIR_DOWN;
			movetimer = TIME_MOVE;
			sound(SOUND_CON, SOUND_MED);
		}
	}
	if(on == CON_L) {
		if(canenter(DIR_LEFT)) {
			state = DIR_LEFT;
			movetimer = TIME_MOVE;
			sound(SOUND_CON, SOUND_MED);
		}
	}
	if(on == CON_R) {
		if(canenter(DIR_RIGHT)) {
			state = DIR_RIGHT;
			movetimer = TIME_MOVE;
			sound(SOUND_CON, SOUND_MED);
		}
	}
}

void onleave() {
	unsigned char off = currentmap[posy / 8][posx / 8];
	if(off == TRAP_C) {
		currentmap[posy / 8][posx / 8] = TRAP_O;
		sound(SOUND_TRAPO, SOUND_SHORT);
	}
	if(off == ROT_H) {
		currentmap[posy / 8][posx / 8] = ROT_V;
		sound(SOUND_ROT, SOUND_SHORT);
	}
	if(off == ROT_V) {
		currentmap[posy / 8][posx / 8] = ROT_H;
		sound(SOUND_ROT, SOUND_SHORT);
	}
	if(off == ROT_TL) {
		currentmap[posy / 8][posx / 8] = ROT_TR;
		sound(SOUND_ROT, SOUND_SHORT);
	}
	if(off == ROT_TR) {
		currentmap[posy / 8][posx / 8] = ROT_BR;
		sound(SOUND_ROT, SOUND_SHORT);
	}
	if(off == ROT_BL) {
		currentmap[posy / 8][posx / 8] = ROT_TL;
		sound(SOUND_ROT, SOUND_SHORT);
	}
	if(off == ROT_BR) {
		currentmap[posy / 8][posx / 8] = ROT_BL;
		sound(SOUND_ROT, SOUND_SHORT);
	}
}

void tostate(uint8_t button, unsigned char state) {
	if(buttonblock == 0 && arduboy.justReleased(button)) {
		sound(SOUND_MENU_NEXT, SOUND_SHORT);
		gamestate = state;
	}
}

void drawbox() {
	arduboy.drawRect(5, 2, 116, 63 - 2 * 2, WHITE);
	arduboy.fillRect(5 + 1, (2 + 1), 116 - 2, 63 - (2 + 1) * 2, BLACK);
}

void editorinput() {
	unsigned char serialbuffer = 0;
	if(buttonblock > 0) {
		return;
	}
	if(arduboy.pressed(A_BUTTON) && arduboy.pressed(B_BUTTON)) {
		sound(SOUND_MENU_EXIT, SOUND_MED);
		gamestate = STATE_SELECT;
		buttonblock = 15;
		return;
	}
	switch(editstate) {
		case EDIT_TILE:
			if(arduboy.justReleased(B_BUTTON)) {
				sound(SOUND_MENU_BACK, SOUND_SHORT);
				editstate = EDIT_PICKING;
				return;
			}
			if(arduboy.justReleased(A_BUTTON)) {
				sound(SOUND_MENU_PICK, SOUND_SHORT);
				currentmap[edity][editx] = pgm_read_byte(&edittiles[edittile]);
				animation = 0;
				editstate = EDIT_PICKING;
				return;
			}
			if(arduboy.justReleased(UP_BUTTON) && edittile < EDITOR_TILES - 1) {
				sound(SOUND_MENU_SCROLL, SOUND_SHORT);
				edittile++;
			}
			if(arduboy.justReleased(DOWN_BUTTON) && edittile > 0) {
				sound(SOUND_MENU_SCROLL, SOUND_SHORT);
				edittile--;
			}
			break;
		case EDIT_PICKING:
			if(arduboy.justReleased(A_BUTTON)) {
				sound(SOUND_MENU_NEXT, SOUND_SHORT);
				editstate = EDIT_TILE;
				return;
			}
			if(arduboy.justReleased(B_BUTTON)) {
				sound(SOUND_MENU_BACK, SOUND_SHORT);
				editstate = EDIT_MENU;
				return;
			}
			if(arduboy.justReleased(UP_BUTTON) && edity > 0) {
				edity--;
			}
			if(arduboy.justReleased(DOWN_BUTTON) && edity < MAP_HEIGHT - 1) {
				edity++;
			}
			if(arduboy.justReleased(LEFT_BUTTON) && editx > 0) {
				editx--;
			}
			if(arduboy.justReleased(RIGHT_BUTTON) && editx < MAP_WIDTH - 1) {
				editx++;
			}
			break;
		case EDIT_SENDING:
			drawbox();
			arduboy.drawBitmap(24, 28, usb, 12, 8, WHITE);
			arduboy.drawBitmap(36, 28, transfering, 47, 8, WHITE);
			arduboy.drawBitmap(83, 28, to, 12, 8, WHITE);
			arduboy.drawBitmap(95, 28, pc, 9, 8, WHITE);
			arduboy.display();
			compressmap();
			Serial.flush();
			Serial.write(compressedmap, 70);
			delay(250);
			serialbuffer = arduboy.audio.enabled();
			arduboy.audio.off();
			delay(1250);
			if(serialbuffer) {
				arduboy.audio.on();
			}
			editstate = EDIT_MENU;
			break;
		case EDIT_READING:
			drawbox();
			arduboy.drawBitmap(20, 28, usb, 12, 8, WHITE);
			arduboy.drawBitmap(32, 28, transfering, 47, 8, WHITE);
			arduboy.drawBitmap(79, 28, from, 20, 8, WHITE);
			arduboy.drawBitmap(99, 28, pc, 9, 8, WHITE);
			clearserialbuffer();
			while(serialbuffer < 70) {
				if(!arduboy.nextFrame()) {
					continue;
				}
				arduboy.drawFastHLine(29, 37, serialbuffer, WHITE);
				arduboy.display();
				beep.timer();
				arduboy.pollButtons();
				if(arduboy.justReleased(B_BUTTON)) {
					clearserialbuffer();
					sound(SOUND_MENU_BACK, SOUND_SHORT);
					editstate = EDIT_MENU;
					return;
				}
				if(Serial.available()) {
					compressedmap[serialbuffer] = (unsigned char)Serial.read();
					serialbuffer++;
				}
			}
			sound(SOUND_CHIPO, SOUND_SHORT);
			expandmap(currentlevel, true);
			editstate = EDIT_MENU;
			break;
		case EDIT_MENU:
			if(arduboy.justReleased(B_BUTTON)) {
				sound(SOUND_MENU_BACK, SOUND_SHORT);
				editstate = EDIT_PICKING;
				return;
			}
			if(arduboy.justReleased(A_BUTTON)) {
				if(editmenu == EDIT_EDIT) {
					editstate = EDIT_PICKING;
				}
				if(editmenu == EDIT_PLAY) {
					compressmap();
					loadlevel(currentlevel, true);
					gamestate = STATE_GAMEPLAY;
				}
				if(editmenu == EDIT_CLEAR) {
					clearcompressed();
					expandmap(currentlevel, true);
					editstate = EDIT_PICKING;
				}
				if(editmenu == EDIT_READ) {
					editstate = EDIT_READING;
				}
				if(editmenu == EDIT_SEND) {
					editstate = EDIT_SENDING;
				}
				if(editmenu == EDIT_SAVE) {
					compressmap();
					savecustommap(currentlevel);
					editstate = EDIT_PICKING;
				}
				if(editmenu == EDIT_EXIT) {
					sound(SOUND_MENU_BACK, SOUND_SHORT);
					editmenu = 0;
					gamestate = STATE_SELECT;
					return;
				}
				sound(SOUND_MENU_NEXT, SOUND_SHORT);
				return;
			}
			if(arduboy.justReleased(UP_BUTTON) && editmenu > 0) {
				sound(SOUND_MENU_SCROLL, SOUND_SHORT);
				editmenu--;
			}
			if(arduboy.justReleased(DOWN_BUTTON) && editmenu < 6) {
				sound(SOUND_MENU_SCROLL, SOUND_SHORT);
				editmenu++;
			}
			break;
	}
}

void die() {
	temperature = 0;
	levelcomplete = false;
	if(menuindex == MENU_PLAY) {
		loadlevel(currentlevel, false);
	} else {
		gamestate = STATE_EDIT_LOAD;
	}
}

void gameplayinput() {
	if(buttonblock > 0) {
		return;
	}
	if(arduboy.pressed(A_BUTTON) && arduboy.pressed(B_BUTTON)) {
		sound(SOUND_MENU_EXIT, SOUND_MED);
		if(menuindex == MENU_PLAY) {
			gamestate = STATE_SELECT;
		} else {
			gamestate = STATE_EDIT_LOAD;
		}
		buttonblock = 15;
		return;
	}
	if(movetimer > 0) {
		if(state == DIR_UP) {
			posy--;
		}
		if(state == DIR_DOWN) {
			posy++;
		}
		if(state == DIR_LEFT) {
			posx--;
		}
		if(state == DIR_RIGHT) {
			posx++;
		}
		movetimer--;
		if(movetimer == 0) {
			if(state == DIR_TELE) {
				state = DIR_STAY;
			} else if(state == DIR_FALL) {
				die();
			} else if(state != DIR_STAY) {
				state = DIR_STAY;
				onenter();
			}
		}
		return;
	}
	if(temperature == TEMP_MAX) {
		die();
		return;
	}
	if(arduboy.pressed(A_BUTTON) || arduboy.pressed(B_BUTTON)) {
		if(temperature < TEMP_MAX && state != DIR_SPAWNED) {
			sound(200 + temperature * 10, 10);
			temperature++;
		}
		if(temperature == TEMP_MAX) {
			state = DIR_STAY;
			movetimer = TIME_EXPLOSION;
			return;
		}
		return;
	} else {
		temperature = 0;
	}
	for(unsigned char d = 0; d < 4; d++) {
		if(arduboy.pressed(pgm_read_byte(&dirbuttons[d])) && canenter(d) && canleave(d)) {
			state = d;
			movetimer = 8;
			onleave();
			return;
		}
	}
}

void drawnumber(unsigned char x, unsigned char y, unsigned char value) {
	arduboy.fillRect(x, y, 9, 7);
	arduboy.drawBitmap(x + 1, y, numbers[value / 10], 3, 8, BLACK);
	arduboy.drawBitmap(x + 5, y, numbers[value % 10], 3, 8, BLACK);
}

void drawdude() {
	if(temperature > 0) {
		if(temperature >= TEMP_MAX) {
			arduboy.setRGBled(255, 0, 0);
			sound(65 + 100 * pgm_read_byte(&explosionsounds[(TIME_EXPLOSION - movetimer - 1) / (TIME_EXPLOSION / 4)]), SOUND_TINY);
			arduboy.drawBitmap(posx, posy, explosion[(TIME_EXPLOSION - movetimer - 1) / (TIME_EXPLOSION / 4) + 4], 8, 8, BLACK);
			arduboy.drawBitmap(posx, posy, explosion[(TIME_EXPLOSION - movetimer - 1) / (TIME_EXPLOSION / 4)], 8, 8, WHITE);
		} else {
			arduboy.setRGBled(temperature * 7, 0, 0);
			arduboy.drawBitmap(posx, posy, blocks[DUDE_BACK], 8, 8, BLACK);
			arduboy.drawBitmap(posx, posy, blocks[DUDE + animation % 2], 8, 8, WHITE);
		}
	} else {
		if(levelcomplete) {
			arduboy.setRGBled(0, 255, 0);
		} else {
			arduboy.setRGBled(0, 0, 0);
		}
		if(state == DIR_TELE) {
			sound(SOUND_TELE + (pgm_read_byte(&explosionsounds[(movetimer - 1) % (TIME_TELE / 4)])) * 100, SOUND_TINY);
			arduboy.drawBitmap(tele[0][PROP_X] * 8, tele[0][PROP_Y] * 8, blocks[DUDE_BACK], 8, 8, BLACK);
			arduboy.drawBitmap(tele[0][PROP_X] * 8, tele[0][PROP_Y] * 8, blocks[DUDE], 8, 8, (animation + 1) % 2);

			arduboy.drawBitmap(tele[1][PROP_X] * 8, tele[1][PROP_Y] * 8, blocks[DUDE_BACK], 8, 8, BLACK);
			arduboy.drawBitmap(tele[1][PROP_X] * 8, tele[1][PROP_Y] * 8, blocks[DUDE], 8, 8, animation % 2);
		} else if(state != DIR_FALL) {
			arduboy.drawBitmap(posx, posy, blocks[DUDE_BACK], 8, 8, BLACK);
			arduboy.drawBitmap(posx, posy, blocks[DUDE], 8, 8, WHITE);
		} else {
			arduboy.setRGBled(255, 0, 0);
			sound(SOUND_FALL - (TIME_FALL - movetimer) * 14, SOUND_TINY);
		}
	}
}

void draweditor() {
	arduboy.setRGBled(0, 0, 0);
	switch(editstate) {
		case EDIT_PICKING:
			if(animation / 6 == 1) {
				arduboy.fillRect(editx * 8 - 2, edity * 8 -2, 12, 12, WHITE);
			}
			break;
		case EDIT_MENU:
			drawbox();
			drawnumber(5 + 2, 2 + 2, currentlevel + 1);
			for(unsigned char i = 0; i < 7; i++) {
				arduboy.drawBitmap((56) - (editmenu == i) * 7, 4 + i * 8, menulabels[pgm_read_byte(&edititems[i])], 21, 8, WHITE);
			}
			if(editmenu == EDIT_READ || editmenu == EDIT_SEND) {
				arduboy.drawBitmap(56 - 19, 4 + editmenu * 8, usb, 12, 8, WHITE);
			}
			break;
		case EDIT_TILE:
			if(edittile < EDITOR_TILES - 1) {
				arduboy.drawBitmap(editx * 8, edity * 8 - 6 - arduboy.pressed(UP_BUTTON) - 1, arrowup, 7, 8, BLACK);
				arduboy.drawBitmap(editx * 8 + 1, edity * 8 - 6 - arduboy.pressed(UP_BUTTON) - 1, arrowup, 7, 8, BLACK);
				arduboy.drawBitmap(editx * 8, edity * 8 - 6 - arduboy.pressed(UP_BUTTON), arrowup, 7, 8, WHITE);
				arduboy.drawBitmap(editx * 8 + 1, edity * 8 - 6 - arduboy.pressed(UP_BUTTON), arrowup, 7, 8, WHITE);
			}
			if(edittile > 0) {
				arduboy.drawBitmap(editx * 8, edity * 8 + 10 + arduboy.pressed(DOWN_BUTTON) + 1, arrowdown, 7, 8, BLACK);
				arduboy.drawBitmap(editx * 8 + 1, edity * 8 + 10 + arduboy.pressed(DOWN_BUTTON) + 1, arrowdown, 7, 8, BLACK);
				arduboy.drawBitmap(editx * 8, edity * 8 + 10 + arduboy.pressed(DOWN_BUTTON), arrowdown, 7, 8, WHITE);
				arduboy.drawBitmap(editx * 8 + 1, edity * 8 + 10 + arduboy.pressed(DOWN_BUTTON), arrowdown, 7, 8, WHITE);
			}

			arduboy.fillRect(editx * 8 - 2, edity * 8 -2, 12, 12, BLACK);
			unsigned char e = pgm_read_byte(&edittiles[edittile]);
			if(e == BLANK) {
				e = HOLD;
			}
			arduboy.drawBitmap(editx * 8, edity * 8, blocks[e], 8, 8, WHITE);
			break;
	}
}

void drawui() {
	if(menuindex == MENU_PLAY) {
		arduboy.drawBitmap(112, 1, lv, 7, 8, WHITE);
		drawnumber(119, 1, currentlevel + 1);
	} else {
		arduboy.drawBitmap(112, 1, menulabels[1], 3, 8, WHITE);
		arduboy.drawBitmap(115, 1, menulabels[1] + 4, 13, 8, WHITE);
	}
	arduboy.drawBitmap(112, 8, sidebar, 16, 56, WHITE);
	if(temperature > 0) {
		arduboy.fillRect(113, 27, 14, 30, BLACK);
		arduboy.drawBitmap(116, 26, thermostat, 8, 32, WHITE);
		arduboy.fillRect(119, 26 + (TEMP_MAX - temperature), 2, temperature - 1, WHITE);
	} else {	
		if(levelcomplete) {
			arduboy.drawBitmap(112, 29, menulabels[5], 3, 8, WHITE);
			arduboy.drawBitmap(115, 29, menulabels[5] + 4, 13, 8, WHITE);
		} else {
			arduboy.drawBitmap(112, 29, wave + wavex, WAVE_WIDTH - wavex, 8, WHITE);
			arduboy.drawBitmap(112 + (WAVE_WIDTH - wavex), 29, wave, 15, 8, WHITE);
		}
	}
}

void drawmap() {
	signed char sx = random(temperature / 6) - (temperature / 12);
	signed char sy = random(temperature / 6) - (temperature / 12);
	for(unsigned char y = 0; y < MAP_HEIGHT; y++) {
		for(unsigned char x = 0; x < MAP_WIDTH; x++) {
			signed char bx = x * 8 + sx;
			signed char by = y * 8 + sy;
			const unsigned char* tile = nullptr;
			switch(currentmap[y][x]) {
				default:
					tile = blocks[currentmap[y][x]];
					break;
				case BLANK:
					break;
				case LED:
					if(levelcomplete) {
						tile = blocks[LED_ON];
					} else {
						tile = blocks[LED];
					}
					break;
				case EXIT:
					if(levelcomplete) {
						tile = blocks[EXIT + animation / 4];
					} else {
						tile = blocks[EXIT];
					}
					break;
				case TELE:
					tile = blocks[TELE + animation / 4];
					break;
				case CON_U:
					tile = conveyors[DIR_UP * 4 + animation / 3];
					break;
				case CON_D:
					tile = conveyors[DIR_DOWN * 4 + animation / 3];
					break;
				case CON_L:
					tile = conveyors[DIR_LEFT * 4 + animation / 3];
					break;
				case CON_R:
					tile = conveyors[DIR_RIGHT * 4 + animation / 3];
					break;
				case BLOCK:
					for(signed char quad = 0; quad < 4; quad++) {
						signed char wall = 0;
						bool corner = (findpiece(corners[quad][PROP_X] + x, corners[quad][PROP_Y] + y, DIR_STAY) == BLOCK);
						bool wallx = (findpiece((quad % 2) * 2 - 1 + x, y, DIR_STAY) == BLOCK);
						bool wally = (findpiece(x, (quad / 2) * 2 - 1 + y, DIR_STAY) == BLOCK);
						if(wallx && wally && corner) {
							continue;
						} else if(wallx && wally) {
							wall = 3 - quad;
						} else if(!wallx && !wally) {
							wall = quad;
						} else if(wallx && !wally) {
							wall = WALL_H;
						} else if(!wallx && wally) {
							wall = WALL_V;
						}
						arduboy.drawBitmap(bx + (corners[quad][PROP_X] == 1) * 4, by + (corners[quad][PROP_Y] == 1) * 4, walls[wall], 4, 8, WHITE);
					}
					break;
			}
			if(tile != nullptr) {
				arduboy.drawBitmap(bx, by, tile, 8, 8, WHITE);
			}
		}
		if(state == DIR_FALL && posy / 8 == y) {
			arduboy.setRGBled(255, 0, 0);
			arduboy.drawBitmap(posx, posy + (TIME_FALL - movetimer) / 4, blocks[DUDE_BACK], 8, 8, BLACK);
			arduboy.drawBitmap(posx, posy + (TIME_FALL - movetimer) / 4, blocks[DUDE], 8, 8, WHITE);

			arduboy.fillRect(posx, posy + 8, 8, 8, BLACK);
		}
	}
}

void credits() {
	arduboy.drawBitmap(8, 8, me, 48, 48, WHITE);

	arduboy.drawBitmap(73, 8, jonathan, 47, 8, WHITE);
	arduboy.drawBitmap(85, 18, holmes, 35, 8, WHITE);
	arduboy.drawBitmap(85, 38, at, 5, 8, WHITE);
	arduboy.drawBitmap(91, 38, crait, 29, 8, WHITE);
	arduboy.drawBitmap(67, 49, crait, 29, 8, WHITE);
	arduboy.drawBitmap(99, 49, net, 21, 8, WHITE);
}

void systems() {
	arduboy.drawBitmap(30, 14, also, 69, 8, WHITE);
	for(unsigned char i = 0; i < 4; i++) {
		arduboy.drawBitmap(6 + 29 * i, 28, 	platforms[i], 24, 24, WHITE);
	}

}

void title() {
	arduboy.setRGBled(0, 0, 0);
	arduboy.drawBitmap(0 - MAIN_OFFSET, 41, rightarm, 8, 24, WHITE);
	arduboy.drawBitmap(8 - MAIN_OFFSET, 11, circuitdude, 48, 56, WHITE);
	arduboy.drawBitmap(56 - MAIN_OFFSET, 43, leftarm, 16, 16, WHITE);
	
	arduboy.drawBitmap(44, 3, circuit, 67, 16, WHITE);
	arduboy.drawBitmap(55, 19, dude, 44, 16, WHITE);
}

void menu() {
	if(arduboy.justReleased(UP_BUTTON) && menuindex > 0) {
		sound(SOUND_MENU_SCROLL, SOUND_SHORT);
		menuindex--;
	}
	if(arduboy.justReleased(DOWN_BUTTON) && menuindex < 3) {
		sound(SOUND_MENU_SCROLL, SOUND_SHORT);
		menuindex++;
	}

	for(unsigned char i = 0; i < 4; i++) {
		arduboy.drawBitmap(107 - (menuindex == i) * 7, 33 + i * 8, menulabels[i], 21, 8, WHITE);
		if(menuindex == i) {
			arduboy.fillRect(121, 33 + i * 8, 7, 7, WHITE);
			if(arduboy.justReleased(A_BUTTON)) {
				sound(SOUND_MENU_NEXT, SOUND_SHORT);
				gamestate = menudirection[i];
			}
			if(menuindex == 3) {
				arduboy.drawBitmap(121, 33 + i * 8, soundlabel, 2 + (arduboy.audio.enabled() * 4), 6, BLACK);
			}
		}
	}
}

void select() {
	arduboy.setRGBled(0, 0, 0);
	if(buttonblock == 0 && arduboy.justReleased(B_BUTTON)) {
		sound(SOUND_MENU_BACK, SOUND_SHORT);
		gamestate = STATE_TITLE;
		return;
	}

	if(menulevel > 0 && arduboy.justReleased(DOWN_BUTTON)) {
		menulevel--;
		sound(SOUND_MENU_SCROLL, SOUND_SHORT);
	}
	if(arduboy.justReleased(UP_BUTTON)) {
		menulevel++;
		sound(SOUND_MENU_SCROLL, SOUND_SHORT);
	}
	if(menulevel > 0) {
		arduboy.drawBitmap(109, 57 + arduboy.pressed(DOWN_BUTTON), arrowdown, 7, 8, WHITE);
	}
	if(menuindex == MENU_EDIT) {
		arduboy.drawBitmap(86, 41, saved, 21, 8, WHITE);
		if(menulevel >= CUSTOMLEVELS) {
			menulevel = CUSTOMLEVELS;
		} else {
			arduboy.drawBitmap(109, 44 - arduboy.pressed(UP_BUTTON), arrowup, 7, 8, WHITE);
		}
		tostate(A_BUTTON, STATE_EDIT_BUFFER);
	} else {
		if(menulevel >= LEVELS - 1) {
			menulevel = LEVELS - 1;
		} else {
			arduboy.drawBitmap(109, 44 - arduboy.pressed(UP_BUTTON), arrowup, 7, 8, WHITE);
		}
		if(menulevel > maxlevel) {
			arduboy.drawBitmap(118, 49, lock, 5, 8, WHITE);
		} else {
			tostate(A_BUTTON, STATE_GAME);
		}
	}
	arduboy.drawBitmap(86, 49, level, 21, 8, WHITE);

	drawnumber(108, 49, menulevel + 1);
}

void ending1() {
	arduboy.setRGBled(150, 0, 0);
	arduboy.drawBitmap(23, 48, ending_table, 80, 16, WHITE);
	arduboy.drawBitmap(27, 4, ending_laughing_face, 53, 32, WHITE);
	arduboy.drawBitmap(32, 36, ending_laughing_body, 58, 16, WHITE);
	arduboy.drawBitmap(90, 22, ending_laughing_left, 26, 24, WHITE);
	arduboy.drawBitmap(2, 32, ending_laughing_right, 24, 24, WHITE);
	arduboy.drawBitmap(21, 48, ending_laughing_arm, 23, 16, WHITE);
}

void ending2() {
	arduboy.setRGBled(255, 0, 0);
	arduboy.drawBitmap(23, 48, ending_table, 80, 16, WHITE);
	arduboy.drawBitmap(43, 48, ending_smile_body_back, 46, 8, BLACK);
	arduboy.drawBitmap(34, 41, ending_smile_body, 61, 16, WHITE);
	arduboy.drawBitmap(38, 9, ending_smile_face, 50, 32, WHITE);
}

void ending3() {
	arduboy.setRGBled(0, 0, 0);
	arduboy.drawBitmap(30, 0, ending_circle_1, 60, 64, WHITE);
}

void ending4() {
	arduboy.setRGBled(255, 0, 0);
	arduboy.drawBitmap(16, 0, ending_circle_2, 96, 64, WHITE);
}

void ending5() {
	arduboy.setRGBled(0, 0, 0);
	arduboy.drawBitmap(52, 28, ending_label, 25, 8, WHITE);
}

void checkcompletion() {
	levelcomplete = true;
	for(unsigned char x = 0; x < MAP_WIDTH; x++) {
		for(unsigned char y = 0; y < MAP_HEIGHT; y++) {
			if(currentmap[y][x] == CHIP_O) {
				levelcomplete = false;
			}
		}
	}

	if(levelcomplete) {
		sound(SOUND_LEVELCOMPLETE, SOUND_LONG);
	}
}

void change(unsigned char from, unsigned char to) {
	for(unsigned char x = 0; x < MAP_WIDTH; x++) {
		for(unsigned char y = 0; y < MAP_HEIGHT; y++) {
			if(currentmap[y][x] == from) {
				currentmap[y][x] = to;
			}
		}
	}
}

void swapall(unsigned char from, unsigned char to) {
	change(from, HOLD);
	change(to, from);
	change(HOLD, to);
}

void loadlevel(unsigned char l, boolean iscustom) {
	arduboy.setRGBled(0, 0, 0);
	posx = 0;
	posy = 0;
	if(l >= LEVELS) {
		gamestate = STATE_ENDING_1;
		return;
	}
	levelcomplete = false;
	temperature = 0;
	movetimer = 0;
	state = DIR_SPAWNED;
	expandmap(l, iscustom);
	tele[0][PROP_X] = 255;
	for(unsigned char x = 0; x < MAP_WIDTH; x++) {
		for(unsigned char y = 0; y < MAP_HEIGHT; y++) {
			if(currentmap[y][x] == START) {
				posx = x * 8;
				posy = y * 8;
				currentmap[y][x] = BLANK;
			}
			if(currentmap[y][x] == TELE) {
				if((tele[0][PROP_X] == 255)) {
					tele[0][PROP_Y] = y;
					tele[0][PROP_X] = x;
				} else {
					tele[1][PROP_Y] = y;
					tele[1][PROP_X] = x;
				}
			}
		}
	}
}

void editor() {
	drawmap();
	drawui();
	draweditor();
	editorinput();
}

void gameplay() {
	drawmap();
	drawui();
	drawdude();
	gameplayinput();
}

void gameloop() {
	switch(gamestate) {
		case STATE_CREDITS:
			credits();
			tostate(A_BUTTON, STATE_SYSTEMS);
			break;
		case STATE_SYSTEMS:
			systems();
			tostate(A_BUTTON, STATE_TITLE);
			break;
		case STATE_SOUND:
			gamestate = STATE_TITLE;
			arduboy.audio.toggle();
			arduboy.audio.saveOnOff();
		case STATE_TITLE:
			title();
			menu();
			break;
		case STATE_EDIT_BUFFER:
			currentlevel = menulevel;
			readcustommap(currentlevel);
		case STATE_EDIT_LOAD:
			editstate = EDIT_MENU;
			editmenu = 0;
			temperature = 0;
			state = DIR_STAY;
			levelcomplete = false;
			expandmap(currentlevel, true);
			gamestate = STATE_EDITOR;
		case STATE_EDITOR:
			editor();
			break;
		case STATE_SELECT_GAME:
			gamestate = STATE_SELECT;
			menulevel = maxlevel;
			title();
			select();
			break;
		case STATE_SELECT_EDIT:
			gamestate = STATE_SELECT;
			menulevel = 0;
			title();
			select();
			break;
		case STATE_SELECT:
			title();
			select();
			break;
		case STATE_GAME:
			currentlevel = menulevel;
			loadlevel(currentlevel, menuindex != MENU_PLAY);
			gamestate = STATE_GAMEPLAY;
		case STATE_GAMEPLAY:
			gameplay();
			break;
		case STATE_ENDING_1:
			ending1();
			tostate(A_BUTTON, STATE_ENDING_2);
			break;
		case STATE_ENDING_2:
			ending2();
			tostate(A_BUTTON, STATE_ENDING_3);
			break;
		case STATE_ENDING_3:
			ending3();
			tostate(A_BUTTON, STATE_ENDING_4);
			break;
		case STATE_ENDING_4:
			ending4();
			tostate(A_BUTTON, STATE_ENDING_5);
			break;
		case STATE_ENDING_5:
			ending5();
			tostate(A_BUTTON, STATE_CREDITS);
			break;
	}
}

void setup() {
  WiFi.mode(WIFI_OFF); 
	arduboy.begin();
	arduboy.setFrameRate(FRAMERATE);
	beep.begin();
	arduboy.setRGBled(0, 0, 0);

	EEPROM.get(SAVELOCATION, maxlevel);
	if(maxlevel >= LEVELS) {
		maxlevel = 0;
		EEPROM.put(SAVELOCATION, maxlevel);
	}
	menulevel = maxlevel;
	
	Serial.begin(9600);
}

void loop() {
	if(!arduboy.nextFrame()) {
		return;
	}

	beep.timer();

	animation = (animation + 1) % 12;
	if(animation % 4 == 0) {
		wavex = (wavex + 1) % WAVE_WIDTH;
	}
	if(buttonblock > 0) {
		buttonblock--;
	}
	arduboy.pollButtons();
	arduboy.clear();

	gameloop();

	arduboy.display();
}
