#define GAME_ID_1                    72
#define GAME_ID_2                    82
#define EEPROM_HRDC_START            16
#define OFFSET_LEVEL_S1              2
#define OFFSET_SHIP_S1               3
#define OFFSET_HSCORE_S1             4
#define OFFSET_LEVEL_S2              4 + sizeof(unsigned int)
#define OFFSET_SHIP_S2               OFFSET_LEVEL_S2 + 1
#define OFFSET_HSCORE_S2             OFFSET_LEVEL_S2 + 2
#define OFFSET_LEVEL_S3              OFFSET_HSCORE_S2 + sizeof(unsigned int)
#define OFFSET_SHIP_S3               OFFSET_LEVEL_S3 + 1
#define OFFSET_HSCORE_S3             OFFSET_LEVEL_S3 + 2

void setHrDcEEPROM()
{
  if (EEPROM.read(EEPROM_STORAGE_SPACE_START + EEPROM_HRDC_START) != GAME_ID_1 && EEPROM.read(EEPROM_STORAGE_SPACE_START + EEPROM_HRDC_START + 1) != GAME_ID_2)
  {
#ifdef DEBUG_SERIAL
    Serial.println("eeprom write");
#endif
    EEPROM.put(EEPROM_STORAGE_SPACE_START + EEPROM_HRDC_START, (byte)GAME_ID_1);
    EEPROM.put(EEPROM_STORAGE_SPACE_START + EEPROM_HRDC_START + 1, (byte)GAME_ID_2);

    EEPROM.put(EEPROM_STORAGE_SPACE_START + EEPROM_HRDC_START + OFFSET_LEVEL_S1, (byte)0);
    EEPROM.put(EEPROM_STORAGE_SPACE_START + EEPROM_HRDC_START + OFFSET_SHIP_S1, (byte)0);
    EEPROM.put(EEPROM_STORAGE_SPACE_START + EEPROM_HRDC_START + OFFSET_HSCORE_S1, (unsigned int)0);

    EEPROM.put(EEPROM_STORAGE_SPACE_START + EEPROM_HRDC_START + OFFSET_LEVEL_S2, (byte)0);
    EEPROM.put(EEPROM_STORAGE_SPACE_START + EEPROM_HRDC_START + OFFSET_SHIP_S2, (byte)0);
    EEPROM.put(EEPROM_STORAGE_SPACE_START + EEPROM_HRDC_START + OFFSET_HSCORE_S2, (unsigned int)0);

    EEPROM.put(EEPROM_STORAGE_SPACE_START + EEPROM_HRDC_START + OFFSET_LEVEL_S3, (byte)0);
    EEPROM.put(EEPROM_STORAGE_SPACE_START + EEPROM_HRDC_START + OFFSET_SHIP_S3, (byte)0);
    EEPROM.put(EEPROM_STORAGE_SPACE_START + EEPROM_HRDC_START + OFFSET_HSCORE_S3, (unsigned int)0);
  }
  EEPROM.commit();
}

void savehighscore(unsigned int gamescore, byte gamelevel, byte gameshiptype)
{
  unsigned int score1 = 0;
  EEPROM.get(EEPROM_STORAGE_SPACE_START + EEPROM_HRDC_START + OFFSET_HSCORE_S1, score1);
  unsigned int score2 = 0;
  EEPROM.get(EEPROM_STORAGE_SPACE_START + EEPROM_HRDC_START + OFFSET_HSCORE_S2, score2);
  unsigned int score3 = 0;
  EEPROM.get(EEPROM_STORAGE_SPACE_START + EEPROM_HRDC_START + OFFSET_HSCORE_S3, score3);

  if (gamescore >= score1)
  {
    byte level1 = EEPROM.read(EEPROM_STORAGE_SPACE_START + EEPROM_HRDC_START + OFFSET_LEVEL_S1);
    byte ship1 = EEPROM.read(EEPROM_STORAGE_SPACE_START + EEPROM_HRDC_START + OFFSET_SHIP_S1);
    byte level2 = EEPROM.read(EEPROM_STORAGE_SPACE_START + EEPROM_HRDC_START + OFFSET_LEVEL_S2);
    byte ship2 = EEPROM.read(EEPROM_STORAGE_SPACE_START + EEPROM_HRDC_START + OFFSET_SHIP_S2);

    EEPROM.put(EEPROM_STORAGE_SPACE_START + EEPROM_HRDC_START + OFFSET_LEVEL_S1, gamelevel);
    EEPROM.put(EEPROM_STORAGE_SPACE_START + EEPROM_HRDC_START + OFFSET_SHIP_S1, gameshiptype);
    EEPROM.put(EEPROM_STORAGE_SPACE_START + EEPROM_HRDC_START + OFFSET_HSCORE_S1, gamescore);

    EEPROM.write(EEPROM_STORAGE_SPACE_START + EEPROM_HRDC_START + OFFSET_LEVEL_S2, (byte)level1);
    EEPROM.write(EEPROM_STORAGE_SPACE_START + EEPROM_HRDC_START + OFFSET_SHIP_S2, (byte)ship1);
    EEPROM.put(EEPROM_STORAGE_SPACE_START + EEPROM_HRDC_START + OFFSET_HSCORE_S2, (unsigned int)score1);

    EEPROM.write(EEPROM_STORAGE_SPACE_START + EEPROM_HRDC_START + OFFSET_LEVEL_S3, (byte)level2);
    EEPROM.write(EEPROM_STORAGE_SPACE_START + EEPROM_HRDC_START + OFFSET_SHIP_S3, (byte)ship2);
    EEPROM.put(EEPROM_STORAGE_SPACE_START + EEPROM_HRDC_START + OFFSET_HSCORE_S3, (unsigned int)score2);
  } else if (gamescore >= score2)
  {
    byte level2 = EEPROM.read(EEPROM_STORAGE_SPACE_START + EEPROM_HRDC_START + OFFSET_LEVEL_S2);
    byte ship2 = EEPROM.read(EEPROM_STORAGE_SPACE_START + EEPROM_HRDC_START + OFFSET_SHIP_S2);

    EEPROM.write(EEPROM_STORAGE_SPACE_START + EEPROM_HRDC_START + OFFSET_LEVEL_S2, gamelevel);
    EEPROM.write(EEPROM_STORAGE_SPACE_START + EEPROM_HRDC_START + OFFSET_SHIP_S2, gameshiptype);
    EEPROM.put(EEPROM_STORAGE_SPACE_START + EEPROM_HRDC_START + OFFSET_HSCORE_S2, gamescore);

    EEPROM.write(EEPROM_STORAGE_SPACE_START + EEPROM_HRDC_START + OFFSET_LEVEL_S3, (byte)level2);
    EEPROM.write(EEPROM_STORAGE_SPACE_START + EEPROM_HRDC_START + OFFSET_SHIP_S3, (byte)ship2);
    EEPROM.put(EEPROM_STORAGE_SPACE_START + EEPROM_HRDC_START + OFFSET_HSCORE_S3, (unsigned int)score2);
  } else if (gamescore >= score3)
  {
    EEPROM.write(EEPROM_STORAGE_SPACE_START + EEPROM_HRDC_START + OFFSET_LEVEL_S3, gamelevel);
    EEPROM.write(EEPROM_STORAGE_SPACE_START + EEPROM_HRDC_START + OFFSET_SHIP_S3, gameshiptype);
    EEPROM.put(EEPROM_STORAGE_SPACE_START + EEPROM_HRDC_START + OFFSET_HSCORE_S3, gamescore);
  }
  EEPROM.commit();
}

void drawshipname(byte shiptype, byte x, byte y)
{
  switch (shiptype)
  {
    case SHIP_ODINO:
      drawstring(F("ODINO"), x, y);
      break;
    case SHIP_THOR:
      drawstring(F("THOR"), x, y);
      break;
    case SHIP_FREYR:
      drawstring(F("FREYR"), x, y);
      break;
  }
}
